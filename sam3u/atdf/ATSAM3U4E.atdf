# ATSAM3U4E device description
Architecture: CORTEX-M3; Family: SAM3; Series: SAM3U
Parameters: __CM3_REV=0x0200, __MPU_PRESENT=1, __FPU_PRESENT=0, __NVIC_PRIO_BITS=4, __Vendor_SysTickConfig=0
Programming and debug interfaces: JTAG, SWD
Registers are 32-bit, read-write, no defined reset value unless marked. A register's access mark holds for its fields unless they carry their own. Offsets are from the block's base; lines under a group give offsets from that group; [hi:lo] are bit positions; {n}, {i} and the like mark numbered series; 'fields as' and 'values as' point back to an identical list; <NAME> marks a mode.

## Ordering variants
ATSAM3U4E-CU: BGA144, up to 96 MHz, -40 to 85 C, 1.62 to 3.6 V
ATSAM3U4E-AU: LQFP144, up to 96 MHz, -40 to 85 C, 1.62 to 3.6 V

## Memory
base space: start 0 size 0x100000000, little endian
  0x40000000 PERIPHERALS size 0x20000000 io
  0xE0000000 SYSTEM size 0x10000000 io
  0x00080000 IFLASH0 size 0x00020000 flash, page 256
  0x00100000 IFLASH1 size 0x00020000 flash, page 256
  0x00180000 IROM size 0x00100000 rom
  0x20000000 IRAM0 size 0x00008000 ram
  0x20080000 IRAM1 size 0x00004000 ram
  0x20100000 NFC_RAM size 0x00100000 other
  0x20180000 UDPHS_RAM size 0x00100000 other
  0x60000000 EBI_CS0 size 0x01000000 other
  0x61000000 EBI_CS1 size 0x01000000 other
  0x62000000 EBI_CS2 size 0x01000000 other
  0x63000000 EBI_CS3 size 0x01000000 other
fuses space: start 0 size 4, little endian
lockbits space: start 0 size 4, little endian

## Peripheral instances (address, pins/pin function, parameters)
ADC at 0x400AC000
  pins: ADTRG PA17/B; AD0 PB5/X1; AD1 PB6/X1; AD2 PB7/X1; AD3 PB8/X1; AD4 PC28/X1; AD5 PC29/X1; AD6 PC30/X1; AD7 PC31/X1
ADC12B at 0x400A8000
  pins: AD12BTRG PA2/B; AD12B0 PA22/X1; AD12B1 PA30/X1; AD12B2 PB3/X1; AD12B3 PB4/X1; AD12B4 PC15/X1; AD12B5 PC16/X1; AD12B6 PC17/X1; AD12B7 PC18/X1
CHIPID at 0x400E0740
DMAC at 0x400B0000
EFC0 at 0x400E0800 (EFC)
  parameters: FLASH_SIZE=131072, PAGE_SIZE=256, PAGES_PR_REGION=32
EFC1 at 0x400E0A00 (EFC)
  parameters: FLASH_SIZE=131072, PAGE_SIZE=256, PAGES_PR_REGION=32
GPBR at 0x400E1290
HSMCI at 0x40000000
  pins: MCCDA PA4/A; MCCK PA3/A; MCDA0 PA5/A; MCDA1 PA6/A; MCDA2 PA7/A; MCDA3 PA8/A; MCDA4 PC28/B; MCDA5 PC29/B; MCDA6 PC30/B; MCDA7 PC31/B
MATRIX at 0x400E0200
PIOA at 0x400E0C00 (PIO)
PIOB at 0x400E0E00 (PIO)
PIOC at 0x400E1000 (PIO)
PMC at 0x400E0400
  pins: PCK0 PA21/B or PA27/B; PCK1 PA3/B or PB24/B; PCK2 PB23/B
PWM at 0x4008C000
  pins: PWMFI0 PA11/B; PWMFI1 PA12/B; PWMFI2 PA18/B; PWMH0 PA4/B or PA28/B or PB0/A or PB13/B or PC24/B; PWMH1 PA5/B or PA29/B or PB1/A or PB14/B or PC25/B; PWMH2 PA6/B or PA15/B or PB2/A or PB15/B or PC26/B; PWMH3 PA20/B or PB3/A or PB16/B or PC27/B; PWML0 PA7/B or PB17/B or PB25/B or PC6/B or PC29/A; PWML1 PA8/B or PB18/B or PB26/B or PC7/B or PC30/A; PWML2 PA9/B or PB19/B or PB27/B or PC8/B or PC31/A; PWML3 PA10/B or PB20/B or PB28/B or PC9/B or PC16/B
RSTC at 0x400E1200
RTC at 0x400E1260
RTT at 0x400E1230
SMC at 0x400E0000
SPI at 0x40008000
  pins: MISO PA13/A; MOSI PA14/A; NPCS0 PA16/A; NPCS1 PA0/B or PC3/B or PC19/B; NPCS2 PA1/B or PC4/B or PC14/B; NPCS3 PA19/B or PC5/B; SPCK PA15/A
SSC at 0x40004000
  pins: RD PA27/A; RF PA31/A; RK PA29/A; TD PA26/A; TF PA30/A; TK PA28/A
SUPC at 0x400E1210
TC0 at 0x40080000 (TC)
  pins: TCLK0 PA2/A; TCLK1 PB4/A; TCLK2 PA26/B; TIOA0 PA1/A; TIOA1 PB5/A; TIOA2 PA30/B; TIOB0 PA0/A; TIOB1 PB6/A; TIOB2 PA31/B
TWI0 at 0x40084000 (TWI)
  pins: TWCK0 PA10/A; TWD0 PA9/A
TWI1 at 0x40088000 (TWI)
  pins: TWCK1 PA25/A; TWD1 PA24/A
UART at 0x400E0600
  pins: URXD PA11/A; UTXD PA12/A
UDPHS at 0x400A4000
USART0 at 0x40090000 (USART)
  pins: CTS0 PB8/A; DCD0 PB11/B; DSR0 PB10/B; DTR0 PB9/B; RI0 PB12/B; RTS0 PB7/A; RXD0 PA19/A; SCK0 PA17/A; TXD0 PA18/A
USART1 at 0x40094000 (USART)
  pins: CTS1 PA23/B; RTS1 PA22/B; RXD1 PA21/A; SCK1 PA24/B; TXD1 PA20/A
USART2 at 0x40098000 (USART)
  pins: CTS2 PB22/B; RTS2 PB21/B; RXD2 PA23/A; SCK2 PA25/B; TXD2 PA22/A
USART3 at 0x4009C000 (USART)
  pins: CTS3 PC10/B; RTS3 PC11/B; RXD3 PC13/B; SCK3 PC19/A; TXD3 PC12/B
WDT at 0x400E1250
FUSES at GPNVMBITS 0 in fuses
LOCKBIT at 0 in lockbits
SystemControl at 0xE000E000
SysTick at 0xE000E010
NVIC at 0xE000E100

## Interrupts
-14 NonMaskableInt_IRQn — Non Maskable Interrupt
-13 HardFault_IRQn — HardFault Interrupt
-12 MemoryManagement_IRQn — Cortex-M3 Memory Management Interrupt
-11 BusFault_IRQn — Cortex-M3 Bus Fault Interrupt
-10 UsageFault_IRQn — Cortex-M3 Usage Fault Interrupt
-5 SVCall_IRQn — Cortex-M3 SV Call Interrupt
-4 DebugMonitor_IRQn — Cortex-M3 Debug Monitor Interrupt
-2 PendSV_IRQn — Cortex-M3 Pend SV Interrupt
-1 SysTick_IRQn — Cortex-M3 System Tick Interrupt
0 SUPC (SYSC) — Supply Controller
1 RSTC (SYSC) — Reset Controller
2 RTC (SYSC) — Real Time Clock
3 RTT (SYSC) — Real Time Timer
4 WDT (SYSC) — Watchdog Timer
5 PMC — Power Management Controller
6 EFC0 — Enhanced Embedded Flash Controller 0
7 EFC1 — Enhanced Embedded Flash Controller 1
8 UART — Universal Asynchronous Receiver Transmitter
10 PIOA — Parallel I/O Controller A,
11 PIOB — Parallel I/O Controller B
12 PIOC — Parallel I/O Controller C
13 USART0
14 USART1
15 USART2
16 USART3
17 HSMCI — High Speed Multimedia Card Interface
18 TWI0 — Two-Wire Interface 0
19 TWI1 — Two-Wire Interface 1
20 SPI — Serial Peripheral Interface
21 SSC — Synchronous Serial Controller
22 TC0 — Timer Counter 0
23 TC1 (TC0) — Timer Counter 1
24 TC2 (TC0) — Timer Counter 2
25 PWM — Pulse Width Modulation Controller
26 ADC12B — 12-bit ADC Controller
27 ADC — 10-bit ADC Controller
28 DMAC — DMA Controller
29 UDPHS — USB Device High Speed

## Properties
SIGNATURES: JTAGID=0x05B2A01F, CHIPID_CIDR=0x28100960, CHIPID_EXID=0x0

## Notices in the file
SAM Software Package License
Copyright (c) %copyright_year%, Atmel Corporation
All rights reserved.
Redistribution and use in source and binary forms, with or without
modification, are permitted provided that the following condition is met:
- Redistributions of source code must retain the above copyright notice,
this list of conditions and the disclaimer below.
Atmel's name may not be used to endorse or promote products derived from
this software without specific prior written permission.
DISCLAIMER:  THIS SOFTWARE IS PROVIDED BY ATMEL "AS IS" AND ANY EXPRESS OR
IMPLIED WARRANTIES, INCLUDING, BUT NOT LIMITED TO, THE IMPLIED WARRANTIES OF
MERCHANTABILITY, FITNESS FOR A PARTICULAR PURPOSE AND NON-INFRINGEMENT ARE
DISCLAIMED. IN NO EVENT SHALL ATMEL BE LIABLE FOR ANY DIRECT, INDIRECT,
INCIDENTAL, SPECIAL, EXEMPLARY, OR CONSEQUENTIAL DAMAGES (INCLUDING, BUT NOT
LIMITED TO, PROCUREMENT OF SUBSTITUTE GOODS OR SERVICES; LOSS OF USE, DATA,
OR PROFITS; OR BUSINESS INTERRUPTION) HOWEVER CAUSED AND ON ANY THEORY OF
LIABILITY, WHETHER IN CONTRACT, STRICT LIABILITY, OR TORT (INCLUDING
NEGLIGENCE OR OTHERWISE) ARISING IN ANY WAY OUT OF THE USE OF THIS SOFTWARE,
EVEN IF ADVISED OF THE POSSIBILITY OF SUCH DAMAGE.
