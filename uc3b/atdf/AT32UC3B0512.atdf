# AT32UC3B0512 device description
Architecture: AVR32_UC3; Family: AVR UC3
Programming and debug interfaces: JTAG
Registers are 32-bit, read-write, reset 0x0 unless marked. A register's access mark holds for its fields unless they carry their own. Offsets are from the block's base; lines under a group give offsets from that group; [hi:lo] are bit positions; {n}, {i} and the like mark numbered series; 'fields as' and 'values as' point back to an identical list; <NAME> marks a mode.

## Ordering variants
standard: up to 60 MHz, 3.0 to 3.6 V

## Memory
sysreg space: start 0 size 1024, big endian
dbgreg space: start 0 size 1024
base space: start 0 size 0x100000000, big endian
  0x80000000 FLASH size 0x00080000 flash
  0x80800000 USER_PAGE size 0x00000200 user_page
  0x00000000 SRAM size 0x00018000 ram
  0xD0000000 USBB_SLAVE size 0x00800000 other
  0xfffe0000 IO size 0x20000 io, rw
fuses space: start 0xFFFE1410 size 4, big endian

## Peripheral instances (address, pins/pin function, parameters)
CORE at 0 in sysreg
INTC at 0xFFFF0800
  parameters: NUM_INT_GRPS=16, NUM_IRQS_PER_GRP0=1, NUM_IRQS_PER_GRP1=11, NUM_IRQS_PER_GRP2=6, NUM_IRQS_PER_GRP3=7, NUM_IRQS_PER_GRP{n}=1 (n=4..11), NUM_IRQS_PER_GRP12=3, NUM_IRQS_PER_GRP13=1, NUM_IRQS_PER_GRP14=1, NUM_IRQS_PER_GRP15=1
ABDAC at 0xffff4000
  pins: DATA0 PA03/D or PA22/D or PB06/D; DATAN0 PA04/D or PA28/D or PB07/D; DATA1 PA05/D or PA26/D or PB08/D; DATAN1 PA06/D or PA27/D or PB09/D
ADC at 0xffff3c00
  pins: AD0 PA03/A; AD1 PA04/A; AD6 PA30/A; AD7 PA31/A; AD2 PA05/B; AD3 PA06/B; AD4 PA07/B; AD5 PA08/B; TRIGGER0 PA22/C
  parameters: ADC_CHANNELS_MSB=7, ADC_DATA_MSB=9, PADDR_MSB=10, PDATA_MSB=32
EIC at 0xffff0d80
  pins: EXTINT0 PA05/A; EXTINT1 PA06/A; EXTINT8 PA13/A; EXTINT6 PB02/A; EXTINT7 PB03/A; SCAN0 PA30/B; SCAN1 PA31/B; SCAN2 PB00/B; SCAN3 PB01/B; EXTINT2 PA14/C; EXTINT3 PA23/C; EXTINT4 PA24/C; EXTINT5 PA25/C; SCAN4 PB06/C; SCAN5 PB07/C; SCAN6 PB08/C; SCAN7 PB09/C
  parameters: INT_MSB=8, SCAN_MSB=7, STD_NUM=8
FLASHC at 0xfffe1400
  pins: EXTCLK0 PA03; LATDELMATCH0 PA04; LATDEL0 PA07; LATDELCLK0 PA08; FLASH_OBS0 PA03; FLASH_OBS1 PA04; FLASH_OBS2 PA05; FLASH_OBS3 PA06; FLASH_OBS{n} PA{n+5:02} (n=4..12); FLASH_OBS{n} PA{n+7} (n=13..20)
  parameters: FLASH_SIZE=524288, PAGES_PR_REGION=64, PAGE_SIZE=512, USER_PAGE=((volatile unsigned char*) AVR32_FLASHC_USER_PAGE_ADDRESS), USER_PAGE_ADDRESS=0x80800000, USER_PAGE_SIZE=512, FWS_0_MAX_FREQ=33000000, FWS_1_MAX_FREQ=60000000
FREQM at 0xffff0d50
  parameters: FREQM_REFSEL_BITS=1
GPIO at 0xffff1000
  pins: P{n} PA{n:02} (n=3..31); P{n} PB{n-32:02} (n=32..43)
  parameters: GPIO_IRQ_MSB=5, GPIO_MAX_IRQ_MSB=5, GPIO_PADDR_BITS=9, GPIO_PINS_MSB=44, IRQS_PER_GROUP=8, NUMBER_OF_PINS=45, PADDR_MSB=8, PDATA_MSB=31, PORT_LENGTH=2
HMATRIX at 0xfffe1000
  parameters: MASTER_CPU_DATA=0, MASTER_CPU_INSTRUCTION=1, MASTER_CPU_SAB=2, MASTER_PDCA=3, MASTER_MACB_DMA=4, MASTER_USBB_DMA=5, SLAVE_FLASH=0, SLAVE_PBA=1, SLAVE_PBB=2, SLAVE_SRAM=3, SLAVE_USBB_DPRAM=4, SLAVE_EBI=5, MASTER_NUM=5, SLAVE_NUM=5
JTAG
PDCA at 0xffff0000
  parameters: CHANNEL_LENGTH=0x7, HADDR_MSB=31, HDATA_MSB=31, PADDR_MSB=31, PDATA_MSB=31, PDCA_CHANNELS_MSB=6, PID_ADC_RX=0, PID_MCI_RX=-1, PID_SPI_RX=6, PID_SPI_TX=12, PID_SPI0_RX=-1, PID_SPI0_TX=-1, PID_SPI1_RX=-1, PID_SPI1_TX=-1, PID_SPI2_RX=-1, PID_SPI2_TX=-1, PID_SPI3_RX=-1, PID_SPI3_TX=-1, PID_SSC_RX=1, PID_SSC_TX=7, PID_SSC0_RX=-1, PID_SSC0_TX=-1, PID_SSC1_RX=-1, PID_SSC1_TX=-1, PID_SSC2_RX=-1, PID_SSC2_TX=-1, PID_TSADCC_RX=-1, PID_TWI_RX=5, PID_TWI_TX=11, PID_TWI0_RX=-1, PID_TWI0_TX=-1, PID_TWI1_RX=-1, PID_TWI1_TX=-1, PID_USART0_RX=2, PID_USART0_TX=8, PID_USART1_RX=3, PID_USART1_TX=9, PID_USART2_RX=4, PID_USART2_TX=10, PID_USART3_RX=-1, PID_USART3_TX=-1, PID_USART4_RX=-1, PID_USART4_TX=-1, PID_USART5_RX=-1, PID_USART5_TX=-1
PLL0
  pins: PLLCLK0 PA09; LOCK0 PA10; DN0 PA13; UP0 PA14; FDIV0 PA15
PLL1
  pins: PLLCLK0 PA03; LOCK0 PA04; DN0 PA05; UP0 PA06; FDIV0 PA07
PM at 0xffff0c00
  pins: GCLK0 PA03/B; GCLK1 PA04/B; GCLK2 PA30/C or PA14/D; RSTM_N0 PA27; XIN00 PA18; XIN10 PA28; XIN320 PA11; XOUT00 PA19; XOUT10 PA29; XOUT320 PA12
  parameters: GCLK_ABDAC=4, GCLK_MSB=3, GCLK_NUM=5, GCLK_USBB=3, GPLP_NUM=2, RCOSC_CALIBRATION_BITS=10, RCOSC_FREQUENCY=115200, PLL_VCO_RANGE0_MIN_FREQ=160000000, PLL_VCO_RANGE0_MAX_FREQ=240000000, PLL_VCO_RANGE1_MIN_FREQ=80000000, PLL_VCO_RANGE1_MAX_FREQ=180000000, CPU_MAX_FREQ=60000000, HSB_MAX_FREQ=60000000, PBA_MAX_FREQ=60000000, PBB_MAX_FREQ=60000000
  clocks: CPU OCD bit 1, SYSTIMER bit 16; HSB FLASHC bit 0, PBA bit 1, PBB bit 2, USBB bit 3, PDCA bit 4; PBA INTC bit 0, GPIO bit 1, PDCA bit 2, PM bit 3, RTC bit 3, EIC bit 3, ADC bit 4, SPI bit 5, TWI bit 6, USART0 bit 7, USART1 bit 8, USART2 bit 9, PWM bit 10, SSC bit 11, TC bit 12, ABDAC bit 13; PBB HMATRIX bit 0, USBB bit 1, FLASHC bit 2
PULLUP
  pins: LPC_PULLUP0 PA28 or PA29 or PA30 or PA31 or PB00 or PB01 or PB02 or PB03 or PB04 or PB05 or PB06 or PB07 or PB08 or PB09 or PB10 or PB11
PWM at 0xffff3000
  pins: PWM0 PA07/A or PA11/C or PA23/D; PWM1 PA08/A or PA12/C or PA24/D; PWM2 PA21/A or PA13/B; PWM6 PA22/A or PA19/B or PA31/C; PWM3 PA14/B or PA25/B; PWM4 PA15/B or PA28/B or PA16/C; PWM5 PA18/B or PB05/C
  parameters: CHANNEL_LENGTH=0x7, PADDR_MSB=13, PDATA_MSB=31, PWM_LINES_MSB=6
RTC at 0xffff0d00
SPI at 0xffff2400
  pins: MOSI0 PA14/A or PA19/C or PA29/C; SCK0 PA15/A or PA17/C; NPCS0 PA16/A or PA24/B; NPCS1 PA17/A or PA23/B; MISO0 PA25/A or PA18/C or PA28/C; NPCS2 PA09/B or PB05/B; NPCS3 PA10/B or PB04/B
  parameters: SPI_CS_MSB=3
SSC at 0xffff3400
  pins: RX_CLOCK0 PB06/A or PA08/D or PA13/D; RX_DATA0 PB07/A or PA11/D; RX_FRAME_SYNC0 PB08/A or PA07/D or PA18/D; TX_CLOCK0 PB09/A or PA19/D; TX_DATA0 PB10/A or PA20/D; TX_FRAME_SYNC0 PB11/A or PA21/D
TC at 0xffff3800
  pins: CLK00 PA29/A or PA20/B; A00 PB00/A or PA26/C; B00 PB01/A or PA27/C; A20 PA11/B or PB10/B; B20 PA12/B or PB11/B; CLK10 PA16/B or PA29/B; CLK20 PA17/B or PB04/C; A10 PA21/B or PB02/B; B10 PA22/B or PB03/B
TWI at 0xffff2c00
  pins: SCL0 PA09/A or PA09; SDA0 PA10/A or PA10
  parameters: APB_TWI_PADDR_MSB=32, PDATA_SIZE=32
USART0 at 0xffff1400 (USART)
  pins: RTS0 PA11/A; CTS0 PA12/A; RXD0 PA18/A or PB10/C; TXD0 PA19/A or PB11/C; CLK0 PA28/A or PA13/C
  parameters: PADDR_MSB=12, PDATA_MSB=31
USART1 at 0xffff1800 (USART)
  pins: CLK0 PA20/A; TXD0 PA23/A or PB02/C or PA12/D; RXD0 PA24/A or PB03/C or PA17/D; CTS0 PB04/A or PA09/C; RTS0 PB05/A or PA10/C; DCD0 PB06/B or PA05/C; DSR0 PB07/B or PA06/C; DTR0 PB08/B or PA07/C; RI0 PB09/B or PA08/C
  parameters: PADDR_MSB=12, PDATA_MSB=31
USART2 at 0xffff1c00 (USART)
  pins: TXD0 PA26/B or PA21/C; RXD0 PA27/B or PA20/C; CLK0 PA15/C; CTS0 PB00/C; RTS0 PB01/C
  parameters: PADDR_MSB=12, PDATA_MSB=31
USBB at 0xfffe0000, USBB_SLAVE 0x0000 in slave
  pins: USB_ID0 PA26/A or PA03/C; USB_VBOF0 PA27/A or PA04/C
  parameters: EPT_NBR=7
WDT at 0xffff0d30
  parameters: WDTEXTRST_MSB=1
FUSES at 0xFFFE1400 in fuses (FLASH_FUSES)

## Interrupts
0 CORE_COMPARE_IRQ (CORE)
NMI EIC_IRQ_8 (EIC)
{n+32} EIC_IRQ_{n} (EIC) (n=0..7)
40 RTC_IRQ (RTC)
41 PM_IRQ (PM)
42 FREQM_IRQ (FREQM)
64 GPIO_IRQ_0 (GPIO)
65 GPIO_IRQ_1 (GPIO)
66 GPIO_IRQ_2 (GPIO)
67 GPIO_IRQ_3 (GPIO)
68 GPIO_IRQ_4 (GPIO)
69 GPIO_IRQ_5 (GPIO)
96 PDCA_IRQ_0 (PDCA)
97 PDCA_IRQ_1 (PDCA)
98 PDCA_IRQ_2 (PDCA)
99 PDCA_IRQ_3 (PDCA)
100 PDCA_IRQ_4 (PDCA)
101 PDCA_IRQ_5 (PDCA)
102 PDCA_IRQ_6 (PDCA)
128 HFLASHC_IRQ (HFLASHC)
160 USART0_IRQ (USART0)
192 USART1_IRQ (USART1)
224 USART2_IRQ (USART2)
288 SPI0_IRQ (SPI)
352 TWI_IRQ (TWI)
384 PWM_IRQ (PWM)
416 SSC_IRQ (SSC)
448 TC_IRQ0 (TC)
449 TC_IRQ1 (TC)
450 TC_IRQ2 (TC)
480 ADC_IRQ (ADC)
544 USBB_IRQ (USBB)
576 ABDAC_IRQ (ABDAC)

## Properties
AVR32_RESET: NumberOfResetDomains=5, ResetGroup=2
SIGNATURES: JTAGID=0x205003f
