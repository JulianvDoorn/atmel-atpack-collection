# ATUC256L3U device description
Architecture: AVR32_UC3; Family: AVR UC3
Programming and debug interfaces: JTAG, aWire
Registers are 32-bit, read-write, reset 0x0 unless marked. A register's access mark holds for its fields unless they carry their own. Offsets are from the block's base; lines under a group give offsets from that group; [hi:lo] are bit positions; {n}, {i} and the like mark numbered series; 'fields as' and 'values as' point back to an identical list; <NAME> marks a mode.

## Ordering variants
standard: up to 50 MHz, 1.62 to 3.6 V

## Memory
sysreg space: start 0 size 1024, big endian
dbgreg space: start 0 size 1024
base space: start 0 size 0x100000000, big endian
  0x80000000 FLASH size 0x00040000 flash
  0x80800000 USER_PAGE size 0x00000200 user_page
  0x90000000 SAU_SLAVE size 0x00010000 other
  0x00000000 SRAM size 0x00008000 ram
  0xfffe0000 IO size 0x20000 io
fuses space: start 0xFFFE0018 size 4, big endian

## Peripheral instances (address, pins/pin function, parameters)
CORE at 0 in sysreg
  parameters: SCAN_CHAIN_MSB=9, SCAN_CLOCK_MSB=1, CONFIG0_RESETVALUE=0x3000D8B, CONFIG1_RESETVALUE=0x800000
OCD at 0 in dbgreg
INTC at 0xffff1000
  parameters: NUM_INT_GRPS=34, NUM_IRQS_PER_GRP0=1, NUM_IRQS_PER_GRP1=2, NUM_IRQS_PER_GRP2=1, NUM_IRQS_PER_GRP3=1, NUM_IRQS_PER_GRP4=4, NUM_IRQS_PER_GRP5=4, NUM_IRQS_PER_GRP6=4, NUM_IRQS_PER_GRP7=1, NUM_IRQS_PER_GRP8=1, NUM_IRQS_PER_GRP9=1, NUM_IRQS_PER_GRP10=4, NUM_IRQS_PER_GRP11=4, NUM_IRQS_PER_GRP12=1, NUM_IRQS_PER_GRP13=1, NUM_IRQS_PER_GRP14=8, NUM_IRQS_PER_GRP{n}=1 (n=15..24), NUM_IRQS_PER_GRP25=3, NUM_IRQS_PER_GRP26=3, NUM_IRQS_PER_GRP{n}=1 (n=27..33)
ABDACB at 0xffff7400
  pins: CLK0 PB15/A; DAC0 PB16/A; DAC1 PB17/A; DACN0 PB18/A; DACN1 PB19/A
ACIFB at 0xffff6400
  pins: ACAP0 PA01/F; ACBP0 PA02/F; ACBN3 PA03/F; ACBP1 PA04/F; ACBN0 PA05/F; ACAN0 PA07/F; ACAP1 PA10/F; ACAN1 PA12/F; ACREFN0 PA16/F; ACBN2 PA22/F; ACAP2 PB00/F; ACAN2 PB02/F; ACBP2 PB03/F; ACAN3 PB06/F; ACAP3 PB07/F; ACBN1 PB09/F; ACBP3 PB12/F
  parameters: AC_A_MSB=3, AC_B_MSB=3, AC_MSB=7
ADCIFB at 0xffff6000
  pins: PRND0 PA12/A; AD0 PA14/A; AD1 PA15/A; AD2 PA16/A; AD3 PA17/A; AD4 PA18/A; AD5 PA19/A; TRIGGER0 PA02/B or PA21/D or PB11/D or PB22/F; ADP0 PB00/B or PA08/D or PB26/F; ADP1 PB01/B or PA09/D or PB13/F or PB24/F or PB27/F; AD6 PB06/C; AD7 PB07/C; AD8 PB08/C
  parameters: ADCIFB_ADC_DATA_MSB=9, ADCIFB_NCH_LOG2_MSB=3, ADCIFB_NCH_MSB=9, PADDR_MSB=10, PDATA_MSB=32
AST at 0xffff1c00
  parameters: CLK1K=4, CLK32=1, GCLK_NUM=2, GENCLK=3, PB=2, RCOSC=0
AW at 0xffff7000
  parameters: PDCA_ID_RX=10, PDCA_ID_TX=21
CAT at 0xffff6800
  pins: SMP0 PA12/D or PA14/D or PA22/D or PA13/F or PA17/F or PB23/F or PA21/H; SYNC0 PB12/D or PA15/F or PA18/F or PB08/F or PA19/G; VDIVEN0 PB11/F; DIS0 PA17/G; CSA2 PA00/H or PB24/H; CSA1 PA01/H; CSA3 PA02/H or PB25/H; CSB3 PA03/H or PB26/H; CSA7 PA04/H; CSB7 PA05/H; CSB1 PA06/H; CSB2 PA07/H or PB13/H; CSA4 PA08/H or PB23/H; CSB4 PA09/H or PB15/H; CSA5 PA10/H or PB16/H; CSB5 PA12/H or PB17/H; CSA0 PA13/H or PB18/H; CSA6 PA14/H; CSB6 PA15/H; CSA8 PA16/H or PB22/H; CSB8 PA17/H; CSB0 PA18/H; CSA10 PA19/H; CSA12 PA20/H or PB19/H; CSB10 PA22/H; CSA9 PB00/H or PB27/H; CSB9 PB01/H or PB14/H; CSB11 PB02/H; CSA11 PB03/H; CSA14 PB04/H or PB20/H; CSB14 PB05/H or PB21/H; CSB13 PB06/H; CSA13 PB07/H; CSB12 PB08/H; CSB15 PB09/H; CSB16 PB10/H; CSA16 PB11/H; CSA15 PB12/H
  parameters: CAT_SENSORS_MSB=16, GCLK_NUM=4, PDCA_ID_RX_ACOUNT=11, PDCA_ID_RX_DMATSR=29, PDCA_ID_TX=22, REG_RX_ACOUNT=ACOUNT, REG_RX_DMATSR=DMATSR, REG_TX=DMATSW
EIC at 0xffff2400
  pins: EXTINT2 PA06/F or PA13/G or PB08/G; EXTINT0 PA07/G or PB06/G or PB27/G; EXTINT1 PA09/G or PB07/G or PB19/G; EXTINT3 PA15/G or PB09/G; EXTINT4 PA16/G or PB10/G; EXTINT5 PA18/G or PB11/G
  parameters: INT_MSB=5, SCAN_MSB=0, STD_NUM=5
FLASHCDW at 0xfffe0000
  parameters: CALFUSE_NB=64, FACTORY_WORD_IMPLEMENTED_MASK=0xC000000000001FFF, FLASH_SIZE=262144, LOCKFUSE_NB=48, PAGE_SIZE=512, PAGES_PR_REGION=32, USER_PAGE=((volatile unsigned char*) AVR32_FLASHCDW_USER_PAGE_ADDRESS), USER_PAGE_ADDRESS=0x80800000, USER_PAGE_SIZE=512, USER_WORD_IMPLEMENTED_MASK=0xC0000001FFFFFFFF, FWS_0_MAX_FREQ=15000000, FWS_1_MAX_FREQ=30000000, IC9692=true
FREQM at 0xffff2800
  parameters: CPU=0, CRIPEL=0, DFLL0=7, FLO=8, GENCLKDIV{n}=0 (n=0..10), GENCLK{n}={n+9} (n=0..9), GENCLK10=0, HSB=1, NUM_CLK=24, NUM_REF_CLK=3, OSC0=4, OSC1=0, OSC2=0, OSC3=0, OSC4=0, OSC32=5, PBA=2, PBB=3, PBC=0, PLL0=22, PLL1=0, PLL2=0, PLL3=0, RCOSC=6, RCOSC8=0, RC32K=21, RC120M=20, RC120M_AW=19, REFSEL_BITS=2, REF_GENCLK{n}=0 (n=0..6), REF_GENCLK9=2, REF_OSC0=0, REF_OSC1=0, REF_OSC2=0, REF_OSC32=1, REF_RCOSC=0, REF_RCOSC8=0
GLOC at 0xffff6c00
  pins: OUT0 PA13/A; IN7 PA13/B; IN6 PA15/D; IN5 PA16/D; IN4 PA18/D; IN3 PA20/D; IN2 PB06/D; IN1 PB07/D; IN0 PB08/D; OUT1 PB10/D
  parameters: GCLK_NUM=5, INPUT_PINS_MSB=7, LUTS=2, OUTPUT_PINS_MSB=1
GPIO at 0xffff2c00
  pins: P{n} PA{n:02} (n=0..22); P{n} PB{n-32:02} (n=32..59)
  parameters: GPIO_IRQ_MSB=7, GPIO_MAX_IRQ_MSB=7, GPIO_PADDR_BITS=10, GPIO_PINS_MSB=59, IRQS_PER_GROUP=8, NUMBER_OF_PINS=60, PADDR_MSB=9, PDATA_MSB=31, PORT_LENGTH=64
HMATRIXB at 0xfffe0400
  parameters: MASTER_NUM=6, MASTER_CPU_DATA=0, MASTER_CPU_INSN=1, MASTER_CPU_SAB=2, MASTER_SAU=3, MASTER_PDCA=4, MASTER_USBC=5, SLAVE_NUM=5, SLAVE_FLASH=0, SLAVE_PBA=1, SLAVE_PBB=2, SLAVE_SRAM=3, SLAVE_SAU=4
IISC at 0xffff7800
  pins: IMCK0 PB15/B; ISCK0 PB16/B; IWS0 PB17/B; ISDI0 PB18/B; ISDO0 PB19/B
  parameters: GCLK_NUM=6, PDCA_ID_RX=25, PDCA_ID_RX_1=26, PDCA_ID_TX=27, PDCA_ID_TX_1=28, REG_RX_1=RHR, REG_TX_1=THR
JTAG
PDCA at 0xffff0000
  parameters: CHANNEL_LENGTH=16, CLK_AHB_ID=-1, HADDR_MSB=31, HDATA_MSB=31, MON_CH0_IMPL=0, MON_CH1_IMPL=0, PADDR_MSB=31, PDATA_MSB=31, PDCA_CHANNELS_MSB=15, PID_ABDACBCH0_TX=23, PID_ABDACBCH1_TX=24, PID_AC97C_RXA=-1, PID_AC97C_RXB=-1, PID_AC97C_TXA=-1, PID_AC97C_TXB=-1, PID_ADC_RX=9, PID_AW_RX=10, PID_AW_TX=21, PID_CAT_ACOUNT=11, PID_CAT_MBLEN=22, PID_IISCCH0_RX=25, PID_IISCCH0_TX=27, PID_IISCCH1_RX=26, PID_IISCCH1_TX=28, PID_MCI_RX=-1, PID_SPI0_RX=4, PID_SPI0_TX=16, PID_SPI1_RX=-1, PID_SPI1_TX=-1, PID_SPI2_RX=-1, PID_SPI2_TX=-1, PID_SPI3_RX=-1, PID_SPI3_TX=-1, PID_SSC_RX=1, PID_SSC_TX=-1, PID_SSC0_RX=-1, PID_SSC0_TX=-1, PID_SSC1_RX=-1, PID_SSC1_TX=-1, PID_SSC2_RX=-1, PID_SSC2_TX=-1, PID_TSADCC_RX=-1, PID_TWIM0_RX=5, PID_TWIM0_TX=17, PID_TWIM1_RX=6, PID_TWIM1_TX=18, PID_TWIS0_RX=7, PID_TWIS0_TX=19, PID_TWIS1_RX=8, PID_TWIS1_TX=20, PID_TWI_RX=-1, PID_TWI_TX=-1, PID_TWI0_RX=-1, PID_TWI0_TX=-1, PID_TWI1_RX=-1, PID_TWI1_TX=-1, PID_USART0_RX=0, PID_USART0_TX=12, PID_USART1_RX=1, PID_USART1_TX=13, PID_USART2_RX=2, PID_USART2_TX=14, PID_USART3_RX=3, PID_USART3_TX=15, PID_USART4_RX=-1, PID_USART4_TX=-1, PID_USART5_RX=-1, PID_USART5_TX=-1
PM at 0xffff1400
  parameters: AWEN_TWIS0=3, AWEN_TWIS1=4, AWEN_USBC=7, PM_CLK_AHB_PEVC=0, PM_CLK_APB_NUM=2, WAKEUP_EN_KEYPAD=0, WAKEUP_EN_USB_DEVICE=0
  clocks: CPU OCD bit 0, CPU_COUNT bit 16; HSB PDCA bit 0, FLASHCDW bit 1, SAU bit 2, PBB bit 3, PBA bit 4, PES bit 5, USBC bit 6; PBA PDCA bit 0, INTC bit 1, PM bit 2, SCIF bit 3, AST bit 4, WDT bit 5, EIC bit 6, FREQM bit 7, GPIO bit 8, USART0 bit 9, USART1 bit 10, USART2 bit 11, USART3 bit 12, SPI bit 13, TWIM0 bit 14, TWIM1 bit 15, TWIS0 bit 16, TWIS1 bit 17, PWMA bit 18, TC0 bit 19, TC1 bit 20, ADCIFB bit 21, ACIFB bit 22, CAT bit 23, GLOC bit 24, AW bit 25, ABDACB bit 26, IISC bit 27; PBB FLASHCDW bit 0, HMATRIX bit 1, SAU bit 2, USBC bit 3
PULLUP
PWMA at 0xffff5400
  pins: PWMA0 PA00/E or PB23/E; PWMA1 PA01/E or PB24/E; PWMA2 PA02/E or PB25/E; PWMA3 PA03/E or PB26/E; PWMA4 PA04/E or PB27/E; PWMA5 PA05/E; PWMA6 PA06/E; PWMA7 PA07/E or PB13/E; PWMA8 PA08/E or PB15/E; PWMA9 PA09/E or PB16/E; PWMA10 PA10/E or PB17/E; PWMA11 PA11/E; PWMA12 PA12/E or PB18/E; PWMA13 PA13/E; PWMA14 PA14/E; PWMA15 PA15/E; PWMA16 PA16/E; PWMA17 PA17/E; PWMA18 PA18/E; PWMA19 PA19/E; PWMA20 PA20/E or PB19/E; PWMA21 PA21/E or PB20/E; PWMA22 PA22/E; PWMA23 PB00/E; PWMA24 PB01/E or PB14/E; PWMA25 PB02/E; PWMA26 PB03/E; PWMA27 PB04/E or PB22/E; PWMA28 PB05/E or PB21/E; PWMA29 PB06/E; PWMA30 PB07/E; PWMA31 PB08/E; PWMA32 PB09/E; PWMA33 PB10/E; PWMA34 PB11/E; PWMA35 PB12/E; PWMAOD21 PA21/F; PWMAOD27 PB04/F; PWMAOD28 PB05/F
  parameters: PWMA_CHANNELS_MSB=35, PWMA_CH_SYNC_EVT=0, PWMA_NUM_CHANNELS=36, PWMA_NUM_IRQS=0
SAU at 0xfffe0800, SAU_HSB 0x90000000 in hsb
  parameters: CHANNELS=16, CLK_AHB_ID=-1
SCAN
  parameters: SCAN_BURN_IN_IMPLEMENTED=0, SCAN_CHAIN_MSB=14, SCAN_CLK_MSB=1, SCAN_COMPRESSION_IMPLEMENTED=1, SCAN_OCC_IMPLEMENTED=0
SCIF at 0xffff1800
  pins: GCLK2 PA13/D or PA09/F or PA10/G or PB16/G; GCLK_IN0 PA19/F; RC32OUT0 PA20/F; GCLK_IN1 PB10/F; GCLK_IN2 PB25/F; GCLK0 PA00/G or PA21/G or PB22/G; GCLK1 PA06/G or PB02/G; GCLK3 PA12/G or PB05/G or PB15/G; GCLK4 PA14/G or PB12/G; GCLK5 PB13/G or PB14/G; LVTM_D_IN0 PB17/G; LVTM_CLOCK_IN0 PB18/G; GCLK6 PB23/G; GCLK7 PB24/G; GCLK8 PB25/G; GCLK9 PB26/G
  parameters: BR_NUM=4, GCLK_NUM=10, GCLK_DFLLIF_REF=0, GCLK_DFLLIF_DITHER=1, GCLK_AST=2, GCLK_PWMA=3, GCLK_ACIFB=4, GCLK_CAT=4, GCLK_GLOC=5, GCLK_ABDACB=6, GCLK_IISC=6, GCLK_USBC=7, GCLK_PLL0=8, GCLK_MASTER=9, GCCTRL_OSCSEL_RCSYS=0, GCCTRL_OSCSEL_OSC32K=1, GCCTRL_OSCSEL_DFLL0=2, GCCTRL_OSCSEL_OSC0=3, GCCTRL_OSCSEL_RC120M=4, GCCTRL_OSCSEL_CLK_CPU=5, GCCTRL_OSCSEL_CLK_HSB=6, GCCTRL_OSCSEL_CLK_PBA=7, GCCTRL_OSCSEL_CLK_PBB=8, GCCTRL_OSCSEL_RC32K=9, GCCTRL_OSCSEL_CLK_1K=11, GCCTRL_OSCSEL_PLL0=12, GCCTRL_OSCSEL_GCLK_IN0=15, GCCTRL_OSCSEL_GCLK_IN1=16, GCCTRL_OSCSEL_GCLK_IN2=17, GCCTRL_OSCSEL_GCLK9=18, OSC_NUM=1, PLL_NUM=1, RCOSC_FREQUENCY=115200
SPI at 0xffff4000
  pins: MISO0 PA04/A or PB23/A or PB02/C; MOSI0 PA05/A or PB24/A or PB03/C; SCK0 PA06/A or PB26/A or PB01/C or PB15/C; NPCS0 PA07/A or PB25/A or PB00/C; NPCS1 PA03/B or PB20/C; NPCS2 PA08/B or PA00/C or PB21/C; NPCS3 PA09/B or PA01/C or PB22/C
  parameters: CS_MSB=3, PDCA_ID_RX=4, PDCA_ID_TX=16
TC0 at 0xffff5800 (TC)
  pins: CLK20 PA14/B or PB15/D; CLK10 PA15/B or PA12/C or PB27/D; CLK00 PA16/B or PB22/D; A10 PA17/B or PA20/C or PA05/D or PB00/D or PB25/D; B10 PA18/B or PA21/C or PA04/D or PB01/D or PB26/D; A20 PA08/C or PA19/C or PB02/D or PB23/D; B20 PA09/C or PA22/C or PB03/D or PB24/D; A00 PA10/C or PA13/C or PA02/D or PB20/D; B00 PA03/D or PA06/D or PB21/D
  parameters: CLK_DIV1=clk_32, CLK_DIV2=2, CLK_DIV3=8, CLK_DIV4=32, CLK_DIV5=128, PEVC=0
TC1 at 0xffff5c00 (TC)
  pins: A00 PB04/A or PB00/G; B00 PB05/A; A10 PB06/A or PB13/D or PB01/G; B10 PB07/A or PB14/D; A20 PB08/A or PB03/G; B20 PB09/A; CLK00 PB10/A; CLK10 PB11/A; CLK20 PB12/A
  parameters: CLK_DIV1=clk_32, CLK_DIV2=2, CLK_DIV3=8, CLK_DIV4=32, CLK_DIV5=128, PEVC=0
TWIM0 at 0xffff4400 (TWIM)
  parameters: PDCA_ID_RX=5, PDCA_ID_TX=17
TWIM1 at 0xffff4800 (TWIM)
  parameters: PDCA_ID_RX=6, PDCA_ID_TX=18
TWIMS0
  pins: TWD0 PA10/A or PA21/B or PA05/G; TWCK0 PA04/B or PA20/B or PA07/D or PB05/D; TWALM0 PB04/D or PA01/G
TWIMS1
  pins: TWD0 PB20/A or PA17/D; TWCK0 PB21/A or PA05/B or PB04/G; TWALM0 PB22/A or PA07/C or PB12/C or PA19/D
TWIS0 at 0xffff4c00 (TWIS)
  parameters: PDCA_ID_RX=7, PDCA_ID_TX=19
TWIS1 at 0xffff5000 (TWIS)
  parameters: PDCA_ID_RX=8, PDCA_ID_TX=20
USART0 at 0xffff3000 (USART)
  pins: TXD0 PA00/A or PB16/C; RXD0 PA01/A or PB17/C; RTS0 PA02/A or PB18/C; CTS0 PA03/A or PA22/A or PB19/C; CLK0 PA02/G or PA03/G
  parameters: CLK_DIV=8, PADDR_MSB=12, PDATA_MSB=31, PDCA_ID_RX=0, PDCA_ID_TX=12
USART1 at 0xffff3400 (USART)
  pins: TXD0 PA08/A or PB10/B or PB26/B or PA05/C; RXD0 PA09/A or PB11/B or PB25/B or PB27/B or PA04/C; RTS0 PA00/B or PB04/B or PB20/F; CTS0 PA01/B or PB05/B or PB21/F; CLK0 PA06/C or PB04/C or PB05/C or PA01/D or PB20/G or PB21/G
  parameters: CLK_DIV=8, PADDR_MSB=12, PDATA_MSB=31, PDCA_ID_RX=1, PDCA_ID_TX=13
USART2 at 0xffff3800 (USART)
  pins: TXD0 PA20/A or PA06/B or PB21/B or PA02/C or PA03/C; RXD0 PA21/A or PA07/B or PB20/B; CLK0 PA12/B or PA22/B or PB23/C or PB24/C; RTS0 PB23/B or PA14/C; CTS0 PB24/B or PA17/C
  parameters: CLK_DIV=8, PADDR_MSB=12, PDATA_MSB=31, PDCA_ID_RX=2, PDCA_ID_TX=14
USART3 at 0xffff3c00 (USART)
  pins: TXD0 PB00/A or PB06/B or PB13/B; RXD0 PB01/A or PB07/B or PB14/B; RTS0 PB02/A or PB08/B; CTS0 PB03/A or PB09/B; CLK0 PB02/B or PB03/B or PB09/C or PB10/C
  parameters: CLK_DIV=8, PADDR_MSB=12, PDATA_MSB=31, PDCA_ID_RX=3, PDCA_ID_TX=15
USBC at 0xfffe1000
  pins: DM0 PB13/A; DP0 PB14/A
  parameters: EPT_NBR=7, GCLK_NUM=7
WDT at 0xffff2000
GPIO_LOCAL at 0x40000000
FUSES at 0xFFFE0000 in fuses (FLASH_FUSES), USERPAGE_FUSES 0x80800000

## Interrupts
0 CORE_COMPARE_IRQ (CORE)
NMI EIC_IRQ_0 (EIC)
32 CORE_OCD_DCEMU_DIRTY_IRQ (CORE)
33 CORE_OCD_DCCPU_READ_IRQ (CORE)
64 FLASHCDW_IRQ (FLASHCDW)
96 SAU_IRQ (SAU)
128 PDCA_IRQ_0 (PDCA)
129 PDCA_IRQ_1 (PDCA)
130 PDCA_IRQ_2 (PDCA)
131 PDCA_IRQ_3 (PDCA)
160 PDCA_IRQ_4 (PDCA)
161 PDCA_IRQ_5 (PDCA)
162 PDCA_IRQ_6 (PDCA)
163 PDCA_IRQ_7 (PDCA)
192 PDCA_IRQ_8 (PDCA)
193 PDCA_IRQ_9 (PDCA)
194 PDCA_IRQ_10 (PDCA)
195 PDCA_IRQ_11 (PDCA)
224 PM_IRQ (PM)
256 SCIF_IRQ (SCIF)
288 AST_ALARM_IRQ (AST)
320 AST_PER_IRQ (AST)
321 AST_OVF_IRQ (AST)
322 AST_READY_IRQ (AST)
323 AST_CLKREADY_IRQ (AST)
352 EIC_IRQ_1 (EIC)
353 EIC_IRQ_2 (EIC)
354 EIC_IRQ_3 (EIC)
355 EIC_IRQ_4 (EIC)
384 EIC_IRQ_5 (EIC)
416 FREQM_IRQ (FREQM)
{n+448} GPIO_IRQ_{n} (GPIO) (n=0..7)
480 USART0_IRQ (USART0)
512 USART1_IRQ (USART1)
544 USART2_IRQ (USART2)
576 USART3_IRQ (USART3)
608 SPI_IRQ (SPI)
640 TWIM0_IRQ (TWIM0)
672 TWIM1_IRQ (TWIM1)
704 TWIS0_IRQ (TWIS0)
736 TWIS1_IRQ (TWIS1)
768 PWMA_IRQ (PWMA)
800 TC0_IRQ0 (TC0)
801 TC0_IRQ1 (TC0)
802 TC0_IRQ2 (TC0)
832 TC1_IRQ0 (TC1)
833 TC1_IRQ1 (TC1)
834 TC1_IRQ2 (TC1)
864 ADCIFB_IRQ (ADCIFB)
896 ACIFB_IRQ (ACIFB)
928 CAT_IRQ (CAT)
960 AW_IRQ (AW)
992 ABDACB_IRQ (ABDACB)
1024 USBC_IRQ (USBC)
1056 IISC_IRQ (IISC)

## Properties
AVR32_RESET: NumberOfResetDomains=1, ResetGroup=4
SIGNATURES: JTAGID=0x21C303F
