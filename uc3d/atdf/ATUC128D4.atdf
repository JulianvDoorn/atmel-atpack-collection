# ATUC128D4 device description
Architecture: AVR32_UC3; Family: AVR UC3
Programming and debug interfaces: JTAG, aWire
Registers are 32-bit, read-write, reset 0x0 unless marked. A register's access mark holds for its fields unless they carry their own. Offsets are from the block's base; lines under a group give offsets from that group; [hi:lo] are bit positions; {n}, {i} and the like mark numbered series; 'fields as' and 'values as' point back to an identical list; <NAME> marks a mode.

## Ordering variants
standard: up to 66 MHz, 3.0 to 3.6 V

## Memory
sysreg space: start 0 size 1024, big endian
dbgreg space: start 0 size 1024
base space: start 0 size 0x100000000, big endian
  0x00000000 SRAM size 0x00004000 ram
  0x80000000 FLASH size 0x00020000 flash
  0x80800000 USER_PAGE size 0x00000100 user_page
  0xFFFF0000 HTOP0 size 0x00007000 other
  0xFFFE0000 HTOP1 size 0x00002400 other
  0xfffe0000 IO size 0x20000 io, rw
fuses space: start 0xFFFE1418 size 4, big endian

## Peripheral instances (address, pins/pin function, parameters)
CORE at 0 in sysreg
  parameters: CLK_CPU_COUNT=16, SCAN_CHAIN_MSB=9, SCAN_CLOCK_MSB=1, CONFIG0_RESETVALUE=0x3000D8B, CONFIG1_RESETVALUE=0x800000
OCD at 0 in dbgreg
INTC at 0xFFFF1000
  parameters: NUM_INT_GRPS=22, NUM_IRQS_PER_GRP0=1, NUM_IRQS_PER_GRP1=10, NUM_IRQS_PER_GRP2=7, NUM_IRQS_PER_GRP3=7, NUM_IRQS_PER_GRP{n}=1 (n=4..13), NUM_IRQS_PER_GRP14=3, NUM_IRQS_PER_GRP15=3, NUM_IRQS_PER_GRP16=1, NUM_IRQS_PER_GRP17=2, NUM_IRQS_PER_GRP18=1, NUM_IRQS_PER_GRP19=4, NUM_IRQS_PER_GRP20=1, NUM_IRQS_PER_GRP21=1
ADCIFD at 0xffff5400
  pins: CLK PA09; ONAD PA10; ONSAR PA11; START PA12; MUXONMX PA13; MUXSEL0 PA14; MUXSEL1 PA15; MUXSEL2 PA16; EOC PA17; ADCOUT{n} PA{n+18} (n=0..9); EXTTRIG PA22/C
  parameters: CHANNELS=8, GCLK_NUM=8, NBCONVS=8, PDCA_ID_RX=8
AST at 0xffff1800
  parameters: CLK1K=-1, CLK32=1, GCLK_NUM=6, GENCLK=3, PB=2, RCOSC=0
AW at 0xffff6800
  pins: DATAOUT PB12
  parameters: PDCA_ID_RX=11, PDCA_ID_TX=21
CAT at 0xffff6000
  pins: SYNC PB13/A or PB18/B; CSB0 PA00/D; CSA1 PA01/D; CSB1 PA02/D; CSB{n} PA{2n-1:02}/D (n=2..12); CSA{n} PA{2n-2:02}/D (n=3..12); CSB15 PA24/D; CSA16 PA25/D; CSB16 PA26/D; CSA0 PA27/D; CSB21 PA28/D; CSA22 PA29/D; CSA18 PA30/D; CSB18 PA31/D; CSA17 PB00/D; CSB17 PB01/D; CSA19 PB02/D; CSB19 PB03/D; CSA20 PB04/D; CSB20 PB05/D; CSA21 PB06/D; CSB22 PB07/D; CSA23 PB08/D; CSB23 PB09/D; CSA24 PB10/D; CSB24 PB11/D; CSA2 PB13/D; CSA13 PB14/D; CSB13 PB15/D; CSA14 PB16/D; CSB14 PB17/D; CSA15 PB18/D
  parameters: CAT_SENSORS_MSB=24, GCLK_NUM=0, PDCA_ID_RX_ACOUNT=9, PDCA_ID_RX_DMATSR=10, PDCA_ID_TX=20, REG_RX_ACOUNT=ACOUNT, REG_RX_DMATSR=DMATSR, REG_TX=DMATSW
EIC at 0xffff2000
  pins: EXTINT8 PA05/A; EXTINT1 PA06/A; EXTINT0 PA13/A or PB08/B; EXTINT6 PB02/A or PA30/B; EXTINT7 PB03/A or PA31/B; EXTINT4 PB00/B or PA24/C; EXTINT5 PB01/B or PA25/C; EXTINT2 PB07/B or PA14/C; EXTINT3 PA23/C
  parameters: INT_MSB=8, SCAN_MSB=0, STD_NUM=8
FLASHCDW at 0xfffe1400
  pins: EXTCLK PA03; LATDEL PA07; LATDELCLK PA08; LATDELMATCH PB13; VMARGIN PA27; FLASH_OBS0 PA03; FLASH_OBS1 PA04; FLASH_OBS2 PA05; FLASH_OBS3 PA06; FLASH_OBS{n} PA{n+5:02} (n=4..12); FLASH_OBS{n} PA{n+7} (n=13..20); FLASH_OBS21 PB17; FLASH_OBS22 PB18
  parameters: CALFUSE_NB=40, CLK_AHB_ID=0, FACTORY_WORD_IMPLEMENTED_MASK=0xC000000000007FFF, FLASH_SIZE=131072, LOCKFUSE_NB=32, PAGE_SIZE=256, PAGES_PR_REGION=32, USER_PAGE=((volatile unsigned char*) AVR32_FLASHCDW_USER_PAGE_ADDRESS), USER_PAGE_ADDRESS=0x80800000, USER_PAGE_SIZE=256, USER_WORD_IMPLEMENTED_MASK=0x0000000100000003, FWS_0_MAX_FREQ=15000000, FWS_1_MAX_FREQ=30000000, HSEN_FWS_0_MAX_FREQ=25000000, HSEN_FWS_1_MAX_FREQ=50000000
FREQM at 0xffff5c00
  parameters: CPU=0, CRIPEL=9, DFLL0=0, FLO=0, GENCLKDIV{n}=0 (n=0..10), GENCLK{n}={n+10} (n=0..8), GENCLK9=0, GENCLK10=0, HSB=1, NUM_CLK=20, NUM_REF_CLK=0, OSC0=4, OSC1=0, OSC2=0, OSC3=0, OSC4=0, OSC32=5, PBA=2, PBB=3, PBC=0, PLL0=7, PLL1=8, PLL2=0, PLL3=0, RCOSC=6, RCOSC8=0, RC32K=0, RC120M=0, RC120M_AW=0, REFSEL_BITS=2, REF_GENCLK{n}=0 (n=0..6), REF_OSC0=2, REF_OSC1=0, REF_OSC2=0, REF_OSC32=1, REF_RCOSC=0, REF_RCOSC8=0
GLOC at 0xffff6400
  pins: IN0 PA00/C; IN1 PA01/C; IN2 PA02/C; IN5 PA03/C; IN6 PA04/C; OUT1 PA05/C; IN7 PA06/C; IN8 PA07/C; IN9 PA08/C; IN15 PB06/C; IN11 PB07/C; IN14 PB08/C; IN3 PB09/C; OUT0 PB12/C; IN4 PB13/C; OUT2 PB14/C; IN12 PB15/C; IN10 PB16/C; IN13 PB17/C; OUT3 PB18/C
  parameters: GCLK_NUM=0, LUTS=4
GPIO at 0xffff2800
  pins: P{n} PA{n:02} (n=0..27); P44 PB12; P45 PB13; P46 PB14; P47 PB15; P48 PB16; P49 PB17; P50 PB18
  parameters: GPIO_IRQ_MSB=6, GPIO_MAX_IRQ_MSB=31, GPIO_PADDR_BITS=10, GPIO_PINS_MSB=35, IRQS_PER_GROUP=8, NUMBER_OF_PINS=36, PADDR_MSB=9, PDATA_MSB=31, PORT_LENGTH=2
  clocks: CPU OCD bit 0, SYSTIMER bit 16; HSB FLASHCDW bit 0, PBA bit 1, PBB bit 2, USBC bit 3, PDCA bit 4; PBA PDCA bit 0, INTC bit 1, PM bit 2, AST bit 3, WDT bit 4, EIC bit 5, GPIO bit 6, USART0 bit 7, USART1 bit 8, USART2 bit 9, SPI bit 10, TWIM bit 11, TWIS bit 12, PWMA bit 13, IISC bit 14, TC bit 15, ADCIFD bit 16, SCIF bit 17, FREQM bit 18, CAT bit 19, GLOC bit 20, AW bit 21; PBB USBC bit 0, HMATRIX bit 1, FLASHCDW bit 2
GPIO_LOCAL at 0x40000000
HMATRIXB at 0xfffe1000
  parameters: MASTER_CPU_DATA=0, MASTER_CPU_INSN=1, MASTER_CPU_SAB=2, MASTER_PDCA=3, MASTER_USBC_DMA=4, SLAVE_FLASH=0, SLAVE_SRAM=1, SLAVE_PBA=2, SLAVE_PBB=3, MASTER_NUM=5, SLAVE_NUM=4
IISC at 0xffff4c00
  pins: IWS PA26/A or PB08/A or PB11/A; ISCK PA27/A or PB06/A or PB09/A; ISDI PB07/A or PB18/A; ISDO PB10/A or PB17/A; IMCK PB09/B or PB12/B
  parameters: GCLK_NUM=5, PDCA_ID_RX=6, PDCA_ID_RX_1=7, PDCA_ID_TX=18, PDCA_ID_TX_1=19, REG_RX_1=RHR, REG_TX_1=THR
JTAG
  pins: TDI PA00; TDO PA01; TMS PA02; TCK PB12
PDCA at 0xffff0000
  parameters: CHANNEL_LENGTH=7, CLK_AHB_ID=4, HADDR_MSB=31, HDATA_MSB=31, MON_CH0_IMPL=0, MON_CH1_IMPL=0, PADDR_MSB=31, PDATA_MSB=31, PDCA_CHANNELS_MSB=6, PID_ADCIFD_RX=8, PID_AW_RX=11, PID_AW_TX=21, PID_CAT_ACOUNT=9, PID_CAT_DMATSR=10, PID_CAT_DMATSW=20, PID_IISCC_LEFT_RX=6, PID_IISCC_LEFT_TX=18, PID_IISCC_RIGHT_RX=7, PID_IISCC_RIGHT_TX=19, PID_I2SC_LEFT_RX=6, PID_I2SC_LEFT_TX=18, PID_I2SC_RIGHT_RX=7, PID_I2SC_RIGHT_TX=19, PID_SPI_RX=3, PID_SPI_TX=15, PID_TWIM_RX=4, PID_TWIM_TX=16, PID_TWIS_RX=5, PID_TWIS_TX=17, PID_USART0_RX=0, PID_USART0_TX=12, PID_USART1_RX=1, PID_USART1_TX=13, PID_USART2_RX=2, PID_USART2_TX=14
PM at 0xffff1400
  pins: RSTM_N PB13
  parameters: MCCTRL_MCSEL_CRIPOSC=5, MCCTRL_MCSEL_OSC0=1, MCCTRL_MCSEL_PLL0=2, MCCTRL_MCSEL_PLL1=3, MCCTRL_MCSEL_RC120M=4, MCCTRL_MCSEL_SLOW=0, PM_CLK_AHB_PEVC=1, PM_CLK_APB_NUM=2, WAKEUP_EN_KEYPAD=4, WAKEUP_EN_USB_DEVICE=4
  clocks: CPU OCD bit 0, SYSTIMER bit 16; HSB FLASHCDW bit 0, PBA bit 1, PBB bit 2, USBC bit 3, PDCA bit 4; PBA PDCA bit 0, INTC bit 1, PM bit 2, AST bit 3, WDT bit 4, EIC bit 5, GPIO bit 6, USART0 bit 7, USART1 bit 8, USART2 bit 9, SPI bit 10, TWIM bit 11, TWIS bit 12, PWMA bit 13, IISC bit 14, TC bit 15, ADCIFD bit 16, SCIF bit 17, FREQM bit 18, CAT bit 19, GLOC bit 20, AW bit 21; PBB USBC bit 0, HMATRIX bit 1, FLASHCDW bit 2
PULLUP
  pins: LPC_PULLUP PA28 or PA29 or PA30 or PA31 or PB00 or PB01 or PB02 or PB03 or PB04 or PB05 or PB06 or PB07 or PB08 or PB09 or PB10 or PB11
PWMA at 0xffff4800
  pins: PWMA0 PA07/A or PA11/C; PWMA1 PA08/A or PA00/B or PA12/C; PWMA2 PA21/A or PA01/B or PA13/B; PWMA6 PA22/A or PA19/B or PA31/C; PWMA3 PA02/B or PA14/B or PA25/B; PWMA4 PA15/B or PA28/B or PA16/C; PWMA5 PA18/B or PB06/B or PB05/C
  parameters: GCLK_NUM=4, PWMA_CHANNELS_MSB=6, PWMA_CH_SYNC_EVT=0, PWMA_NUM_CHANNELS=7, PWMA_NUM_IRQS=7
SCAN
  pins: SCAN_IN{n} PA{n:02} (n=0..9); SCAN_OUT0 PA10; SCAN_OUT1 PA13; SCAN_OUT2 PA14; SCAN_OUT3 PA15; SCAN_OUT4 PA16; SCAN_OUT5 PA17; SCAN_IN10 PA20; SCAN_OUT6 PA21; SCAN_OUT7 PA22; SCAN_OUT8 PA25; SCAN_OUT9 PB17; SCAN_OUT10 PB18; SCAN_OUTPUT PA11 or PA12 or PA18 or PA19 or PA26 or PA27 or PA28 or PA29 or PA30 or PA31 or PB00 or PB01 or PB02 or PB03 or PB04 or PB05 or PB06 or PB07 or PB08 or PB09 or PB10 or PB11 or PB14 or PB15 or PB16; SCAN_ENABLE_FROM_PAD PA23; SCAN_CLOCKS0 PA24; SCAN_CLOCKS1 PB12
  parameters: SCAN_BURN_IN_IMPLEMENTED=0, SCAN_CHAIN_MSB=10, SCAN_CLK_MSB=1, SCAN_COMPRESSION_IMPLEMENTED=0, SCAN_OCC_IMPLEMENTED=0
SCIF at 0xffff5800
  pins: GCLK0 PA03/B; GCLK1 PA04/B; GCLK2 PB13/B or PA30/C; PLLCLK1 PA03; LOCK1 PA04; DN1 PA05; UP1 PA06; FDIV1 PA07; PLLCLK0 PA09; LOCK0 PA10; DN0 PA13; UP0 PA14; FDIV0 PA15; XIN0 PA18; XIN32 PA11; XOUT0 PA19; XOUT32 PA12
  parameters: GCLK_EXT_NUM=3, GCLK_NUM=9, GCLK_NUM_EXTCLK=2:0, GCLK_NUM_STILO=7, GCLK_GLOC=0, GCLK_USBC=3, GCLK_PWM=4, GCLK_IISC=5, GCLK_AST=6, GCLK_ADCIFD=7, GC_DIV_CLOCK=1, GCCTRL_OSCSEL_RCSYS=0, GCCTRL_OSCSEL_OSC32K=1, GCCTRL_OSCSEL_OSC0=2, GCCTRL_OSCSEL_PLL0=3, GCCTRL_OSCSEL_PLL1=4, GCCTRL_OSCSEL_CLK_CPU=5, GCCTRL_OSCSEL_CLK_HSB=6, GCCTRL_OSCSEL_CLK_PBA=7, GCCTRL_OSCSEL_CLK_PBB=8, GCCTRL_OSCSEL_RC120M=9, GPLP_NUM=2, OSC_NUM=1, PLL_MSB=1, PLL_NUM=2
SPI at 0xffff3c00
  pins: MISO PA00/A or PA25/A or PA18/C or PA28/C; MOSI PA01/A or PA14/A or PA19/C or PA29/C; SCK PA02/A or PA15/A or PA17/C; NPCS0 PA16/A or PB12/A or PA24/B; NPCS1 PA17/A or PA23/B; NPCS2 PA09/B or PB05/B; NPCS3 PA10/B or PB04/B
  parameters: CS_MSB=3, PDCA_ID_RX=3, PDCA_ID_TX=15
TC at 0xffff5000
  pins: CLK0 PA29/A or PA20/B; A0 PB00/A or PA26/C; B0 PB01/A or PA27/C; A2 PA11/B or PB10/B; B2 PA12/B or PB11/B; CLK1 PA16/B or PA29/B; CLK2 PA17/B or PB04/C; A1 PA21/B or PB02/B; B1 PA22/B or PB03/B
  parameters: APB_TIMER1_PADDR_MSB=2, CLK_DIV1=clk_32, CLK_DIV2=2, CLK_DIV3=8, CLK_DIV4=32, CLK_DIV5=128, PDATA_SIZE=2, PEVC=1
TWIM at 0xffff4000
  parameters: PDCA_ID_RX=4, PDCA_ID_TX=16
TWIMS
  pins: TWCK PA09/A; TWD PA10/A
TWIS at 0xffff4400
  parameters: PDCA_ID_RX=5, PDCA_ID_TX=17
USART0 at 0xffff3000 (USART)
  pins: RTS PA11/A or PB17/B; CTS PA12/A or PB16/B; RXD PA18/A or PB14/B or PB10/C; TXD PA19/A or PB15/B or PB11/C; CLK PA28/A or PA13/C
  parameters: CLK_DIV=8, PADDR_MSB=12, PDATA_MSB=31, PDCA_ID_RX=0, PDCA_ID_TX=12
USART1 at 0xffff3400 (USART)
  pins: CLK PA20/A; TXD PA23/A or PB02/C; RXD PA24/A or PB03/C; CTS PB04/A or PA09/C; RTS PB05/A or PA10/C
  parameters: CLK_DIV=8, PADDR_MSB=12, PDATA_MSB=31, PDCA_ID_RX=1, PDCA_ID_TX=13
USART2 at 0xffff3800 (USART)
  pins: TXD PA26/B or PA21/C; RXD PA27/B or PA20/C; CLK PA15/C; CTS PB00/C; RTS PB01/C
  parameters: CLK_DIV=8, PADDR_MSB=12, PDATA_MSB=31, PDCA_ID_RX=2, PDCA_ID_TX=14
USBC at 0xfffe0000
  pins: DP PB14/A; DM PB15/A; VBUS PB16/A
  parameters: CLK_AHB_ID=3, EPT_NBR=7, GCLK_NUM=3, HS_IMPLEMENTED=0, OTG_IMPLEMENTED=0, VBUS_MONITORING=0
WDT at 0xffff1c00
FUSES at 0xFFFE1400 in fuses (FLASH_FUSES), USERPAGE_FUSES 0x80800000

## Interrupts
NMI EIC_IRQ_0 (EIC)
0 CORE_COMPARE_IRQ (CORE)
{n+31} EIC_IRQ_{n} (EIC) (n=1..8)
40 AST_ALARM_IRQ (AST)
41 PM_IRQ (PM)
64 GPIO_IRQ_0 (GPIO)
65 GPIO_IRQ_1 (GPIO)
66 GPIO_IRQ_2 (GPIO)
67 GPIO_IRQ_3 (GPIO)
68 GPIO_IRQ_4 (GPIO)
69 GPIO_IRQ_5 (GPIO)
70 GPIO_IRQ_6 (GPIO)
96 PDCA_IRQ_0 (PDCA)
97 PDCA_IRQ_1 (PDCA)
98 PDCA_IRQ_2 (PDCA)
99 PDCA_IRQ_3 (PDCA)
100 PDCA_IRQ_4 (PDCA)
101 PDCA_IRQ_5 (PDCA)
102 PDCA_IRQ_6 (PDCA)
128 FLASHCDW_IRQ (FLASHCDW)
160 USART0_IRQ (USART0)
192 USART1_IRQ (USART1)
224 USART2_IRQ (USART2)
256 FREQM_IRQ (FREQM)
288 SPI_IRQ (SPI)
320 TWIM_IRQ (TWIM)
352 TWIS_IRQ (TWIS)
384 PWMA_IRQ (PWMA)
416 IISC_IRQ (IISC)
448 TC_IRQ0 (TC)
449 TC_IRQ1 (TC)
450 TC_IRQ2 (TC)
480 ADCIFD_SEQ_IRQ (ADCIFD)
481 ADCIFD_TIMING_IRQ (ADCIFD)
482 ADCIFD_WINDOW_IRQ (ADCIFD)
544 USBC_IRQ (USBC)
576 CORE_OCD_DCEMU_DIRTY_IRQ (CORE)
577 CORE_OCD_DCCPU_READ_IRQ (CORE)
608 SCIF_IRQ (SCIF)
640 AST_CLKREADY_IRQ (AST)
641 AST_OVF_IRQ (AST)
642 AST_PER_IRQ (AST)
643 AST_READY_IRQ (AST)
672 CAT_IRQ (CAT)
704 AW_IRQ (AW)

## Properties
AVR32_RESET: NumberOfResetDomains=1, ResetGroup=4
SIGNATURES: JTAGID=0x213003F
