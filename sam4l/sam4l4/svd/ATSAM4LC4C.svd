# ATSAM4LC4C register map
Vendor: Atmel Corporation; Series: SAM4L; File version: B
Atmel ATSAM4LC4C device: Cortex-M4 Microcontroller with 256KB Flash, 32KB SRAM, 100-pin package (refer to http://www.atmel.com/devices/SAM4LC4C.aspx for more)
CPU: CM4 r0p1, little endian, MPU, no FPU, 4 interrupt priority bits
Registers are 32-bit, write-only, reset 0x0 unless marked. A register's access mark holds for its fields unless they carry their own. Offsets are from the block's base; lines under a group give offsets from that group; [hi:lo] are bit positions; {n}, {i} and the like mark numbered series; 'fields as' and 'values as' point back to an identical list; <NAME> marks a mode.

## Memory map
0x40004000 IISC size 0x400 — Inter-IC Sound (I2S) Controller
0x40008000 SPI size 0x400 — Serial Peripheral Interface
0x40010000 TC0 size 0x400 — Timer/Counter 0
0x40014000 TC1 size 0x400 — Timer/Counter 1
0x40018000 TWIM0 size 0x400 — Two-wire Master Interface 0
0x40018400 TWIS0 size 0x400 — Two-wire Slave Interface 0
0x4001C000 TWIM1 size 0x400 — Two-wire Master Interface 1
0x4001C400 TWIS1 size 0x400 — Two-wire Slave Interface 1
0x40024000 USART0 size 0x400 — Universal Synchronous Asynchronous Receiver Transmitter 0
0x40028000 USART1 size 0x400 — Universal Synchronous Asynchronous Receiver Transmitter 1
0x4002C000 USART2 size 0x400 — Universal Synchronous Asynchronous Receiver Transmitter 2
0x40030000 USART3 size 0x400 — Universal Synchronous Asynchronous Receiver Transmitter 3
0x40038000 ADCIFE size 0x400 — ADC controller interface
0x4003C000 DACC size 0x400 — DAC Controller
0x40040000 ACIFC size 0x400 — Analog Comparator Interface
0x40060000 GLOC size 0x400 — Glue Logic Controller
0x40064000 ABDACB size 0x400 — Audio Bitstream DAC
0x40068000 TRNG size 0x400 — True Random Number Generator
0x4006C000 PARC size 0x400 — Parallel Capture
0x40070000 CATB size 0x400 — Capacitive Touch Module B
0x40078000 TWIM2 size 0x400 — Two-wire Master Interface 2
0x4007C000 TWIM3 size 0x400 — Two-wire Master Interface 3
0x40080000 LCDCA size 0x400 — LCD Controller
0x400A0000 HFLASHC size 0x400 — Flash Controller
0x400A0400 HCACHE size 0x100 — Cortex M I&D Cache Controller
0x400A1000 HMATRIX size 0x400 — HSB Matrix
0x400A2000 PDCA size 0x1000 — Peripheral DMA Controller
0x400A3000 SMAP size 0x400 — System Manager Access Port
0x400A4000 CRCCU size 0x400 — CRC Calculation Unit
0x400A5000 USBC size 0x1000 — USB 2.0 Interface
0x400A6000 PEVC size 0x400 — Peripheral Event Controller
0x400B0000 AESA size 0x100 — Advanced Encryption Standard
0x400E0000 PM size 0x400 — Power Manager
0x400E0400 CHIPID size 0x400 — Chip ID Registers
0x400E0800 SCIF size 0x400 — System Control Interface
0x400E0C00 FREQM size 0x400 — Frequency Meter
0x400E1000 GPIO size 0x1000 — General-Purpose Input/Output Controller
0x400F0000 BPM size 0x400 — Backup Power Manager
0x400F0400 BSCIF size 0x400 — Backup System Control Interface
0x400F0800 AST size 0x400 — Asynchronous Timer
0x400F0C00 WDT size 0x400 — Watchdog Timer
0x400F1000 EIC size 0x400 — External Interrupt Controller
0x400F1400 PICOUART size 0x400

## Interrupts
0 HFLASHC_INTREQ (HFLASHC)
{n+1} PDCA_INTREQ_{n} (PDCA) (n=0..15)
17 CRCCU_INTREQ (CRCCU)
18 USBC_INTREQ (USBC)
19 PEVC_INTREQ_0 (PEVC)
20 PEVC_INTREQ_1 (PEVC)
21 AESA_INTREQ (AESA)
22 PM_INTREQ (PM)
23 SCIF_INTREQ (SCIF)
24 FREQM_INTREQ (FREQM)
{n+25} GPIO_INTREQ_{n} (GPIO) (n=0..11)
37 BPM_INTREQ (BPM)
38 BSCIF_INTREQ (BSCIF)
39 AST_INTREQ_0 (AST)
40 AST_INTREQ_1 (AST)
41 AST_INTREQ_2 (AST)
42 AST_INTREQ_3 (AST)
43 AST_INTREQ_4 (AST)
44 WDT_INTREQ (WDT)
{n+45} EIC_INTREQ_{n} (EIC) (n=0..7)
53 IISC_INTREQ (IISC)
54 SPI_INTREQ (SPI)
55 TC0_INTREQ_0 (TC0)
56 TC0_INTREQ_1 (TC0)
57 TC0_INTREQ_2 (TC0)
58 TC1_INTREQ_0 (TC1)
59 TC1_INTREQ_1 (TC1)
60 TC1_INTREQ_2 (TC1)
61 TWIM0_INTREQ (TWIM0)
62 TWIS0_INTREQ (TWIS0)
63 TWIM1_INTREQ (TWIM1)
64 TWIS1_INTREQ (TWIS1)
65 USART0_INTREQ (USART0)
66 USART1_INTREQ (USART1)
67 USART2_INTREQ (USART2)
68 USART3_INTREQ (USART3)
69 ADCIFE_INTREQ (ADCIFE)
70 DACC_INTREQ (DACC)
71 ACIFC_INTREQ (ACIFC)
72 ABDACB_INTREQ (ABDACB)
73 TRNG_INTREQ (TRNG)
74 PARC_INTREQ (PARC)
75 CATB_INTREQ (CATB)
77 TWIM2_INTREQ (TWIM2)
78 TWIM3_INTREQ (TWIM3)
79 LCDCA_INTREQ (LCDCA)

## Licence text in the file
============================================================================ Atmel Microcontroller Software Support ============================================================================ Copyright (c) 2016 Atmel Corporation, a wholly owned subsidiary of Microchip Technology Inc. . Licensed under the Apache License, Version 2.0 (the "License"); you may not use this file except in compliance with the License. You may obtain a copy of the Licence at http://www.apache.org/licenses/LICENSE-2.0 . Unless required by applicable law or agreed to in writing, software distributed under the License is distributed on an "AS IS" BASIS, WITHOUT WARRANTIES OR CONDITIONS OF ANY KIND, either express or implied. See the License for the specific language governing permissions and limitations under the License. ============================================================================
