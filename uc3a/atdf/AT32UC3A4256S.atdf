# AT32UC3A4256S device description
Architecture: AVR32_UC3; Family: AVR UC3
Programming and debug interfaces: JTAG
Registers are 32-bit, read-write, reset 0x0 unless marked. A register's access mark holds for its fields unless they carry their own. Offsets are from the block's base; lines under a group give offsets from that group; [hi:lo] are bit positions; {n}, {i} and the like mark numbered series; 'fields as' and 'values as' point back to an identical list; <NAME> marks a mode.

## Ordering variants
standard: up to 84 MHz, 3.0 to 3.6 V

## Memory
sysreg space: start 0 size 1024, big endian
dbgreg space: start 0 size 1024
base space: start 0 size 0x100000000, big endian
  0xC0000000 EBI_CS0 size 0x01000000 other
  0xD0000000 EBI_CS1 size 0x08000000 other
  0xC8000000 EBI_CS2 size 0x01000000 other
  0xCC000000 EBI_CS3 size 0x01000000 other
  0xD8000000 EBI_CS4 size 0x01000000 other
  0xDC000000 EBI_CS5 size 0x01000000 other
  0x80000000 FLASH size 0x00040000 flash
  0x80800000 USER_PAGE size 0x00000200 user_page
  0xFF000000 INTRAM0 size 0x00008000 other
  0xFF008000 INTRAM1 size 0x00008000 other
  0x00000000 SRAM size 0x00010000 ram
  0xE0000000 USBB_SLAVE size 0x00800000 other
  0xfffe0000 IO size 0x20000 io, rw
fuses space: start 0xfffe1400 size 0x01, big endian
  0xfffe1400 FUSES size 0x00000001 fuses, rw

## Peripheral instances (address, pins/pin function, parameters)
CORE at 0 in sysreg
INTC at 0xFFFF0800
  parameters: NUM_INT_GRPS=30, NUM_IRQS_PER_GRP0=1, NUM_IRQS_PER_GRP1=11, NUM_IRQS_PER_GRP2=14, NUM_IRQS_PER_GRP3=8, NUM_IRQS_PER_GRP{n}=1 (n=4..13), NUM_IRQS_PER_GRP14=3, NUM_IRQS_PER_GRP15=1, NUM_IRQS_PER_GRP16=3, NUM_IRQS_PER_GRP{n}=1 (n=17..21), NUM_IRQS_PER_GRP22=5, NUM_IRQS_PER_GRP{n}=1 (n=23..29)
ADC at 0xffff3c00
  pins: AD0 PA21/A; AD1 PA22/A; AD2 PA23/A; AD3 PA24/A; ADVREFP0 PB12/B; TRIGGER0 PX47/B or PB00/C; AD7 PA17/C; AD6 PA18/C; AD5 PA19/C; AD4 PA20/C
  parameters: ADC_CHANNELS_MSB=7, ADC_DATA_MSB=9, PADDR_MSB=10, PDATA_MSB=32
AES at 0xfffd0000
BUSMON at 0xfffe2800
  parameters: BUSMON_CH0_IMPL=1, BUSMON_CH1_IMPL=1, BUSMON_CH2_IMPL=1, BUSMON_CH3_IMPL=1
ABDAC at 0xffff4000
  pins: DATAN0 PA07/B or PA04/C; DATA0 PA08/B or PA03/C; DATA1 PB01/B or PA23/C; DATAN1 PB02/B or PA24/C
DMACA at 0xff100000
  pins: DMARQ1 PX17/B; DMAACK1 PX18/B; DMAACK0 PX51/B or PA30/C; DMARQ0 PX52/B or PA31/C
  parameters: CH_AES_RX=0, CH_AES_TX=1, CH_AUDIOC_RXA=-1, CH_AUDIOC_RXB=-1, CH_AUDIOC_TXA=-1, CH_AUDIOC_TXB=-1, CH_DAC_TX=-1, CH_EXTRQ0=6, CH_EXTRQ1=7, CH_EXTRQ2=-1, CH_EXTRQ3=-1, CH_MMCI_RX=2, CH_MMCI_TX=3, CH_MSI_RX=4, CH_MSI_TX=5, DMAC_HS_INT_MSB=8, EXT_DMARQ_MSB=1, MAX_BLK_SIZE=16, NUM_CHANNELS=4
EBI
  pins: DATA10 PX00/A; DATA9 PX01/A; DATA8 PX02/A; DATA7 PX03/A; DATA6 PX04/A; DATA5 PX05/A; DATA4 PX06/A; DATA3 PX07/A; DATA2 PX08/A; DATA1 PX09/A; DATA0 PX10/A; NWE10 PX11/A; NWE00 PX12/A; NRD0 PX13/A; NCS1 PX14/A; ADDR19 PX15/A; ADDR18 PX16/A; ADDR17 PX17/A; ADDR16 PX18/A; ADDR15 PX19/A; ADDR14 PX20/A; ADDR13 PX21/A; ADDR12 PX22/A; ADDR11 PX23/A; ADDR10 PX24/A; ADDR9 PX25/A; ADDR8 PX26/A; ADDR7 PX27/A; ADDR6 PX28/A; ADDR5 PX29/A; ADDR4 PX30/A; ADDR3 PX31/A; ADDR2 PX32/A; ADDR1 PX33/A; ADDR0 PX34/A; DATA15 PX35/A; DATA14 PX36/A; DATA13 PX37/A; DATA12 PX38/A; DATA11 PX39/A; SDCS0 PX40/A; CAS0 PX41/A; RAS0 PX42/A; SDA100 PX43/A; SDWE0 PX44/A; SDCK0 PX45/A; SDCKE0 PX46/A; NANDOE0 PX47/A; ADDR23 PX48/A; CFRNW0 PX49/A; CFCE20 PX50/A; CFCE10 PX51/A; NCS3 PX52/A; NCS2 PX53/A; NWAIT0 PX54/A; ADDR22 PX55/A; ADDR21 PX56/A; ADDR20 PX57/A; NCS0 PX58/A; NANDWE0 PX59/A; NCS4 PB09/C; NCS5 PB10/C; SCAN_CLOCK0 PX45
  parameters: CF0_CS=4, CF1_CS=5, HADDR_MSB=0, HBURST_MSB=0, HDATA_MSB=0, HEBI_CS_MSB=5, HMATRIX_NR=6, HPROT_MSB=0, HRESP_MSB=0, HSIZE_MSB=0, HTRANS_MSB=0, NAND_CS=3, PADDR_MSB=0, PDATA_MSB=0, SDRAM_CS=1, SMC{n}_CS={n} (n=0..5)
ECCHRS at 0xfffe2400
  parameters: PADDR_MSB=31, PDATA_MSB=31
EIC at 0xffff0d80
  pins: EXTINT8 PA20/A; EXTINT4 PA03/B; EXTINT5 PA04/B; EXTINT6 PA09/B; EXTINT0 PA21/B; EXTINT1 PA22/B; EXTINT2 PA23/B; EXTINT3 PA24/B; SCAN0 PX19/B or PX58/B or PB01/C; SCAN1 PX20/B or PX57/B or PB02/C; SCAN2 PX21/B or PX56/B or PB03/C; SCAN3 PX22/B or PX55/B or PB04/C; SCAN4 PX23/B or PB05/C; SCAN5 PX24/B or PB06/C; SCAN6 PX25/B or PB07/C; SCAN7 PX26/B or PB08/C; EXTINT7 PA13/C
  parameters: INT_MSB=8, SCAN_MSB=7, STD_NUM=8
FLASHC at 0xfffe1400
  pins: EXTCLK0 PB04; LATDEL0 PB05; LATDELCLK0 PB06; FLASH_OBS{n} PA{n:02} (n=0..17); FLASH_OBS18 PB09; FLASH_OBS19 PB10; FLASH_OBS20 PB11
  parameters: FLASH_SIZE=262144, PAGES_PR_REGION=32, PAGE_SIZE=512, USER_PAGE=(*(volatile unsigned char*)) AVR32_FLASHC_USER_PAGE_ADDRESS)), USER_PAGE_ADDRESS=0x80800000, USER_PAGE_SIZE=512, CF_NUM=64, GPF_NUM=64, FWS_0_MAX_FREQ=36000000, FWS_1_MAX_FREQ=72000000
FREQM at 0xffff0d50
  parameters: FREQM_REFSEL_BITS=1
GPIO at 0xffff1000
  pins: P{n} PA{n:02} (n=0..31); P{n} PB{n-32:02} (n=32..44); P45 PC00; P46 PC01; P47 PC02; P48 PC03; P49 PC04; P50 PC05; P{n} PX{n-51:02} (n=51..110)
  parameters: GPIO_IRQ_MSB=13, GPIO_MAX_IRQ_MSB=13, GPIO_PADDR_BITS=10, GPIO_PINS_MSB=111, IRQS_PER_GROUP=8, NUMBER_OF_PINS=112, PADDR_MSB=9, PDATA_MSB=31, PORT_LENGTH=4
HMATRIX at 0xfffe1000
  parameters: MASTER_CPU_DATA=0, MASTER_CPU_INSTRUCTION=1, MASTER_CPU_SAB=2, MASTER_PDCA=3, MASTER_MACB_DMA=4, MASTER_USBB_DMA=5, SLAVE_FLASH=0, SLAVE_PBA=1, SLAVE_PBB=2, SLAVE_SRAM=3, SLAVE_USBB_DPRAM=4, SLAVE_EBI=5, MASTER_NUM=6, SLAVE_NUM=6
SDRAMC at 0xfffe2000
SMC at 0xfffe1c00
JTAG
MCI at 0xfffe4000
  pins: CMD1 PA15/A or PX59/C; DATA11 PA16/A or PX47/C; DATA10 PA17/A or PX48/C; DATA9 PA18/A or PX49/C; DATA8 PA19/A or PX50/C; CLK0 PA27/A; CMD0 PA28/A; DATA0 PA29/A; DATA1 PA30/A; DATA2 PA31/A; DATA3 PB00/A; DATA4 PB01/A; DATA5 PB02/A; DATA6 PB03/A; DATA7 PB04/A; DATA15 PX51/C; DATA14 PX52/C; DATA13 PX53/C; DATA12 PX54/C; SCAN_CLOCK0 PA27
  parameters: MMCI_SDCARD=2
MSI at 0xfffe8000
  pins: SCLK0 PA27/D; BS0 PA28/D; DATA0 PA29/D; DATA1 PA30/D; DATA2 PA31/D; DATA3 PB00/D; INS0 PB01/D
PDCA at 0xffff0000
  parameters: CHANNEL_LENGTH=8, HADDR_MSB=31, HDATA_MSB=31, PADDR_MSB=31, PDATA_MSB=31, PDCA_CHANNELS_MSB=7, PID_ADC_RX=0, PID_DAC_TX=23, PID_MCI_RX=-1, PID_SPI0_RX=10, PID_SPI0_TX=21, PID_SPI1_RX=11, PID_SPI1_TX=22, PID_SPI2_RX=-1, PID_SPI2_TX=-1, PID_SPI3_RX=-1, PID_SPI3_TX=-1, PID_SSC_RX=1, PID_SSC_TX=12, PID_SSC0_RX=-1, PID_SSC0_TX=-1, PID_SSC1_RX=-1, PID_SSC1_TX=-1, PID_SSC2_RX=-1, PID_SSC2_TX=-1, PID_TSADCC_RX=-1, PID_TWIM0_RX=6, PID_TWIM0_TX=17, PID_TWIM1_RX=7, PID_TWIM1_TX=18, PID_TWIS0_RX=8, PID_TWIS0_TX=19, PID_TWIS1_RX=9, PID_TWIS1_TX=20, PID_TWI_RX=-1, PID_TWI_TX=-1, PID_TWI0_RX=-1, PID_TWI0_TX=-1, PID_TWI1_RX=-1, PID_TWI1_TX=-1, PID_USART0_RX=2, PID_USART0_TX=13, PID_USART1_RX=3, PID_USART1_TX=14, PID_USART2_RX=4, PID_USART2_TX=15, PID_USART3_RX=5, PID_USART3_TX=16, PID_USART4_RX=-1, PID_USART4_TX=-1, PID_USART5_RX=-1, PID_USART5_TX=-1
PLL0
  pins: PLLCLK0 PA00; LOCK0 PA01; DN0 PA06; UP0 PB05; FDIV0 PB06
PLL1
  pins: PLLCLK0 PA02; LOCK0 PA03; FDIV0 PA05; DN0 PB09; UP0 PB10
PM at 0xffff0c00
  pins: GCLK1 PB11/C or PX35/C; GCLK0 PB12/C or PX02/C or PX34/C; GCLK2 PX36/C; GCLK3 PX37/C; RSTM_N0 PX46; XIN00 PC02; XIN10 PC04; XIN320 PC00; XOUT00 PC03; XOUT10 PC05; XOUT320 PC01
  parameters: GCLK_MSB=3, GCLK_NUM=9, GCLK_USBB=4, GPLP_NUM=8, RCOSC_CALIBRATION_BITS=10, RCOSC_FREQUENCY=115200, PLL_VCO_RANGE0_MIN_FREQ=160000000, PLL_VCO_RANGE0_MAX_FREQ=240000000, PLL_VCO_RANGE1_MIN_FREQ=80000000, PLL_VCO_RANGE1_MAX_FREQ=180000000, CPU_MAX_FREQ=72000000, HSB_MAX_FREQ=72000000, PBA_MAX_FREQ=72000000, PBB_MAX_FREQ=72000000
  clocks: CPU OCD bit 0, SYSTIMER bit 16; HSB FLASHC bit 0, PBA bit 1, PBB bit 2, USBB bit 3, PDCA bit 4, EBI bit 5, PBC bit 6, DMACA bit 7, BUSMON bit 8, HRAMC0 bit 9, HRAMC1 bit 10; PBA INTC bit 0, IO bit 1, PDCA bit 2, PM bit 3, RTC bit 3, EIC bit 3, ADC bit 4, SPI0 bit 5, SPI1 bit 6, TWIM0 bit 7, TWIM1 bit 8, TWIS0 bit 9, TWIS1 bit 10, USART0 bit 11, USART1 bit 12, USART2 bit 13, USART3 bit 14, SSC bit 15, TC0 bit 16, TC1 bit 17, ABDAC bit 18; PBB HMATRIX bit 0, USBB bit 1, FLASHC bit 2, SMC bit 3, SDRAMC bit 4, ECCHRS bit 5, MCI bit 6, BUSMON bit 7, MSI bit 8, AES bit 9
RTC at 0xffff0d00
SPI0 at 0xffff2400 (SPI)
  pins: NPCS3 PA07/A or PX33/B; SCK0 PA08/A or PX29/B; NPCS0 PA09/A or PX30/B or PA02/C; MOSI0 PA10/A or PX28/B; MISO0 PA11/A or PX27/B; NPCS1 PA14/A or PA13/B or PX31/B; NPCS2 PA12/B or PX32/B; SCAN_CLOCK0 PA08
  parameters: PDCA_ID_RX=11, PDCA_ID_TX=22, SPI_CS_MSB=3
SPI1 at 0xffff2800 (SPI)
  pins: SCK0 PB07/A or PA15/B or PX36/B; MISO0 PB08/A or PA19/B or PX34/B; NPCS0 PB09/A or PX37/B; MOSI0 PB10/A or PA16/B or PX35/B; NPCS1 PA17/B or PX38/B; NPCS2 PA18/B or PX39/B; NPCS3 PA00/C; SCAN_CLOCK0 PB07
  parameters: PDCA_ID_RX=11, PDCA_ID_TX=22, SPI_CS_MSB=3
SSC at 0xffff3400
  pins: RX_FRAME_SYNC0 PA20/B or PB10/B or PX26/C; RX_DATA0 PA27/B or PB09/B or PX25/C; RX_CLOCK0 PA28/B or PX28/C; TX_CLOCK0 PB07/B or PX23/C; TX_DATA0 PB08/B or PX24/C; TX_FRAME_SYNC0 PB11/B or PX27/C
  parameters: PDCA_ID_RX=2, PDCA_ID_TX=13
TC0 at 0xffff3800 (TC)
  pins: CLK10 PA00/B or PX21/C; A10 PA01/B or PX16/C; B10 PA02/B or PX17/C; A00 PB05/B or PX14/C; B00 PB06/B or PX15/C; CLK00 PA29/C or PX20/C; A20 PX18/C; B20 PX19/C; CLK20 PX22/C
TC1 at 0xffff4400 (TC)
  pins: CLK00 PA05/B; CLK10 PA06/B; B20 PX50/B; B10 PA08/C; A10 PA09/C; B00 PA10/C; A20 PA11/C; A00 PA12/C; CLK20 PA16/C
TWIM0 at 0xffff2c00 (TWIM)
  parameters: PDCA_ID_RX=7, PDCA_ID_TX=18
TWIM1 at 0xffff3000 (TWIM)
  parameters: PDCA_ID_RX=7, PDCA_ID_TX=18
TWIMS0
  pins: TWD0 PA25/A or PA25; TWCK0 PA26/A or PA26; TWALM0 PA14/B
TWIMS1
  pins: TWALM0 PA25/B; TWCK0 PA14/C; TWD0 PA15/C
TWIS0 at 0xffff5000 (TWIS)
  parameters: PDCA_ID_RX=9, PDCA_ID_TX=20
TWIS1 at 0xffff5400 (TWIS)
  parameters: PDCA_ID_RX=9, PDCA_ID_TX=20
USART0 at 0xffff1400 (USART)
  pins: RTS0 PA00/A or PX03/B; CTS0 PA01/A or PX02/B; CLK0 PA02/A; RXD0 PA03/A or PX00/B; TXD0 PA04/A or PX01/B
  parameters: PADDR_MSB=12, PDATA_MSB=31, PDCA_ID_RX=3, PDCA_ID_TX=14
USART1 at 0xffff1800 (USART)
  pins: RXD0 PA05/A or PB11/A or PX04/B; TXD0 PA06/A or PB12/A or PX05/B; CTS0 PA12/A or PX06/B; RTS0 PA13/A or PX07/B; RI0 PX43/B or PX00/C; DTR0 PX44/B or PX01/C; CLK0 PA07/C; DCD0 PA25/C or PX38/C; DSR0 PA26/C or PX39/C
  parameters: PADDR_MSB=12, PDATA_MSB=31, PDCA_ID_RX=3, PDCA_ID_TX=14
USART2 at 0xffff1c00 (USART)
  pins: CTS0 PA26/B or PX12/B; RXD0 PA31/B or PX10/B or PX55/C; TXD0 PB00/B or PX11/B or PX56/C; CLK0 PB03/B; RTS0 PX13/B or PA01/C
  parameters: PADDR_MSB=12, PDATA_MSB=31, PDCA_ID_RX=3, PDCA_ID_TX=14
USART3 at 0xffff2000 (USART)
  pins: TXD0 PA29/B or PX09/B or PX54/B or PX58/C; CLK0 PA30/B; RXD0 PB04/B or PX08/B or PX57/C; RTS0 PX15/B or PA27/C; CTS0 PX16/B or PA28/C
  parameters: PADDR_MSB=12, PDATA_MSB=31, PDCA_ID_RX=3, PDCA_ID_TX=14
USBB at 0xfffe0000, USBB_HSB 0x0000 in hsb
  pins: USB_ID0 PB05/A or PA11/B or PX49/B or PA05/C or PA21/C; USB_VBOF0 PB06/A or PA10/B or PX48/B or PA06/C or PA22/C
UTMI
  pins: CLK_UTMI_12M_SCAN0 PB10; CLK_UTMI_30M_SCAN0 PB11
WDT at 0xffff0d30
  parameters: WDTEXTRST_MSB=1
FUSES at 0xFFFE1400 in fuses (FLASH_FUSES)

## Interrupts
0 CORE_COMPARE_IRQ (CORE)
NMI EIM_IRQ_8 (EIC)
{n+32} EIM_IRQ_{n} (EIC) (n=0..7)
40 RTC_IRQ (RTC)
41 PM_IRQ (PM)
42 FREQM_IRQ (FREQM)
{n+64} GPIO_IRQ_{n} (GPIO) (n=0..13)
{n+96} PDMA_IRQ_{n} (PDCA) (n=0..7)
128 HFLASHC_IRQ (FLASHC)
160 USART0_IRQ (USART0)
192 USART1_IRQ (USART1)
224 USART2_IRQ (USART2)
256 USART3_IRQ (USART3)
288 SPI0_IRQ (SPI0)
320 SPI1_IRQ (SPI1)
352 TWIM0_IRQ (TWIM0)
384 TWIM1_IRQ (TWIM1)
416 SSC_IRQ (SSC)
448 TC0_IRQ0 (TC0)
449 TC0_IRQ1 (TC0)
450 TC0_IRQ2 (TC0)
480 ADC_IRQ (ADC)
512 TC1_IRQ0 (TC1)
513 TC1_IRQ1 (TC1)
514 TC1_IRQ2 (TC1)
544 USB_IRQ (USBB)
576 HSDRAMC_IRQ (SDRAMC)
608 DAC_IRQ (ABDAC)
640 MCI_IRQ (MCI)
672 AES_IRQ (AES)
704 DMACA_BLOCK_IRQ (DMACA)
705 DMACA_DSTT_IRQ (DMACA)
706 DMACA_ERR_IRQ (DMACA)
707 DMACA_SRCT_IRQ (DMACA)
708 DMACA_TFR_IRQ (DMACA)
832 MSI_IRQ (MSI)
864 TWIS0_IRQ (TWIS0)
896 TWIS1_IRQ (TWIS1)
928 RS4_IRQ (ECCHRS)

## Properties
AVR32_RESET: NumberOfResetDomains=5, ResetGroup=1
SIGNATURES: JTAGID=0x202903F
