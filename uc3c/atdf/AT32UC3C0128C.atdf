# AT32UC3C0128C device description
Architecture: AVR32_UC3; Family: AVR UC3
Programming and debug interfaces: JTAG, aWire
Registers are 32-bit, read-write, reset 0x0 unless marked. A register's access mark holds for its fields unless they carry their own. Offsets are from the block's base; lines under a group give offsets from that group; [hi:lo] are bit positions; {n}, {i} and the like mark numbered series; 'fields as' and 'values as' point back to an identical list; <NAME> marks a mode.

## Ordering variants
standard: up to 66 MHz, 3.0 to 5.0 V

## Memory
sysreg space: start 0 size 1024, big endian
dbgreg space: start 0 size 1024
base space: start 0 size 0x100000000, big endian
  0x00000000 SRAM size 0x00008000 ram
  0xC0000000 EBI_CS0 size 0x01000000 other
  0xD0000000 EBI_CS1_0 size 0x04000000 other
  0xD4000000 EBI_CS1_1 size 0x04000000 other
  0xC8000000 EBI_CS2 size 0x01000000 other
  0xCC000000 EBI_CS3 size 0x01000000 other
  0x80000000 FLASH size 0x00020000 flash
  0x80800000 USER_PAGE size 0x00000200 user_page
  0x80800200 FACTORY_PAGE size 0x001C other, ro
  0xA0000000 HRAMC0 size 0x00001000 other
  0x90000000 SAU_SLAVE size 0x00000400 other
  0xFFFD0000 IO size 0x30000 io, rw
fuses space: start 0xFFFE0018 size 4, big endian

## Peripheral instances (address, pins/pin function, parameters)
CORE at 0 in sysreg
  parameters: CONFIG0_RESETVALUE=0x3000DCB, CONFIG1_RESETVALUE=0x800000
INTC at 0xFFFF0000
  parameters: NUM_INT_GRPS=47, NUM_IRQS_PER_GRP0=1, NUM_IRQS_PER_GRP1=2, NUM_IRQS_PER_GRP2=1, NUM_IRQS_PER_GRP3=4, NUM_IRQS_PER_GRP4=4, NUM_IRQS_PER_GRP5=4, NUM_IRQS_PER_GRP6=4, NUM_IRQS_PER_GRP7=1, NUM_IRQS_PER_GRP8=1, NUM_IRQS_PER_GRP9=10, NUM_IRQS_PER_GRP10=1, NUM_IRQS_PER_GRP11=1, NUM_IRQS_PER_GRP12=1, NUM_IRQS_PER_GRP13=1, NUM_IRQS_PER_GRP14=5, NUM_IRQS_PER_GRP15=4, NUM_IRQS_PER_GRP16=4, NUM_IRQS_PER_GRP17=1, NUM_IRQS_PER_GRP18=16, NUM_IRQS_PER_GRP{n}=1 (n=19..32), NUM_IRQS_PER_GRP33=3, NUM_IRQS_PER_GRP34=3, NUM_IRQS_PER_GRP35=2, NUM_IRQS_PER_GRP36=6, NUM_IRQS_PER_GRP37=1, NUM_IRQS_PER_GRP38=1, NUM_IRQS_PER_GRP39=6, NUM_IRQS_PER_GRP40=6, NUM_IRQS_PER_GRP{n}=1 (n=41..46)
ACIFA0 at 0xffff6000 (ACIFA)
  pins: ACAOUT PA04/C; ACBOUT PA05/C
  parameters: ACIFA_PADDR_SIZE=7, PADDR_MSB=31, PDATA_MSB=31
ACIFA1 at 0xffff6400 (ACIFA)
  pins: ACAOUT PB20/D; ACBOUT PB21/D
  parameters: ACIFA_PADDR_SIZE=7, PADDR_MSB=31, PDATA_MSB=31
ADCIFA at 0xfffd2400
  pins: OUT10 PA28; OUT11 PA29; PREAMPCAL8 PB00; PREAMPCAL9 PB01; PREAMP0RESET PB02; PREAMP1RESET PB03; CAL{n} PB{n+4:02} (n=0..14); CLK PB19; EN PB20; MUX0NSEL0 PB22; MUX0NSEL1 PB23; MUX0NSEL2 PB24; MUX0NSEL3 PB25; MUX0PSEL0 PB27; MUX0PSEL1 PB28; MUX0PSEL2 PB29; MUX0PSEL3 PC00; MUX1NSEL0 PC02; MUX1NSEL1 PC03; MUX1NSEL2 PC04; MUX1NSEL3 PC05; MUX1PSEL0 PC07; MUX1PSEL1 PC08; MUX1PSEL2 PC09; MUX1PSEL3 PC10; OUT{n} PC{n+11} (n=0..9); OUT{n} PC{n+11} (n=12..20); OUT21 PD00; OUT22 PD01; OUT23 PD02; PGATE0EN PD03; PGATE1EN PD04; PREAMP0EN PD05; PREAMP0HOLD PD06; PREAMP0OUTEN PD07; PREAMP0S0GAIN0 PD08; PREAMP0S0GAIN1 PD09; PREAMP0S1GAIN0 PD10; PREAMP0S1GAIN1 PD11; PREAMP1EN PD12; PREAMP1OUTEN PD13; PREAMP1S0GAIN0 PD14; PREAMP1HOLD PD15; PREAMP1S0GAIN1 PD16; PREAMP1S1GAIN0 PD17; PREAMP1S1GAIN1 PD18; REFBUFEN PD19; REFSEL0 PD20; REFSEL1 PD21; PENDETECT PD22; PREAMPCAL{n} PD{n+23} (n=0..7)
  parameters: PDCA_ID_RX_CH0=0, PDCA_ID_RX_CH1=1, REG_RX_CH0=LCV0, REG_RX_CH1=LCV1
AST at 0xffff0c00
  parameters: APB=2, CLK32=1, GCLK_NUM=2, GENCLK=3, RCOSC=0
AW at 0xffff7000
  pins: DATAOUT PA02
  parameters: PDCA_ID_RX=12, PDCA_ID_TX=28
CANIF at 0xfffd1c00
  pins: TXLINE1 PA00/B or PB01/B or PC12/B or PC24/B or PC00/E or PC16/E; RXLINE1 PA01/B or PB00/B or PC11/B or PC23/B or PC01/E or PC15/E; RXLINE0 PB04/B or PC21/B or PD09/B or PD27/B or PB16/E; TXLINE0 PB05/B or PC22/B or PD10/B or PD28/B or PB17/E
  parameters: CAN_NB=2, CLK_AHB_ID=4, GCLK_NUM=1, HADDR_MSB=31, HBURST_MSB=2, HDATA_MSB=31, HPROT_MSB=3, HRESP_MSB=1, HSIZE_MSB=2, HTRANS_MSB=1, PADDR_MSB=31, PDATA_MSB=31
DACIFB0 at 0xffff6800 (DACIFB)
  pins: GAINCALIB7 PA26; GAINCALIB8 PA27; OFFSETCALIB7 PA28; OFFSETCALIB8 PA29; CHAOE PB04; CHASAMPLE PB05; CHBOE PB06; CHBSAMPLE PB07; CONVERTBAR PB08; EN PB09; GAINCALIB0 PB10; GAINCALIB1 PB11; GAINCALIB2 PB12; GAINCALIB3 PB13; GAINCALIB4 PB14; GAINCALIB5 PB15; GAINCALIB6 PB16; INTERNOE PB17; LOWPOWER PB18; OFFSETCALIB0 PB19; OFFSETCALIB1 PB20; OFFSETCALIB2 PB21; OFFSETCALIB3 PB22; OFFSETCALIB4 PB23; OFFSETCALIB5 PB24; OFFSETCALIB6 PB25; REFSEL PB26; SHEN PB27; VALUE0 PB28; VALUE1 PB29; VALUE{n} PC{n-2:02} (n=2..11)
  parameters: DAC_PRECISION_MSB=11, PADDR_MSB=31, PDATA_MSB=31, PDCA_ID_TX_CHA=23, PDCA_ID_TX_CHB=24, REG_TX_CHA=DR0, REG_TX_CHB=DR1
DACIFB1 at 0xffff6c00 (DACIFB)
  parameters: DAC_PRECISION_MSB=11, PADDR_MSB=31, PDATA_MSB=31, PDCA_ID_TX_CHA=25, PDCA_ID_TX_CHB=26, REG_TX_CHA=DR0, REG_TX_CHB=DR1
EBI
  pins: NCS3 PC07/B; NCS0 PC08/C; ADDR23 PC09/C; ADDR22 PC10/C; ADDR21 PC11/C; ADDR20 PC12/C; SDCS PC13/C; SDCKE PC14/C; SDWE PC15/C; CAS PC16/C; RAS PC17/C; SDA10 PC18/C; DATA{n} PC{n+19}/C (n=0..12); DATA13 PD00/C; DATA14 PD01/C; DATA15 PD02/C; ADDR{n} PD{n+3:02}/C (n=0..9); SDCK PD13/C; ADDR{n} PD{n+4}/C (n=10..19); NWE1 PD24/C; NWE0 PD25/C; NRD PD26/C; NCS1 PD27/C; NCS2 PD28/C; NWAIT PD30/C
  parameters: CLK_AHB_ID=10, CS_MSB=3, HADDR_MSB=0, HBURST_MSB=0, HDATA_MSB=0, HMATRIX_NR=6, HPROT_MSB=0, HRESP_MSB=0, HSIZE_MSB=0, HTRANS_MSB=0, PADDR_MSB=0, PDATA_MSB=0, SDRAM_CS=1, SMC0_CS=0, SMC1_CS=1, SMC2_CS=2, SMC3_CS=3
EIC at 0xffff1400
  pins: EXTINT1 PA03/B or PA19/B or PA26/B or PC03/B; EXTINT4 PA10/B or PC05/B or PB18/C; EXTINT2 PA27/B or PB07/B or PA08/C; EXTINT3 PA28/B or PC04/B or PD30/B; EXTINT0 PA29/B or PD21/B or PA25/C or PC27/D; EXTINT7 PC13/B or PD14/B; EXTINT5 PC18/B or PD07/B; EXTINT6 PD08/B or PD29/B; EXTINT8 PD24/B or PB00/C; SCAN{n} PB{n+8:02}/D (n=0..7)
  parameters: INT_MSB=8, SCAN_MSB=7, STD_NUM=8
HFLASHC at 0xfffe0000 (FLASHC)
  pins: EXTCLK PD14; LATDELMATCH PD00; LATDELCLK PD02; LATDEL PD13; FLASH_OBS0 PA04; FLASH_OBS1 PA05; FLASH_OBS2 PA06; FLASH_OBS3 PA07; FLASH_OBS4 PA08; FLASH_OBS5 PA09; FLASH_OBS6 PA16; FLASH_OBS9 PA19; FLASH_OBS10 PA20; FLASH_OBS11 PA21; FLASH_OBS12 PA22; FLASH_OBS13 PA23; FLASH_OBS14 PC02; FLASH_OBS15 PC03; FLASH_OBS16 PC04; FLASH_OBS17 PC05; FLASH_OBS18 PC15; FLASH_OBS19 PC16; FLASH_OBS20 PC17; FLASH_OBS8 PC18; FLASH_OBS7 PC19
  parameters: CLK_AHB_ID=5, FLASH_SIZE=131072, PAGES_PR_REGION=16, PAGE_SIZE=512, USER_PAGE=(*(volatile unsigned char*)) AVR32_FLASHC_USER_PAGE_ADDRESS)), USER_PAGE_ADDRESS=0x80800000, USER_PAGE_SIZE=512, FWS_0_MAX_FREQ=25000000, FWS_1_MAX_FREQ=66000000
FREQM at 0xffff1800
  parameters: CPU=0, CRIPEL=12, DFLL0=0, FLO=0, GENCLKDIV{n}=0 (n=0..10), GENCLK{n}={n+13} (n=0..10), HSB=1, NUM_CLK=32, NUM_REF_CLK=5, OSC0=5, OSC1=6, OSC2=0, OSC3=0, OSC4=0, OSC32=7, PBA=2, PBB=3, PBC=4, PLL0=10, PLL1=11, PLL2=0, PLL3=0, RCOSC=8, RCOSC8=9, RC32K=0, RC120M=25, RC120M_AW=0, REFSEL_BITS=3, REF_GENCLK{n}=0 (n=0..6), REF_OSC0=2, REF_OSC1=3, REF_OSC2=0, REF_OSC32=1, REF_RCOSC=0, REF_RCOSC8=4
GPIO at 0xffff2000
  pins: P{n} PA{n:02} (n=0..16); P{n} PA{n} (n=19..29); P{n} PB{n-32:02} (n=32..63); P{n} PC{n-64:02} (n=64..95); P{n} PD{n-96:02} (n=96..126)
  parameters: GPIO_IRQ_MSB=15, GPIO_MAX_IRQ_MSB=31, GPIO_PADDR_BITS=11, GPIO_PINS_MSB=123, IRQS_PER_GROUP=8, NUMBER_OF_PINS=124, PADDR_MSB=10, PDATA_MSB=31, PORT_LENGTH=4
HMATRIX at 0xfffe2000 (HMATRIXB)
  parameters: MASTER_CPU_DATA=0, MASTER_CPU_INSN=1, MASTER_CPU_SAB=2, MASTER_SAU=3, MASTER_PDCA=4, MASTER_MDMA_READ=5, MASTER_MDMA_WRITE=6, MASTER_USBB_DMA=7, MASTER_CANIF=8, SLAVE_FLASH=0, SLAVE_PBA=1, SLAVE_PBB=2, SLAVE_PBC=3, SLAVE_SRAM=4, SLAVE_HSB_RAM=5, SLAVE_EBI=6, SLAVE_SAU=7, SLAVE_USBB_DPRAM=8, MASTER_NUM=9, SLAVE_NUM=9
IISC at 0xffff4800
  pins: ISDO PB19/C or PC17/D; ISDI PB20/C or PC18/D; IMCK PB21/C or PC19/D; ISCK PB22/C or PC20/D; IWS PB23/C or PC21/D
  parameters: CHANNELS_BITS=8, DMA_CHANNELS_BITS=8, GCLK_ID=11, PDCA_ID_RX=44:37, PDCA_ID_TX=52:45
JTAG
  pins: TDI PA01; TDO PA02; TMS PA03; TCK PA00
MACB at 0xfffe3000
  pins: SPEED PA22/E; WOL PA23/E; TXD2 PB04/E; TXD3 PB05/E; TX_ER PB06/E; RX_DV PB07/E or PD28/E; RXD0 PB08/E or PD13/E; RXD1 PB09/E or PD14/E; RX_ER PB13/E or PD27/E; MDC PB14/E or PC02/E; MDIO PB15/E or PC03/E; CRS PB19/E; COL PB20/E; RXD2 PB21/E; RXD3 PB22/E; RX_CLK PB23/E; TX_EN PB26/E or PD30/E; TXD0 PB27/E or PD11/E; TXD1 PB28/E or PD12/E; TX_CLK PD29/E
  parameters: CLK_AHB_ID=11
MDMA at 0xfffd1000
  parameters: CLK_AHB_ID=2
PDCA at 0xfffd0000
  parameters: CHANNEL_LENGTH=16, CLK_AHB_ID=1, HADDR_MSB=31, HDATA_MSB=31, MON_CH0_IMPL=1, MON_CH1_IMPL=0, PADDR_MSB=31, PDATA_MSB=31, PDCA_CHANNELS_MSB=15, PID_AC97C_RXA=-1, PID_AC97C_RXB=-1, PID_AC97C_TXA=-1, PID_AC97C_TXB=-1, PID_ADC_RX=-1, PID_AW_RX=-1, PID_AW_TX=-1, PID_CAT_ACOUNT=-1, PID_CAT_MBLEN=-1, PID_MCI_RX=-1, PID_SPI0_RX=-1, PID_SPI0_TX=-1, PID_SPI1_RX=-1, PID_SPI1_TX=-1, PID_SPI2_RX=-1, PID_SPI2_TX=-1, PID_SPI3_RX=-1, PID_SPI3_TX=-1, PID_SSC_RX=-1, PID_SSC_TX=-1, PID_SSC0_RX=-1, PID_SSC0_TX=-1, PID_SSC1_RX=-1, PID_SSC1_TX=-1, PID_SSC2_RX=-1, PID_SSC2_TX=-1, PID_TSADCC_RX=-1, PID_TWIM0_RX=-1, PID_TWIM0_TX=-1, PID_TWIM1_RX=-1, PID_TWIM1_TX=-1, PID_TWIS0_RX=-1, PID_TWIS0_TX=-1, PID_TWIS1_RX=-1, PID_TWIS1_TX=-1, PID_TWI_RX=-1, PID_TWI_TX=-1, PID_TWI0_RX=-1, PID_TWI0_TX=-1, PID_TWI1_RX=-1, PID_TWI1_TX=-1, PID_USART{n}_RX=-1 (n=0..5), PID_USART{n}_TX=-1 (n=0..5)
PEVC at 0xffff5c00
  pins: PAD_EVT15 PC06/A or PC10/A; PAD_EVT2 PC07/A or PA06/C; PAD_EVT13 PC08/A or PA10/C; PAD_EVT14 PC09/A or PA11/C; PAD_EVT1 PB08/B or PA02/C; PAD_EVT0 PA01/C; PAD_EVT3 PA07/C or PC23/D; PAD_EVT4 PA22/C or PC24/D; PAD_EVT5 PA23/C or PC31/D; PAD_EVT6 PB02/C or PD11/D; PAD_EVT7 PB03/C or PD12/D; PAD_EVT12 PB05/C or PB29/C; PAD_EVT8 PB25/C or PD13/D; PAD_EVT9 PB26/C or PD14/D; PAD_EVT10 PB27/C or PB00/D; PAD_EVT11 PB28/C or PB01/D
  parameters: CLK_AHB_ID=12, EVIN_BITS=34, EVS_BITS=24, GCLK_NUM=8:7, PADDR_BITS=32, PADS_BITS=16, PDATA_BITS=32, TRIGOUT_BITS=22
PM at 0xffff0400
  pins: RSTM_N PD30
  parameters: PM_CLK_AHB_PEVC=1, PM_CLK_APB_NUM=3, WAKEUP_EN_KEYPAD=4, WAKEUP_EN_USB_DEVICE=4, CPU_MAX_FREQ=66000000, HSB_MAX_FREQ=66000000, PBA_MAX_FREQ=66000000, PBB_MAX_FREQ=66000000
  clocks: CPU OCD bit 0; HSB SAU bit 0, PDCA bit 1, MDMA bit 2, USBC bit 3, CANIF bit 4, HFLASHC bit 5, PBA bit 6, PBB bit 7, PBC bit 8, HSBRAM bit 9, EBI bit 10, MACB bit 11, PEVC bit 12; PBA INTC bit 0, PM bit 1, SCIF bit 2, AST bit 3, WDT bit 4, EIC bit 5, FREQM bit 6, GPIO bit 7, USART0 bit 8, USART2 bit 9, USART3 bit 10, SPI bit 11, TWIM0 bit 12, TWIM1 bit 13, TWIS0 bit 14, TWIS1 bit 15, IISC bit 16, PWM bit 17, QDEC0 bit 18, QDEC1 bit 19, TC1 bit 20, PEVC bit 21, ACIFA0 bit 22, ACIFA1 bit 23, DACIFB0 bit 24, DACIFB1 bit 25, AW bit 26; PBB FLASHC bit 0, USBC bit 1, HMATRIX bit 2, SAU bit 3, SMC bit 4, SDRAMC bit 5, MACB bit 6; PBC PDCA bit 0, MDMA bit 1, USART1 bit 2, SPI0 bit 3, CANIF bit 4, TC0 bit 5, ADCIFA bit 6, USART4 bit 7, TWIM2 bit 8, TWIS2 bit 9; CPU OCD bit 0; HSB SAU bit 0, PDCA bit 1, MDMA bit 2, USBC bit 3, CANIF bit 4, HFLASHC bit 5, PBA bit 6, PBB bit 7, PBC bit 8, HSBRAM bit 9, EBI bit 10, MACB bit 11, PEVC bit 12; PBA INTC bit 0, PM bit 1, SCIF bit 2, AST bit 3, WDT bit 4, EIC bit 5, FREQM bit 6, GPIO bit 7, USART0 bit 8, USART2 bit 9, USART3 bit 10, SPI bit 11, TWIM0 bit 12, TWIM1 bit 13, TWIS0 bit 14, TWIS1 bit 15, IISC bit 16, PWM bit 17, QDEC0 bit 18, QDEC1 bit 19, TC1 bit 20, PEVC bit 21, ACIFA0 bit 22, ACIFA1 bit 23, DACIFB0 bit 24, DACIFB1 bit 25, AW bit 26; PBB FLASHC bit 0, USBC bit 1, HMATRIX bit 2, SAU bit 3, SMC bit 4, SDRAMC bit 5, MACB bit 6; PBC PDCA bit 0, MDMA bit 1, USART1 bit 2, SPI0 bit 3, CANIF bit 4, TC0 bit 5, ADCIFA bit 6, USART4 bit 7, TWIM2 bit 8, TWIS2 bit 9
PWM at 0xffff4c00
  pins: PWMH3 PC11/A or PB15/C or PC11; PWML3 PC12/A or PB14/C or PC12; PWMH2 PC13/A or PC20/A or PB13/C or PC20; PWML2 PC14/A or PC19/A or PB12/C or PC19; PWMH1 PC15/A or PB11/C or PC15; PWML1 PC16/A or PB10/C or PC16; PWMH0 PC17/A or PB09/C or PC17; PWML0 PC18/A or PB08/C or PC18; EXT_FAULTS0 PC21/A or PB16/C or PC21; EXT_FAULTS1 PC22/A or PB17/C or PC22
  parameters: CHANNEL_NUM=4, CMP_NUM=8, EVT_NUM=2, EXT_FAULT_NUM=2, FAULT_NUM=5, GCLK_NUM=4, PADDR_MSB=14, PDATA_MSB=31, PDCA_ID_TX=27, REG_TX=PDCDATA, TRIGGER_NUM=2
QDEC0 at 0xffff5000 (QDEC)
  pins: QEPA PB27/A or PD02/D or PD09/D; QEPB PB28/A or PD03/D or PD10/D; QEPI PB29/A or PD00/D or PD07/D
  parameters: GCLK_NUM=5, PADDR_MSB=31, PDATA_MSB=31, QDEC_PADDR_SIZE=6
QDEC1 at 0xffff5400 (QDEC)
  pins: QEPB PC23/A or PB07/C or PD24/D; QEPA PC24/A or PB06/C or PD23/D; QEPI PC26/A or PB04/C or PD21/D
  parameters: GCLK_NUM=6, PADDR_MSB=31, PDATA_MSB=31, QDEC_PADDR_SIZE=6
SAU at 0xfffe2400, SAU_HSB 0x90000000 in hsb
  parameters: CHANNELS=16, CLK_AHB_ID=0
SCAN
  pins: SCAN_IN{n} PA{n+1:02} (n=0..8); SCAN_IN9 PA16; SCAN_IN10 PA19; SCAN_IN11 PA20; SCAN_OUT0 PA21; SCAN_OUT1 PA22; SCAN_OUT2 PA23; SCAN_OUT3 PB00; SCAN_OUT4 PB01; SCAN_OUT5 PB30; SCAN_OUT6 PB31; SCAN_OUT7 PC02; SCAN_OUT8 PC03; SCAN_OUT9 PC04; SCAN_OUT10 PC15; SCAN_OUT11 PC16; SCAN_OUT12 PC17; SCAN_IN12 PD03; SCAN_IN13 PD11; SCAN_IN14 PD12; SCAN_IN15 PD13; SCAN_OUT13 PD21; SCAN_OUT14 PD27; SCAN_OUT15 PD28; SCAN_CLOCKS0 PA00; SCAN_IO PA01 or PA02 or PA03 or PA04 or PA05 or PA06 or PA07 or PA08 or PA09 or PA16 or PA19 or PA20 or PA21 or PA22 or PA23 or PB00 or PB01 or PB30 or PB31 or PC02 or PC03 or PC04 or PC15 or PC16 or PC17 or PD03 or PD11 or PD12 or PD13 or PD21 or PD27 or PD28; SCAN_OUTPUT PA10 or PA11 or PA12 or PA13 or PA14 or PA15 or PA24 or PA25 or PA26 or PA27 or PA28 or PA29 or PB02 or PB03 or PB04 or PB05 or PB06 or PB07 or PB08 or PB09 or PB10 or PB11 or PB12 or PB13 or PB14 or PB15 or PB16 or PB17 or PB18 or PB19 or PB20 or PB21 or PB22 or PB23 or PB24 or PB25 or PB26 or PB27 or PB28 or PB29 or PC00 or PC01 or PC06 or PC07 or PC08 or PC09 or PC10 or PC11 or PC12 or PC13 or PC14 or PC21 or PC22 or PC23 or PC24 or PC25 or PC26 or PC27 or PC28 or PC29 or PC30 or PC31 or PD04 or PD05 or PD06 or PD07 or PD08 or PD09 or PD10 or PD15 or PD16 or PD17 or PD18 or PD19 or PD20 or PD22 or PD23 or PD24 or PD25 or PD26; SCAN_CLOCKS3 PC05; SCAN_ENABLE_FROM_PAD PC18; SCAN_CLOCKS1 PC19; SCAN_CLOCKS2 PC20; SCAN_CLOCKS4 PD00; SCAN_CLOCKS5 PD01; SCAN_CLOCKS6 PD02; SCAN_CLOCKS7 PD14; SCAN_OCC_MODE0 PD29
  parameters: SCAN_BURN_IN_IMPLEMENTED=0, SCAN_CHAIN_MSB=15, SCAN_CLK_MSB=7, SCAN_COMPRESSION_IMPLEMENTED=1, SCAN_OCC_IMPLEMENTED=0
SCIF at 0xffff0800
  pins: GCLK0 PA02/A or PC19/B or PB22/D or PC25/D or PD22/D; GCLK1 PA03/A or PC20/B or PB23/D or PC26/D; DN0 PB07; FDIV0 PB08; LOCK0 PB10; UP0 PB11; DN1 PB24; FDIV1 PB25; PLLCLK1 PB26; LOCK1 PB28; UP1 PB29; PLLCLK0 PD06; XIN0 PB30; XIN1 PB02; XIN32 PB00; XOUT0 PB31; XOUT1 PB03; XOUT32 PB01
  parameters: GCLK_NUM=12, GCLK_USBC=0, GCLK_CANIF=1, GCLK_AST=2, GCLK_PWM=4, GCLK_QDEC0=5, GCLK_QDEC1=6, GCLK_GCLK7=7, GCLK_GCLK8=8, GCLK_GCLK9=9, GCLK_GCLK10=10, GCLK_IISC=11, GCCTRL_OSCSEL_RCSYS=0, GCCTRL_OSCSEL_OSC32K=1, GCCTRL_OSCSEL_RC8M=2, GCCTRL_OSCSEL_OSC0=3, GCCTRL_OSCSEL_OSC1=4, GCCTRL_OSCSEL_PLL0=5, GCCTRL_OSCSEL_PLL1=6, GCCTRL_OSCSEL_CLK_CPU=7, GCCTRL_OSCSEL_CLK_HSB=8, GCCTRL_OSCSEL_CLK_PBA=9, GCCTRL_OSCSEL_CLK_PBB=10, GCCTRL_OSCSEL_CLK_PBC=11, OSC_NUM=2, PLL_NUM=2, RCOSC_FREQUENCY=115200, GCLK_EXT_NUM=2, GCLK_NUM_EXTCLK=10:9, GCLK_PEVC_NUM=2, GC_DIV_CLOCK=1, GC_NO_DIV_CLOCK=0, GPLP_NUM=2, PLL_MSB=1
SDRAMC at 0xfffe2c00
SMC at 0xfffe2800
SPI0 at 0xfffd1800 (SPI)
  pins: NPCS1 PC29/A or PA13/B or PB14/B or PC00/B or PC16/B; NPCS2 PC30/A or PB16/B or PC01/B or PC17/B; NPCS3 PC31/A or PB17/B or PC02/B; MOSI PD00/A or PD04/A or PB10/B; MISO PD01/A or PD05/A or PB11/B; SCK PD02/A or PD06/A or PB12/B; NPCS0 PD03/A or PA12/B or PB13/B or PB29/B or PC15/B
  parameters: CS_MSB=3, PDCA_ID_RX=10, PDCA_ID_TX=21
SPI1 at 0xffff3400 (SPI)
  pins: MOSI PB04/A or PB19/B or PB28/B; MISO PB05/A or PB20/B or PB27/B; SCK PB06/A or PB21/B or PB26/B; NPCS0 PB07/A or PA14/B or PB25/B; NPCS1 PB08/A or PA15/B or PB24/B or PC08/B; NPCS2 PB09/A or PA24/B or PB23/B or PC09/B; NPCS3 PC28/A or PA25/B or PB22/B or PC10/B
  parameters: CS_MSB=3, PDCA_ID_RX=11, PDCA_ID_TX=22
TC0 at 0xfffd2000 (TC)
  pins: CLK2 PB18/A or PD02/B or PC06/D; A0 PB19/A or PD15/A or PD27/D; B0 PB20/A or PD16/A or PD28/D; CLK1 PB21/A or PD26/A or PD01/D; A1 PB22/A or PD17/A or PD30/D; B1 PB23/A or PD18/A or PC04/D; CLK0 PB24/A or PD25/A or PC11/D or PD29/D; A2 PB25/A or PD19/A or PD22/B or PC05/D; B2 PB26/A or PD20/A or PD03/B or PC07/D
  parameters: APB_TIMER1_PADDR_MSB=2, CLK_DIV1=clk_32, CLK_DIV2=2, CLK_DIV3=8, CLK_DIV4=32, CLK_DIV5=128, PDATA_SIZE=2, PEVC=1
TC1 at 0xffff5800 (TC)
  pins: CLK2 PC25/B or PD08/D; B2 PC26/B or PC00/D; A2 PC27/B or PC01/D; CLK1 PC28/B or PC02/D; B1 PC29/B or PC03/D; A1 PC30/B or PB02/D; B0 PC31/B or PB28/D; CLK0 PD00/B or PB27/D; A0 PD01/B or PB29/D
  parameters: APB_TIMER1_PADDR_MSB=2, CLK_DIV1=clk_32, CLK_DIV2=2, CLK_DIV3=8, CLK_DIV4=32, CLK_DIV5=128, PDATA_SIZE=2, PEVC=0
TWIM0 at 0xffff3800 (TWIM)
  parameters: PDCA_ID_RX=6, PDCA_ID_TX=17
TWIM1 at 0xffff3c00 (TWIM)
  parameters: PDCA_ID_RX=7, PDCA_ID_TX=18
TWIM2 at 0xfffd2c00 (TWIM)
  parameters: PDCA_ID_RX=32, PDCA_ID_TX=35
TWIMS0
  pins: TWD PC02/A or PC02; TWCK PC03/A or PC03; TWALM PC06/F
TWIMS1
  pins: TWD PC04/A or PC04; TWCK PC05/A or PC05; TWALM PC07/F
TWIMS2
  pins: TWD PC06/E or PC06; TWCK PC07/E or PC07
TWIS0 at 0xffff4000 (TWIS)
  parameters: PDCA_ID_RX=8, PDCA_ID_TX=19
TWIS1 at 0xffff4400 (TWIS)
  parameters: PDCA_ID_RX=9, PDCA_ID_TX=20
TWIS2 at 0xfffd3000 (TWIS)
  parameters: PDCA_ID_RX=33, PDCA_ID_TX=36
USART0 at 0xffff2800 (USART)
  pins: CLK PB00/A or PC14/B or PD29/C; TXD PD27/A or PC16/D or PD00/E; RXD PD28/A or PC15/D or PD01/E; CTS PD29/A or PC14/D; RTS PD30/A or PC13/D
  parameters: CLK_DIV=8, PADDR_MSB=12, PDATA_MSB=31, PDCA_ID_RX=2, PDCA_ID_TX=13
USART1 at 0xfffd1400 (USART)
  pins: DTR PB10/A or PD07/A; DSR PB11/A or PD08/A; DCD PB12/A or PD09/A; RI PB13/A or PD10/A; RTS PB14/A or PD14/A; CTS PB15/A or PD13/A; RXD PB16/A or PD12/A; TXD PB17/A or PD11/A; CLK PB15/B or PD13/B or PB06/D
  parameters: CLK_DIV=8, PADDR_MSB=12, PDATA_MSB=31, PDCA_ID_RX=3, PDCA_ID_TX=14
USART2 at 0xffff2c00 (USART)
  pins: CLK PC06/B or PC12/D; CTS PC00/C or PC06/C; RTS PC01/C or PC07/C; RXD PC02/C or PC05/C; TXD PC03/C or PC04/C
  parameters: CLK_DIV=8, PADDR_MSB=12, PDATA_MSB=31, PDCA_ID_RX=4, PDCA_ID_TX=15
USART3 at 0xffff3000 (USART)
  pins: TXD PD21/A or PD15/B or PC17/F; RXD PD22/A or PD16/B or PC18/F; CTS PD23/A or PD17/B or PC19/F; RTS PD24/A or PD18/B or PC20/F; CLK PD23/B or PB05/D or PD17/D or PC22/E
  parameters: CLK_DIV=8, PADDR_MSB=12, PDATA_MSB=31, PDCA_ID_RX=5, PDCA_ID_TX=16
USART4 at 0xfffd2800 (USART)
  pins: TXD PC08/E or PC25/E or PD07/E; RXD PC09/E or PC26/E or PD08/E; CTS PC27/E or PD09/E; RTS PC28/E or PD10/E; CLK PC31/E or PD25/E
  parameters: CLK_DIV=8, PADDR_MSB=12, PDATA_MSB=31, PDCA_ID_RX=31, PDCA_ID_TX=34
USBC at 0xfffe1000
  pins: ID PC00/A or PA04/B or PB02/B or PD11/B or PD25/B; VBOF PC01/A or PA05/B or PB03/B or PD12/B or PD26/B
  parameters: CLK_AHB_ID=3, EPT_NBR=7, GCLK_NUM=0
WDT at 0xffff1000
FUSES at 0xFFFE0000 in fuses (FLASH_FUSES), USERPAGE_FUSES 0x80800000

## Interrupts
0 CORE_COMPARE_IRQ (CORE)
NMI EIC_IRQ_0 (EIC)
32 CORE_OCD_DCEMU_DIRTY_IRQ (CORE)
33 CORE_OCD_DCCPU_READ_IRQ (CORE)
64 SAU_IRQ (SAU)
96 PDCA_IRQ_0 (PDCA)
97 PDCA_IRQ_1 (PDCA)
98 PDCA_IRQ_2 (PDCA)
99 PDCA_IRQ_3 (PDCA)
128 PDCA_IRQ_4 (PDCA)
129 PDCA_IRQ_5 (PDCA)
130 PDCA_IRQ_6 (PDCA)
131 PDCA_IRQ_7 (PDCA)
160 PDCA_IRQ_8 (PDCA)
161 PDCA_IRQ_9 (PDCA)
162 PDCA_IRQ_10 (PDCA)
163 PDCA_IRQ_11 (PDCA)
192 PDCA_IRQ_12 (PDCA)
193 PDCA_IRQ_13 (PDCA)
194 PDCA_IRQ_14 (PDCA)
195 PDCA_IRQ_15 (PDCA)
224 MDMA_IRQ (MDMA)
256 USBC_IRQ (USBC)
288 CANIF_BOFF_IRQ_0 (CANIF)
289 CANIF_ERROR_IRQ_0 (CANIF)
290 CANIF_RXOK_IRQ_0 (CANIF)
291 CANIF_TXOK_IRQ_0 (CANIF)
292 CANIF_WAKEUP_IRQ_0 (CANIF)
293 CANIF_BOFF_IRQ_1 (CANIF)
294 CANIF_ERROR_IRQ_1 (CANIF)
295 CANIF_RXOK_IRQ_1 (CANIF)
296 CANIF_TXOK_IRQ_1 (CANIF)
297 CANIF_WAKEUP_IRQ_1 (CANIF)
320 HFLASHC_IRQ (HFLASHC)
352 SDRAMC_IRQ (SDRAMC)
384 PM_IRQ (PM)
416 SCIF_IRQ (SCIF)
448 AST_ALARM_IRQ (AST)
449 AST_CLKREADY_IRQ (AST)
450 AST_OVF_IRQ (AST)
451 AST_PER_IRQ (AST)
452 AST_READY_IRQ (AST)
480 EIC_IRQ_1 (EIC)
481 EIC_IRQ_2 (EIC)
482 EIC_IRQ_3 (EIC)
483 EIC_IRQ_4 (EIC)
512 EIC_IRQ_5 (EIC)
513 EIC_IRQ_6 (EIC)
514 EIC_IRQ_7 (EIC)
515 EIC_IRQ_8 (EIC)
544 FREQM_IRQ (FREQM)
{n+576} GPIO_IRQ_{n} (GPIO) (n=0..15)
608 USART0_IRQ (USART0)
640 USART1_IRQ (USART1)
672 USART2_IRQ (USART2)
704 USART3_IRQ (USART3)
736 SPI0_IRQ (SPI0)
768 SPI1_IRQ (SPI1)
800 TWIM0_IRQ (TWIM0)
832 TWIM1_IRQ (TWIM1)
864 TWIS0_IRQ (TWIS0)
896 TWIS1_IRQ (TWIS1)
928 IISC_IRQ (IISC)
960 PWM_IRQ (PWM)
992 QDEC0_IRQ (QDEC0)
1024 QDEC1_IRQ (QDEC1)
1056 TC0_IRQ0 (TC0)
1057 TC0_IRQ1 (TC0)
1058 TC0_IRQ2 (TC0)
1088 TC1_IRQ0 (TC1)
1089 TC1_IRQ1 (TC1)
1090 TC1_IRQ2 (TC1)
1120 PEVC_TR_IRQ (PEVC)
1121 PEVC_OV_IRQ (PEVC)
1152 ADCIFA_SEQ0_IRQ (ADCIFA)
1153 ADCIFA_SEQ1_IRQ (ADCIFA)
1154 ADCIFA_SUTD_IRQ (ADCIFA)
1155 ADCIFA_WINDOW_IRQ (ADCIFA)
1156 ADCIFA_AWAKEUP_IRQ (ADCIFA)
1157 ADCIFA_PENDET_IRQ (ADCIFA)
1184 ACIFA0_IRQ (ACIFA0)
1216 ACIFA1_IRQ (ACIFA1)
1248 DACIFB0_CHB_UNDERRUN_IRQ (DACIFB0)
1249 DACIFB0_CHB_OVERRUN_IRQ (DACIFB0)
1250 DACIFB0_CHB_DATA_EMPTY_IRQ (DACIFB0)
1251 DACIFB0_CHA_UNDERRUN_IRQ (DACIFB0)
1252 DACIFB0_CHA_OVERRUN_IRQ (DACIFB0)
1253 DACIFB0_CHA_DATA_EMPTY_IRQ (DACIFB0)
1280 DACIFB1_CHA_DATA_EMPTY_IRQ (DACIFB1)
1281 DACIFB1_CHA_OVERRUN_IRQ (DACIFB1)
1282 DACIFB1_CHA_UNDERRUN_IRQ (DACIFB1)
1283 DACIFB1_CHB_DATA_EMPTY_IRQ (DACIFB1)
1284 DACIFB1_CHB_OVERRUN_IRQ (DACIFB1)
1285 DACIFB1_CHB_UNDERRUN_IRQ (DACIFB1)
1312 AW_IRQ (AW)
1344 MACB_IRQ (MACB)
1408 USART4_IRQ (USART4)
1440 TWIM2_IRQ (TWIM2)
1472 TWIS2_IRQ (TWIS2)

## Properties
AVR32_RESET: NumberOfResetDomains=1, ResetGroup=3
SIGNATURES: JTAGID=0x200203f
