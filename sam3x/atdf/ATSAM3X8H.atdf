# ATSAM3X8H device description
Architecture: CORTEX-M3; Family: SAM3; Series: SAM3XA
Parameters: __CM3_REV=0x0200, __MPU_PRESENT=1, __FPU_PRESENT=0, __NVIC_PRIO_BITS=4, __Vendor_SysTickConfig=0
Programming and debug interfaces: JTAG, SWD
Registers are 32-bit, read-write, no defined reset value unless marked. A register's access mark holds for its fields unless they carry their own. Offsets are from the block's base; lines under a group give offsets from that group; [hi:lo] are bit positions; {n}, {i} and the like mark numbered series; 'fields as' and 'values as' point back to an identical list; <NAME> marks a mode.

## Ordering variants
ATSAM3X8H-CU: BGA217, up to 84 MHz, -40 to +85 C, 1.62 to 3.6 V

## Memory
base space: start 0 size 0x100000000, little endian
  0x40000000 PERIPHERALS size 0x20000000 io
  0xE0000000 SYSTEM size 0x10000000 io
  0x00080000 IFLASH0 size 0x00040000 flash, page 256
  0xC0000 IFLASH1 size 0x00040000 flash, page 256
  0x00100000 IROM size 0x00100000 rom
  0x20000000 IRAM0 size 0x00010000 ram
  0x20080000 IRAM1 size 0x00008000 ram
  0x20100000 NFC_RAM size 0x00100000 other
  0x20180000 UOTGHS_RAM size 0x00100000 other
  {0x60000000+0x1000000*n} EBI_CS{n} size 0x01000000 other (n=0..7)
fuses space: start 0 size 4, little endian
lockbits space: start 0 size 0x8, little endian

## Peripheral instances (address, pins/pin function, parameters)
ADC at 0x400C0000
  pins: ADTRG PA11/B; AD0 PA2/X1; AD1 PA3/X1; WKUP1 PA3/X1; AD2 PA4/X1; AD3 PA6/X1; AD4 PA22/X1; AD5 PA23/X1; AD6 PA24/X1; AD7 PA16/X1; AD8 PB12/X1; AD9 PB13/X1; AD10 PB17/X1; AD11 PB18/X1; AD12 PB19/X1; AD13 PB20/X1; AD14 PB21/X1; WKUP13 PB21/X1
CAN0 at 0x400B4000 (CAN)
  pins: CANRX0 PA1/A; CANTX0 PA0/A
CAN1 at 0x400B8000 (CAN)
  pins: CANRX1 PB15/A; CANTX1 PB14/A
CHIPID at 0x400E0940
DACC at 0x400C8000
  pins: DAC0 PB15/X1; WKUP12 PB15/X1; DAC1 PB16/X1; DATRG PA10/B
DMAC at 0x400C4000
EFC0 at 0x400E0A00 (EFC)
  parameters: FLASH_SIZE=262144, PAGE_SIZE=256, PAGES_PR_REGION=64
EFC1 at 0x400E0C00 (EFC)
  parameters: FLASH_SIZE=262144, PAGE_SIZE=256, PAGES_PR_REGION=64
EMAC at 0x400B0000
  pins: ECOL PC13/B; ECRS PC10/B; ECRSDV PB4/A; ERXDV PB4/A; EMDC PB8/A; EMDIO PB9/A; ERXCK PC14/B; ERXER PB7/A; ERX0 PB5/A; ERX1 PB6/A; ERX2 PC11/B; ERX3 PC12/B; ETXCK PB0/A; ETXEN PB1/A; ETXER PC17/B; ETX0 PB2/A; ETX1 PB3/A; ETX2 PC15/B; ETX3 PC16/B
GPBR at 0x400E1A90
HSMCI at 0x40000000
  pins: MCCDA PA20/A; MCCDB PE20/B; MCCK PA19/A; MCDA0 PA21/A; MCDA1 PA22/A; MCDA2 PA23/A; MCDA3 PA24/A; MCDA4 PD0/B; MCDA5 PD1/B; MCDA6 PD2/B; MCDA7 PD3/B; MCDB0 PE22/B; MCDB1 PE24/B; MCDB2 PE26/B; MCDB3 PE27/B
MATRIX at 0x400E0400
PIOA at 0x400E0E00 (PIO)
PIOB at 0x400E1000 (PIO)
PIOC at 0x400E1200 (PIO)
PIOD at 0x400E1400 (PIO)
PIOE at 0x400E1600 (PIO)
PIOF at 0x400E1800 (PIO)
PMC at 0x400E0600
  pins: PCK0 PA1/B or PB22/B; PCK1 PA24/B or PA30/B; PCK2 PA28/B or PA31/B
PWM at 0x40094000
  pins: PWMFI0 PA5/B; PWMFI1 PA3/B; PWMFI2 PD6/B; PWMH0 PA8/B or PB12/B or PC3/B or PE15/A; PWMH1 PA19/B or PB13/B or PC5/B or PE16/A; PWMH2 PA13/B or PB14/B or PC7/B; PWMH3 PA9/B or PB15/B or PC9/B or PF3/A; PWMH4 PC20/B or PE20/A; PWMH5 PC19/B or PE22/A; PWMH6 PC18/B or PE24/A; PWMH7 PE26/A; PWML0 PA21/B or PB16/B or PC2/B or PE18/A; PWML1 PA12/B or PB17/B or PC4/B; PWML2 PA20/B or PB18/B or PC6/B or PE17/A; PWML3 PA0/B or PB19/B or PC8/B; PWML4 PB6/B or PC21/B or PE19/A; PWML5 PB7/B or PC22/B or PE21/A; PWML6 PB8/B or PC23/B or PE23/A; PWML7 PB9/B or PC24/B or PE25/A
RSTC at 0x400E1A00
RTC at 0x400E1A60
RTT at 0x400E1A30
SDRAMC at 0x400E0200
SMC at 0x400E0000
SPI0 at 0x40008000 (SPI)
  pins: SPI0_MISO PA25/A; SPI0_MOSI PA26/A; SPI0_NPCS0 PA28/A; SPI0_NPCS1 PA29/A or PB20/B; SPI0_NPCS2 PA30/A or PB21/B; SPI0_NPCS3 PA31/A or PB23/B; SPI0_SPCK PA27/A
SPI1 at 0x4000C000 (SPI)
  pins: SPI1_MISO PE28/A; SPI1_MOSI PE29/A; SPI1_NPCS0 PE31/A; SPI1_NPCS1 PF0/A; SPI1_NPCS2 PF1/A; SPI1_NPCS3 PF2/A; SPI1_SPCK PE30/A
SSC at 0x40004000
  pins: RD PB18/A; RF PB17/A; RK PB19/A; TD PA16/B; TF PA15/B; TK PA14/B
SUPC at 0x400E1A10
TC0 at 0x40080000 (TC)
  pins: TCLK0 PB26/B; TCLK1 PA4/A; TCLK2 PA7/A; TIOA0 PB25/B; TIOA1 PA2/A; TIOA2 PA5/A; TIOB0 PB27/B; TIOB1 PA3/A; TIOB2 PA6/A
TC1 at 0x40084000 (TC)
  pins: TCLK3 PA22/B; TCLK4 PA23/B; TCLK5 PB16/A; TIOA3 PB0/B or PE9/A; TIOA4 PB2/B or PE11/A; TIOA5 PB4/B or PE13/A; TIOB3 PB1/B or PE10/A; TIOB4 PB3/B or PE12/A; TIOB5 PB5/B or PE14/A
TC2 at 0x40088000 (TC)
  pins: TCLK6 PC27/B; TCLK7 PC30/B; TCLK8 PD9/B; TIOA6 PC25/B; TIOA7 PC28/B; TIOA8 PD7/B; TIOB6 PC26/B; TIOB7 PC29/B; TIOB8 PD8/B
TRNG at 0x400BC000
TWI0 at 0x4008C000 (TWI)
  pins: TWCK0 PA18/A; TWD0 PA17/A
TWI1 at 0x40090000 (TWI)
  pins: TWCK1 PB13/A; TWD1 PB12/A
UART at 0x400E0800
  pins: URXD PA8/A; UTXD PA9/A
UOTGHS at 0x400AC000
  pins: UOTGID PB11/A; UOTGVBOF PB10/A
USART0 at 0x40098000 (USART)
  pins: CTS0 PB26/A; RTS0 PB25/A; RXD0 PA10/A; SCK0 PA17/B; TXD0 PA11/A
USART1 at 0x4009C000 (USART)
  pins: CTS1 PA15/A; RTS1 PA14/A; RXD1 PA12/A; SCK1 PA16/A; TXD1 PA13/A
USART2 at 0x400A0000 (USART)
  pins: CTS2 PB23/A; RTS2 PB22/A; RXD2 PB21/A; SCK2 PB24/A; TXD2 PB20/A
USART3 at 0x400A4000 (USART)
  pins: CTS3 PF4/A; RTS3 PF5/A; RXD3 PD5/B; SCK3 PE16/B; TXD3 PD4/B
WDT at 0x400E1A50
FUSES at GPNVMBITS 0 in fuses
LOCKBIT at 0 in lockbits
SystemControl at 0xE000E000
SysTick at 0xE000E010
NVIC at 0xE000E100

## Interrupts
-14 NonMaskableInt_IRQn — Non Maskable Interrupt
-12 MemoryManagement_IRQn — Cortex-M3 Memory Management Interrupt
-11 BusFault_IRQn — Cortex-M3 Bus Fault Interrupt
-10 UsageFault_IRQn — Cortex-M3 Usage Fault Interrupt
-5 SVCall_IRQn — Cortex-M3 SV Call Interrupt
-4 DebugMonitor_IRQn — Cortex-M3 Debug Monitor Interrupt
-2 PendSV_IRQn — Cortex-M3 Pend SV Interrupt
-1 SysTick_IRQn — Cortex-M3 System Tick Interrupt
0 SUPC (SYSC) — Supply Controller
1 RSTC (SYSC) — Reset Controller
2 RTC (SYSC) — Real Time Clock
3 RTT (SYSC) — Real Time Timer
4 WDT (SYSC) — Watchdog Timer
5 PMC — Power Management Controller
6 EFC0 — Enhanced Flash Controller 0
7 EFC1 — Enhanced Flash Controller 1
8 UART — Universal Asynchronous Receiver Transceiver
10 SDRAMC — Synchronous Dynamic RAM Controller
11 PIOA — Parallel I/O Controller A,
12 PIOB — Parallel I/O Controller B
13 PIOC — Parallel I/O Controller C
14 PIOD — Parallel I/O Controller D
15 PIOE — Parallel I/O Controller E
16 PIOF — Parallel I/O Controller F
17 USART0
18 USART1
19 USART2
20 USART3
21 HSMCI — Multimedia Card Interface
22 TWI0 — Two-Wire Interface 0
23 TWI1 — Two-Wire Interface 1
24 SPI0 — Serial Peripheral Interface
25 SPI1 — Serial Peripheral Interface
26 SSC — Synchronous Serial Controller
27 TC0 — Timer Counter 0
28 TC1 (TC0) — Timer Counter 1
29 TC2 (TC0) — Timer Counter 2
30 TC3 (TC1) — Timer Counter 3
31 TC4 (TC1) — Timer Counter 4
32 TC5 (TC1) — Timer Counter 5
33 TC6 (TC2) — Timer Counter 6
34 TC7 (TC2) — Timer Counter 7
35 TC8 (TC2) — Timer Counter 8
36 PWM — Pulse Width Modulation Controller
37 ADC — ADC Controller
38 DACC — DAC Controller
39 DMAC — DMA Controller
40 UOTGHS — USB OTG High Speed
41 TRNG — True Random Number Generator
42 EMAC — Ethernet MAC
43 CAN0 — CAN Controller 0
44 CAN1 — CAN Controller 1

## Properties
SIGNATURES: JTAGID=0x05B2B03F, CHIPID_CIDR=0x286E0A60, CHIPID_EXID=0x0

## Notices in the file
SAM Software Package License
Copyright (c) %copyright_year%, Atmel Corporation
All rights reserved.
Redistribution and use in source and binary forms, with or without
modification, are permitted provided that the following condition is met:
- Redistributions of source code must retain the above copyright notice,
this list of conditions and the disclaimer below.
Atmel's name may not be used to endorse or promote products derived from
this software without specific prior written permission.
DISCLAIMER:  THIS SOFTWARE IS PROVIDED BY ATMEL "AS IS" AND ANY EXPRESS OR
IMPLIED WARRANTIES, INCLUDING, BUT NOT LIMITED TO, THE IMPLIED WARRANTIES OF
MERCHANTABILITY, FITNESS FOR A PARTICULAR PURPOSE AND NON-INFRINGEMENT ARE
DISCLAIMED. IN NO EVENT SHALL ATMEL BE LIABLE FOR ANY DIRECT, INDIRECT,
INCIDENTAL, SPECIAL, EXEMPLARY, OR CONSEQUENTIAL DAMAGES (INCLUDING, BUT NOT
LIMITED TO, PROCUREMENT OF SUBSTITUTE GOODS OR SERVICES; LOSS OF USE, DATA,
OR PROFITS; OR BUSINESS INTERRUPTION) HOWEVER CAUSED AND ON ANY THEORY OF
LIABILITY, WHETHER IN CONTRACT, STRICT LIABILITY, OR TORT (INCLUDING
NEGLIGENCE OR OTHERWISE) ARISING IN ANY WAY OUT OF THE USE OF THIS SOFTWARE,
EVEN IF ADVISED OF THE POSSIBILITY OF SUCH DAMAGE.
