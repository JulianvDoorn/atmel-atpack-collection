# ATSAM4N16C device description
Architecture: CORTEX-M4; Family: SAM4; Series: SAM4N
Parameters: __CM4_REV=0x0001, __MPU_PRESENT=1, __FPU_PRESENT=0, __NVIC_PRIO_BITS=4, __Vendor_SysTickConfig=0
Programming and debug interfaces: JTAG, SWD
Registers are 32-bit, read-write, no defined reset value unless marked. A register's access mark holds for its fields unless they carry their own. Offsets are from the block's base; lines under a group give offsets from that group; [hi:lo] are bit positions; {n}, {i} and the like mark numbered series; 'fields as' and 'values as' point back to an identical list; <NAME> marks a mode.

## Ordering variants
ATSAM4N16C-AU: LQFP100, up to 120 MHz, -40 to +85 C, 1.62 to 3.6 V
ATSAM4N16C-CU: TFBGA100, up to 120 MHz, -40 to +85 C, 1.62 to 3.6 V
ATSAM4N16C-CFU: VFBGA100, up to 120 MHz, -40 to +85 C, 1.62 to 3.6 V

## Memory
base space: start 0 size 0x100000000, little endian
  0x40000000 PERIPHERALS size 0x20000000 io
  0xE0000000 SYSTEM size 0x10000000 io
  0x00400000 IFLASH size 0x00100000 flash, page 512
  0x00800000 IROM size 0x00400000 rom
  0x20000000 IRAM size 0x00014000 ram
fuses space: start 0 size 1, little endian
lockbits space: start 0 size 0x10, little endian

## Peripheral instances (address, pins/pin function, parameters)
ADC at 0x40038000
  pins: ADTRG PA8/B; AD0 PA17/X1; AD1 PA18/X1; AD2 PA19/X1; WKUP9 PA19/X1; AD3 PA20/X1; WKUP10 PA20/X1; AD4 PB0/X1; AD5 PB1/X1; AD6 PB2/X1; WKUP12 PB2/X1; AD7 PB3/X1; AD8 PA21/X1; AD9 PA22/X1; AD10 PC13/X1; AD11 PC15/X1; AD12 PC12/X1; AD13 PC29/X1; AD14 PC30/X1; AD15 PC31/X1
CHIPID at 0x400E0740
DACC at 0x4003C000
  pins: DAC0 PB13/X1; DATRG PA2/C
EFC at 0x400E0A00
  parameters: FLASH_SIZE=1048576, PAGE_SIZE=512, PAGES_PR_REGION=16
GPBR at 0x400E1490
MATRIX at 0x400E0200
PIOA at 0x400E0E00 (PIO)
PIOB at 0x400E1000 (PIO)
PIOC at 0x400E1200 (PIO)
PMC at 0x400E0400
  pins: PCK0 PA6/B or PB13/B or PC16/B; PCK1 PA17/B or PA21/B or PC17/B; PCK2 PA18/B or PA31/B or PB3/B or PC14/B
PWM at 0x40020000
  pins: PWM0 PA0/A or PA11/B or PA23/B or PB0/A or PC8/B or PC18/B or PC22/B; PWM1 PA1/A or PA12/B or PA24/B or PB1/A or PC9/B or PC19/B; PWM2 PA2/A or PA13/B or PA25/B or PB4/B or PC10/B or PC20/B; PWM3 PA7/B or PA14/B or PB14/B or PC11/B or PC21/B
RSTC at 0x400E1400
RTC at 0x400E1460
RTT at 0x400E1430
SPI at 0x40008000
  pins: MISO PA12/A; MOSI PA13/A; NPCS0 PA11/A; NPCS1 PA9/B or PA31/A or PB14/A or PC4/B; NPCS2 PA10/B or PA30/B or PB2/B or PC7/B; NPCS3 PA3/B or PA5/B or PA22/B; SPCK PA14/A
SUPC at 0x400E1410
TC0 at 0x40010000 (TC)
  pins: TCLK0 PA4/B; TCLK1 PA28/B; TCLK2 PA29/B; TIOA0 PA0/B; TIOA1 PA15/B; TIOA2 PA26/B; TIOB0 PA1/B; TIOB1 PA16/B; TIOB2 PA27/B
TC1 at 0x40014000 (TC)
  pins: TCLK3 PC25/B; TCLK4 PC28/B; TCLK5 PC31/B; TIOA3 PC23/B; TIOA4 PC26/B; TIOA5 PC29/B; TIOB3 PC24/B; TIOB4 PC27/B; TIOB5 PC30/B
TWI0 at 0x40018000 (TWI)
  pins: TWCK0 PA4/A; TWD0 PA3/A
TWI1 at 0x4001C000 (TWI)
  pins: TWCK1 PB5/A; TWD1 PB4/A
TWI2 at 0x40040000 (TWI)
  pins: TWCK2 PB1/B; TWD2 PB0/B
UART0 at 0x400E0600 (UART)
  pins: URXD0 PA9/A; UTXD0 PA10/A
UART1 at 0x400E0800 (UART)
  pins: URXD1 PB2/A; UTXD1 PB3/A
UART2 at 0x40044000 (UART)
  pins: URXD2 PA16/A; UTXD2 PA15/A
UART3 at 0x40048000 (UART)
  pins: URXD3 PB10/B; UTXD3 PB11/B
USART0 at 0x40024000 (USART)
  pins: CTS0 PA8/A; RTS0 PA7/A; RXD0 PA5/A; SCK0 PA2/B; TXD0 PA6/A
USART1 at 0x40028000 (USART)
  pins: CTS1 PA25/A; RTS1 PA24/A; RXD1 PA21/A; SCK1 PA23/A; TXD1 PA22/A
USART2 at 0x4002C000 (USART)
  pins: CTS2 PC17/A; RTS2 PC16/A; RXD2 PC9/A; SCK2 PC14/A; TXD2 PC10/A
WDT at 0x400E1450
FUSES at GPNVMBITS 0 in fuses
LOCKBIT at 0 in lockbits
SystemControl at 0xE000E000
SysTick at 0xE000E010
NVIC at 0xE000E100
MPU at 0xE000ED90

## Interrupts
-14 NonMaskableInt_IRQn — Non Maskable Interrupt
-13 HardFault_IRQn — HardFault Interrupt
-12 MemoryManagement_IRQn — Cortex-M4 Memory Management Interrupt
-11 BusFault_IRQn — Cortex-M4 Bus Fault Interrupt
-10 UsageFault_IRQn — Cortex-M4 Usage Fault Interrupt
-5 SVCall_IRQn — Cortex-M4 SV Call Interrupt
-4 DebugMonitor_IRQn — Cortex-M4 Debug Monitor Interrupt
-2 PendSV_IRQn — Cortex-M4 Pend SV Interrupt
-1 SysTick_IRQn — Cortex-M4 System Tick Interrupt
0 SUPC (SYSC) — Supply Controller
1 RSTC (SYSC) — Reset Controller
2 RTC (SYSC) — Real Time Clock
3 RTT (SYSC) — Real Time Timer
4 WDT (SYSC) — Watchdog Timer
5 PMC — Power Management Controller
6 EFC — Enhanced Flash Controller
8 UART0
9 UART1
10 UART2
11 PIOA — Parallel I/O Controller A
12 PIOB — Parallel I/O Controller B
13 PIOC — Parallel I/O Controller C
14 USART0
15 USART1
16 UART3
17 USART2
19 TWI0 — Two Wire Interface 0
20 TWI1 — Two Wire Interface 1
21 SPI — Serial Peripheral Interface
22 TWI2 — Two Wire Interface 2
23 TC0 — Timer/Counter 0
24 TC1 (TC0) — Timer/Counter 1
25 TC2 (TC0) — Timer/Counter 2
26 TC3 (TC1) — Timer/Counter 3
27 TC4 (TC1) — Timer/Counter 4
28 TC5 (TC1) — Timer/Counter 5
29 ADC — Analog To Digital Converter
30 DACC — Digital To Analog Converter
31 PWM — Pulse Width Modulation

## Properties
SIGNATURES: JTAGID=0x05B3603F, CHIPID_CIDR=0x29560CE0, CHIPID_EXID=0x0

## Notices in the file
SAM Software Package License
Copyright (c) %copyright_year%, Atmel Corporation
All rights reserved.
Redistribution and use in source and binary forms, with or without
modification, are permitted provided that the following condition is met:
- Redistributions of source code must retain the above copyright notice,
this list of conditions and the disclaimer below.
Atmel's name may not be used to endorse or promote products derived from
this software without specific prior written permission.
DISCLAIMER:  THIS SOFTWARE IS PROVIDED BY ATMEL "AS IS" AND ANY EXPRESS OR
IMPLIED WARRANTIES, INCLUDING, BUT NOT LIMITED TO, THE IMPLIED WARRANTIES OF
MERCHANTABILITY, FITNESS FOR A PARTICULAR PURPOSE AND NON-INFRINGEMENT ARE
DISCLAIMED. IN NO EVENT SHALL ATMEL BE LIABLE FOR ANY DIRECT, INDIRECT,
INCIDENTAL, SPECIAL, EXEMPLARY, OR CONSEQUENTIAL DAMAGES (INCLUDING, BUT NOT
LIMITED TO, PROCUREMENT OF SUBSTITUTE GOODS OR SERVICES; LOSS OF USE, DATA,
OR PROFITS; OR BUSINESS INTERRUPTION) HOWEVER CAUSED AND ON ANY THEORY OF
LIABILITY, WHETHER IN CONTRACT, STRICT LIABILITY, OR TORT (INCLUDING
NEGLIGENCE OR OTHERWISE) ARISING IN ANY WAY OUT OF THE USE OF THIS SOFTWARE,
EVEN IF ADVISED OF THE POSSIBILITY OF SUCH DAMAGE.
