# AT32UC3L064 device description
Architecture: AVR32_UC3; Family: AVR UC3
Programming and debug interfaces: JTAG, aWire
Registers are 32-bit, read-write, reset 0x0 unless marked. A register's access mark holds for its fields unless they carry their own. Offsets are from the block's base; lines under a group give offsets from that group; [hi:lo] are bit positions; {n}, {i} and the like mark numbered series; 'fields as' and 'values as' point back to an identical list; <NAME> marks a mode.

## Ordering variants
standard: up to 50 MHz, 1.62 to 3.6 V

## Memory
sysreg space: start 0 size 1024, big endian
dbgreg space: start 0 size 1024
base space: start 0 size 0x100000000, big endian
  0x80000000 FLASH size 0x00010000 flash
  0x80800000 USER_PAGE size 0x00000100 user_page
  0x90000000 SAU_SLAVE size 0x00010000 other
  0x00000000 SRAM size 0x00004000 ram
  0xfffe0000 IO size 0x20000 io, rw
fuses space: start 0xFFFE0018 size 4, big endian

## Peripheral instances (address, pins/pin function, parameters)
CORE at 0 in sysreg
OCD at 0 in dbgreg
INTC at 0xFFFF1000
  parameters: NUM_INT_GRPS=31, NUM_IRQS_PER_GRP0=1, NUM_IRQS_PER_GRP1=2, NUM_IRQS_PER_GRP2=1, NUM_IRQS_PER_GRP3=1, NUM_IRQS_PER_GRP4=4, NUM_IRQS_PER_GRP5=4, NUM_IRQS_PER_GRP6=4, NUM_IRQS_PER_GRP7=1, NUM_IRQS_PER_GRP8=1, NUM_IRQS_PER_GRP9=1, NUM_IRQS_PER_GRP10=4, NUM_IRQS_PER_GRP11=4, NUM_IRQS_PER_GRP12=1, NUM_IRQS_PER_GRP13=1, NUM_IRQS_PER_GRP14=6, NUM_IRQS_PER_GRP{n}=1 (n=15..24), NUM_IRQS_PER_GRP25=3, NUM_IRQS_PER_GRP26=3, NUM_IRQS_PER_GRP27=1, NUM_IRQS_PER_GRP28=1, NUM_IRQS_PER_GRP29=1, NUM_IRQS_PER_GRP30=1
ACIFB at 0xffff6400
  pins: ACAP0 PA01/F; ACBP0 PA02/F; ACBN3 PA03/F; ACBP1 PA04/F; ACBN0 PA05/F; ACAN0 PA07/F; ACAP1 PA10/F; ACAN1 PA12/F; ACREFN0 PA16/F; ACBN2 PA22/F; ACAP2 PB00/F; ACAN2 PB02/F; ACBP2 PB03/F; ACAN3 PB06/F; ACAP3 PB07/F; ACBN1 PB09/F; ACBP3 PB12/F
  parameters: AC_A_MSB=3, AC_B_MSB=3, AC_MSB=7
ADCIFB at 0xffff6000
  pins: PRND0 PA12/A; AD0 PA14/A; AD1 PA15/A; AD2 PA16/A; AD3 PA17/A; AD4 PA18/A; AD5 PA19/A; TRIGGER0 PA02/B or PA21/D or PB11/D; ADP0 PB00/B or PA08/D; ADP1 PB01/B or PA09/D; AD6 PB06/C; AD7 PB07/C; AD8 PB08/C
  parameters: ADCIFB_ADC_DATA_MSB=9, ADCIFB_NCH_LOG2_MSB=3, ADCIFB_NCH_MSB=9, PADDR_MSB=10, PDATA_MSB=32
AST at 0xffff1c00
  parameters: CLK32=1, GCLK_NUM=2, GENCLK=3, PB=2, RCOSC=0
AW at 0xffff7000
  pins: DATAOUT0 PA00
  parameters: PDCA_ID_RX=13, PDCA_ID_TX=30
CAT at 0xffff6800
  pins: SMP0 PA12/D or PA14/D or PA22/D or PA13/F or PA17/F or PA21/H; SYNC0 PB12/D or PA15/F or PA18/F or PB08/F or PA19/G; VDIVEN0 PB11/F; DIS0 PA17/G; CSA2 PA00/H; CSA1 PA01/H; CSA3 PA02/H; CSB3 PA03/H; CSA7 PA04/H; CSB7 PA05/H; CSB1 PA06/H; CSB2 PA07/H; CSA4 PA08/H; CSB4 PA09/H; CSA5 PA10/H; CSB5 PA12/H; CSA0 PA13/H; CSA6 PA14/H; CSB6 PA15/H; CSA8 PA16/H; CSB8 PA17/H; CSB0 PA18/H; CSA10 PA19/H; CSA12 PA20/H; CSB10 PA22/H; CSA9 PB00/H; CSB9 PB01/H; CSB11 PB02/H; CSA11 PB03/H; CSA14 PB04/H; CSB14 PB05/H; CSB13 PB06/H; CSA13 PB07/H; CSB12 PB08/H; CSB15 PB09/H; CSB16 PB10/H; CSA16 PB11/H; CSA15 PB12/H
  parameters: CAT_SENSORS_MSB=16
EIC at 0xffff2400
  pins: EXTINT0 PA07/G or PB06/G; EXTINT1 PA09/G or PB07/G; EXTINT2 PA13/G or PB08/G; EXTINT3 PA15/G or PB09/G; EXTINT4 PA16/G or PB10/G; EXTINT5 PA18/G or PB11/G
  parameters: INT_MSB=5, SCAN_MSB=0, STD_NUM=5
FLASHCDW at 0xfffe0000
  pins: EXTCLK0 PA16; LATDEL0 PA06 or PB05; LATDELCLK0 PA09 or PB01; LATDELMATCH0 PA10; VMARGIN0 PA06; VMDIV0 PA07; FLASH_OBS11 PA04; FLASH_OBS21 PA05; FLASH_OBS13 PA06; FLASH_OBS14 PA07; FLASH_OBS15 PA08; FLASH_OBS16 PA09; FLASH_OBS17 PA10; FLASH_OBS18 PA11; FLASH_OBS20 PA12; FLASH_OBS6 PA13; FLASH_OBS7 PA14; FLASH_OBS22 PA15; FLASH_OBS9 PA16; FLASH_OBS10 PA17; FLASH_OBS2 PA18; FLASH_OBS3 PA19; FLASH_OBS4 PA20; FLASH_OBS0 PA21; FLASH_OBS1 PA22; FLASH_OBS5 PB00; FLASH_OBS8 PB01; FLASH_OBS12 PB02; FLASH_OBS19 PB03
  parameters: FLASH_SIZE=65536, PAGES_PR_REGION=16, PAGE_SIZE=256, USER_PAGE=((volatile unsigned char*) AVR32_FLASHC_USER_PAGE_ADDRESS), USER_PAGE_ADDRESS=0x80800000, USER_PAGE_SIZE=256, FWS_0_MAX_FREQ=25000000, FWS_1_MAX_FREQ=50000000, IC9692=true
FREQM at 0xffff2800
  parameters: CPU=0, CRIPEL=0, CRIPOSC=8, DFLL0=7, GENCLKDIV{n}=0 (n=0..10), GENCLK{n}={n+9} (n=0..5), GENCLK{n}=0 (n=6..10), HSB=1, NUM_CLK=17, OSC0=4, OSC1=0, OSC2=0, OSC3=0, OSC4=0, OSC32=5, PBA=2, PBB=3, PBC=0, PLL0=0, PLL1=0, PLL2=0, PLL3=0, RCOSC=6, RCOSC8=0, RC32K=17, RC120M=16, RC120M_AW=15, REFSEL_BITS=1, REF_OSC0=0, REF_OSC1=0, REF_OSC2=0, REF_OSC32=1, REF_RCOSC=0, REF_RCOSC8=0
GLOC at 0xffff6c00
  pins: OUT0 PA13/A; IN7 PA13/B; IN6 PA15/D; IN5 PA16/D; IN4 PA18/D; IN3 PA20/D; IN2 PB06/D; IN1 PB07/D; IN0 PB08/D; OUT1 PB10/D
  parameters: GCLK_NUM=5, INPUT_PINS_MSB=7, LUTS=2, OUTPUT_PINS_MSB=1
GPIO at 0xffff2c00
  pins: P{n} PA{n:02} (n=0..22); P{n} PB{n-32:02} (n=32..44)
  parameters: GPIO_IRQ_MSB=5, GPIO_MAX_IRQ_MSB=5, GPIO_PADDR_BITS=10, GPIO_PINS_MSB=36, IRQS_PER_GROUP=8, NUMBER_OF_PINS=37, PADDR_MSB=9, PDATA_MSB=31, PORT_LENGTH=2
HMATRIXB at 0xfffe0400
  parameters: MASTER_CPU_DATA=0, MASTER_CPU_INSN=1, MASTER_CPU_SAB=2, MASTER_PDCA=3, MASTER_SAU=4, SLAVE_FLASH=0, SLAVE_PBA=1, SLAVE_PBB=2, SLAVE_SRAM=3, SLAVE_SAU=4, MASTER_NUM=5, SLAVE_NUM=5
JTAG
  pins: TCK0 PA00; TMS0 PA01; TDO0 PA02; TDI0 PA03
PDCA at 0xffff0000
  parameters: CHANNEL_LENGTH=12, HADDR_MSB=31, HDATA_MSB=31, PADDR_MSB=31, PDATA_MSB=31, PDCA_CHANNELS_MSB=11, PID_AC97C_RXA=-1, PID_AC97C_RXB=-1, PID_AC97C_TXA=-1, PID_AC97C_TXB=-1, PID_ADC_RX=9, PID_AW_RX=10, PID_AW_TX=21, PID_CAT_ACOUNT=11, PID_CAT_MBLEN=22, PID_MCI_RX=-1, PID_SPI0_RX=4, PID_SPI0_TX=16, PID_SPI1_RX=-1, PID_SPI1_TX=-1, PID_SPI2_RX=-1, PID_SPI2_TX=-1, PID_SPI3_RX=-1, PID_SPI3_TX=-1, PID_SSC_RX=1, PID_SSC_TX=-1, PID_SSC0_RX=-1, PID_SSC0_TX=-1, PID_SSC1_RX=-1, PID_SSC1_TX=-1, PID_SSC2_RX=-1, PID_SSC2_TX=-1, PID_TSADCC_RX=-1, PID_TWIM0_RX=5, PID_TWIM0_TX=17, PID_TWIM1_RX=6, PID_TWIM1_TX=18, PID_TWIS0_RX=7, PID_TWIS0_TX=19, PID_TWIS1_RX=8, PID_TWIS1_TX=20, PID_TWI_RX=-1, PID_TWI_TX=-1, PID_TWI0_RX=-1, PID_TWI0_TX=-1, PID_TWI1_RX=-1, PID_TWI1_TX=-1, PID_USART0_RX=0, PID_USART0_TX=12, PID_USART1_RX=1, PID_USART1_TX=13, PID_USART2_RX=2, PID_USART2_TX=14, PID_USART3_RX=3, PID_USART3_TX=15, PID_USART4_RX=-1, PID_USART4_TX=-1, PID_USART5_RX=-1, PID_USART5_TX=-1
PM at 0xffff1400
  pins: RSTM_N0 PA06
  parameters: MCCTRL_MCSEL_CRIPOSC=4, MCCTRL_MCSEL_DFLL0=2, MCCTRL_MCSEL_OSC0=1, MCCTRL_MCSEL_RC120M=3, MCCTRL_MCSEL_SLOW=0, PM_CLK_AHB_PEVC=0, PM_CLK_APB_NUM=2, WAKEUP_EN_KEYPAD=0, WAKEUP_EN_USB_DEVICE=0, CPU_MAX_FREQ=50000000, HSB_MAX_FREQ=50000000, PBA_MAX_FREQ=50000000, PBB_MAX_FREQ=50000000
  clocks: CPU OCD bit 0, SYSTIMER bit 16; HSB PDCA bit 0, FLASHCDW bit 1, SAU bit 2, PBB bit 3, PBA bit 4, PES bit 5; PBA PDCA bit 0, INTC bit 1, PM bit 2, SCIF bit 3, AST bit 4, WDT bit 5, EIC bit 6, FREQM bit 7, GPIO bit 8, USART0 bit 9, USART1 bit 10, USART2 bit 11, USART3 bit 12, SPI bit 13, TWIM0 bit 14, TWIM1 bit 15, TWIS0 bit 16, TWIS1 bit 17, PWMA bit 18, TC0 bit 19, TC1 bit 20, ADCIFB bit 21, ACIFB bit 22, CAT bit 23, GLOC bit 24, AW bit 25; PBB FLASHCDW bit 0, HMATRIX bit 1, SAU bit 2
PULLUP
  pins: LPC_PULLUP0 PA19 or PA20 or PA21 or PA22 or PB00 or PB01 or PB02 or PB03 or PB04 or PB05 or PB06 or PB07 or PB08 or PB09 or PB10 or PB11 or PB12; OUTPUT_ONE0 PA05 or PA07 or PA17 or PA21 or PB04 or PB05
PWMA at 0xffff5400
  pins: PWMA{n} PA{n:02}/E (n=0..22); PWMA{n} PB{n-23:02}/E (n=23..35); PWMAOD21 PA21/F; PWMAOD27 PB04/F; PWMAOD28 PB05/F
  parameters: PWMA_CHANNELS_MSB=35, PWMA_CH_SYNC_EVT=0, PWMA_NUM_CHANNELS=36, PWMA_NUM_IRQS=0
SAU at 0xfffe0800, SAU_HSB 0x0000 in hsb
  parameters: CHANNELS=63
SCAN
  pins: SCAN_IN0 PA01; SCAN_IN1 PA02; SCAN_IN2 PA03; SCAN_IN3 PA08; SCAN_IN4 PA09; SCAN_IN5 PA10; SCAN_IN6 PA11; SCAN_OUT0 PA12; SCAN_OUT1 PA13; SCAN_OUT2 PA14; SCAN_OUT3 PA15; SCAN_OUT4 PA16; SCAN_OUT5 PA17; SCAN_OUT6 PA18; SCAN_CLOCKS0 PA00; SCAN_CLOCKS1 PA04; SCAN_ENABLE_FROM_PAD0 PA05; SCAN_OCC_MODE0 PA07
  parameters: SCAN_BURN_IN_IMPLEMENTED=0, SCAN_CHAIN_MSB=6, SCAN_CLK_MSB=1, SCAN_COMPRESSION_IMPLEMENTED=1, SCAN_OCC_IMPLEMENTED=0
SCIF at 0xffff1800
  pins: GCLK2 PA13/D or PA09/F or PA10/G; RC32OUT0 PA20/F; GCLK0 PA00/G or PA21/G; GCLK1 PA06/G or PB02/G; GCLK3 PA12/G or PB05/G; GCLK4 PA14/G or PB12/G; XIN00 PA08; XIN320 PA10; XIN32_20 PA13; XOUT00 PA09; XOUT320 PA12; XOUT32_20 PA20
  parameters: BR_NUM=4, GCLK_NUM=6, GCLK_DFLLIF_REF=0, GCLK_DFLLIF_DITHER=1, GCLK_AST=2, GCLK_PWMA=3, GCLK_ACIFB=4, GCLK_CAT=4, GCLK_GLOC=5, GCCTRL_OSCSEL_RCSYS=0, GCCTRL_OSCSEL_OSC32K=1, GCCTRL_OSCSEL_DFLL0=2, GCCTRL_OSCSEL_OSC0=3, GCCTRL_OSCSEL_RC120M=4, GCCTRL_OSCSEL_CLK_CPU=5, GCCTRL_OSCSEL_CLK_HSB=6, GCCTRL_OSCSEL_CLK_PBA=7, GCCTRL_OSCSEL_CLK_PBB=8, GCCTRL_OSCSEL_RC32K=9, GCCTRL_OSCSEL_CLK_1K=11, OSC_NUM=2, PLL_NUM=2, RCOSC_FREQUENCY=115200
SPI at 0xffff4000
  pins: MISO0 PA04/A or PB02/C; MOSI0 PA05/A or PB03/C; SCK0 PA06/A or PB01/C; NPCS0 PA07/A or PB00/C; NPCS1 PA03/B; NPCS2 PA08/B or PA00/C; NPCS3 PA09/B or PA01/C
  parameters: CS_MSB=3, PDCA_ID_RX=11, PDCA_ID_TX=11
TC0 at 0xffff5800 (TC)
  pins: CLK20 PA14/B; CLK10 PA15/B or PA12/C; CLK00 PA16/B; A10 PA17/B or PA20/C or PA05/D or PB00/D; B10 PA18/B or PA21/C or PA04/D or PB01/D; A20 PA08/C or PA19/C or PB02/D; B20 PA09/C or PA22/C or PB03/D; A00 PA10/C or PA13/C or PA02/D; B00 PA03/D or PA06/D
  parameters: CLK_DIV1=clk_32, CLK_DIV2=2, CLK_DIV3=8, CLK_DIV4=32, CLK_DIV5=128, PEVC=0
TC1 at 0xffff5c00 (TC)
  pins: A00 PB04/A or PB00/G; B00 PB05/A; A10 PB06/A or PB01/G; B10 PB07/A; A20 PB08/A or PB03/G; B20 PB09/A; CLK00 PB10/A; CLK10 PB11/A; CLK20 PB12/A
  parameters: CLK_DIV1=clk_32, CLK_DIV2=2, CLK_DIV3=8, CLK_DIV4=32, CLK_DIV5=128, PEVC=0
TWIM0 at 0xffff4400 (TWIM)
  parameters: PDCA_ID_RX=7, PDCA_ID_TX=18
TWIM1 at 0xffff4800 (TWIM)
  parameters: PDCA_ID_RX=7, PDCA_ID_TX=18
TWIMS0
  pins: TWD0 PA10/A or PA21/B or PA05/G; TWCK0 PA04/B or PA20/B or PA07/D or PB05/D; TWALM0 PB04/D or PA01/G
TWIMS1
  pins: TWCK0 PA05/B or PB04/G; TWALM0 PA07/C or PB12/C or PA19/D; TWD0 PA17/D
TWIS0 at 0xffff4c00 (TWIS)
  parameters: PDCA_ID_RX=9, PDCA_ID_TX=20
TWIS1 at 0xffff5000 (TWIS)
  parameters: PDCA_ID_RX=9, PDCA_ID_TX=20
USART0 at 0xffff3000 (USART)
  pins: TXD0 PA00/A; RXD0 PA01/A; RTS0 PA02/A; CTS0 PA03/A or PA22/A; CLK0 PA02/G or PA03/G
  parameters: CLK_DIV=8, PADDR_MSB=12, PDATA_MSB=31, PDCA_ID_RX=3, PDCA_ID_TX=14
USART1 at 0xffff3400 (USART)
  pins: TXD0 PA08/A or PB10/B or PA05/C; RXD0 PA09/A or PB11/B or PA04/C; RTS0 PA00/B or PB04/B; CTS0 PA01/B or PB05/B; CLK0 PA06/C or PB04/C or PB05/C or PA01/D
  parameters: CLK_DIV=8, PADDR_MSB=12, PDATA_MSB=31, PDCA_ID_RX=3, PDCA_ID_TX=14
USART2 at 0xffff3800 (USART)
  pins: TXD0 PA20/A or PA06/B or PA02/C or PA03/C; RXD0 PA21/A or PA07/B; CLK0 PA12/B or PA22/B; RTS0 PA14/C; CTS0 PA17/C
  parameters: CLK_DIV=8, PADDR_MSB=12, PDATA_MSB=31, PDCA_ID_RX=3, PDCA_ID_TX=14
USART3 at 0xffff3c00 (USART)
  pins: TXD0 PB00/A or PB06/B; RXD0 PB01/A or PB07/B; RTS0 PB02/A or PB08/B; CTS0 PB03/A or PB09/B; CLK0 PB02/B or PB03/B or PB09/C or PB10/C
  parameters: CLK_DIV=8, PADDR_MSB=12, PDATA_MSB=31, PDCA_ID_RX=3, PDCA_ID_TX=14
WDT at 0xffff2000
GPIO_LOCAL at 0x40000000
FUSES at FLASH_FUSES 0xFFFE0000 in fuses, USERPAGE_FUSES 0x80800000

## Interrupts
0 CORE_COMPARE_IRQ (CORE)
NMI EIC_IRQ_0 (EIC)
32 CORE_OCD_DCEMU_DIRTY_IRQ (CORE)
33 CORE_OCD_DCCPU_READ_IRQ (CORE)
64 FLASHCDW_IRQ (FLASHCDW)
96 SAU_IRQ (SAU)
128 PDCA_IRQ_0 (PDCA)
129 PDCA_IRQ_1 (PDCA)
130 PDCA_IRQ_2 (PDCA)
131 PDCA_IRQ_3 (PDCA)
160 PDCA_IRQ_4 (PDCA)
161 PDCA_IRQ_5 (PDCA)
162 PDCA_IRQ_6 (PDCA)
163 PDCA_IRQ_7 (PDCA)
192 PDCA_IRQ_8 (PDCA)
193 PDCA_IRQ_9 (PDCA)
194 PDCA_IRQ_10 (PDCA)
195 PDCA_IRQ_11 (PDCA)
224 PM_IRQ (PM)
256 SCIF_IRQ (SCIF)
288 AST_ALARM_IRQ (AST)
320 AST_PER_IRQ (AST)
321 AST_OVF_IRQ (AST)
322 AST_READY_IRQ (AST)
323 AST_CLKREADY_IRQ (AST)
352 EIC_IRQ_1 (EIC)
353 EIC_IRQ_2 (EIC)
354 EIC_IRQ_3 (EIC)
355 EIC_IRQ_4 (EIC)
384 EIC_IRQ_5 (EIC)
416 FREQM_IRQ (FREQM)
448 GPIO_IRQ_0 (GPIO)
449 GPIO_IRQ_1 (GPIO)
450 GPIO_IRQ_2 (GPIO)
451 GPIO_IRQ_3 (GPIO)
452 GPIO_IRQ_4 (GPIO)
453 GPIO_IRQ_5 (GPIO)
480 USART0_IRQ (USART0)
512 USART1_IRQ (USART1)
544 USART2_IRQ (USART2)
576 USART3_IRQ (USART3)
608 SPI_IRQ (SPI)
640 TWIM0_IRQ (TWIM0)
672 TWIM1_IRQ (TWIM1)
704 TWIS0_IRQ (TWIS0)
736 TWIS1_IRQ (TWIS1)
768 PWMA_IRQ (PWMA)
800 TC0_IRQ0 (TC0)
801 TC0_IRQ1 (TC0)
802 TC0_IRQ2 (TC0)
832 TC1_IRQ0 (TC1)
833 TC1_IRQ1 (TC1)
834 TC1_IRQ2 (TC1)
864 ADCIFB_IRQ (ADCIFB)
896 ACIFB_IRQ (ACIFB)
928 CAT_IRQ (CAT)
960 AW_IRQ (AW)

## Properties
AVR32_RESET: NumberOfResetDomains=1, ResetGroup=4
SIGNATURES: JTAGID=0x203003f
