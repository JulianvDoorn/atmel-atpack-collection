# ATSAM4LC8C device description
Architecture: CORTEX-M4; Family: SAM4; Series: SAM4L
Parameters: LITTLE_ENDIAN=1, __BB_PRESENT=0, __CM4_REV=0x0001, __CONST_AHB_CTRL=0, __DEBUG_LVL=3, __FPU_PRESENT=0, __JTAG_PRESENT=1, __MPU_PRESENT=1, __NVIC_PRIO_BITS=4, __TRACE_LVL=1, __Vendor_SysTickConfig=0, __WIC_LINES=3, __WIC_PRESENT=0
Programming and debug interfaces: JTAG, SWD
Registers are 32-bit, read-write, reset 0x0 unless marked. A register's access mark holds for its fields unless they carry their own. Offsets are from the block's base; lines under a group give offsets from that group; [hi:lo] are bit positions; {n}, {i} and the like mark numbered series; 'fields as' and 'values as' point back to an identical list; <NAME> marks a mode.

## Ordering variants
SAM4LC8C-AU: TQFP100, pinout QFP100, up to 48 MHz, -40 to 85 C, 1.68 to 3.6 V
SAM4LC8C-CU: VFBGA100, up to 48 MHz, -40 to 85 C, 1.68 to 3.6 V

## Memory
base space: start 0 size 0x100000000, little endian
  0x00000000 FLASH size 0x80000 flash, rw, executable, page 512
  0x00800000 USER_PAGE size 0x200 user_page, rw, page 512
  0x20000000 HRAMC0 size 0x10000 ram, rw, executable
  0x21000000 HRAMC1 size 0x800 ram, rw, executable
  0x40000000 HTOP0 size 0xA0000 io, rw
  0x400A0000 HTOP1 size 0x10000 io, rw
  0x400E0000 HTOP2 size 0x10000 io, rw
  0x400F0000 HTOP3 size 0x10000 io, rw
  0xE000E000 SCS size 0x00001000 io, rw
  0x40000000 PERIPHERALS size 0x20000000 io, rw
  0x40000000 PERIPHERALS size 0x20000000 io
  0xE0000000 SYSTEM size 0x20000000 io
fuses space: start 0x400A0014 size 8, little endian

## Peripheral instances (address, pins/pin function, parameters)
ABDACB at 0x40064000
  pins: CLK PC12/C; DAC0 PB02/C or PC09/C or PA17/B; DAC1 PB04/C or PC13/C or PA19/B; DACN0 PB03/C or PC10/C or PA18/B; DACN1 PB05/C or PC14/C or PA20/B
  parameters: GCLK_NUM=6, PDCA_ID_TX_CH0=31, PDCA_ID_TX_CH1=32, INSTANCE_ID=16
ACIFC at 0x40040000
  pins: ACAN0 PA06/E; ACAN1 PC09/E; ACAP0 PA07/E; ACAP1 PC10/E; ACBN0 PB02/E; ACBN1 PC13/E; ACBP0 PB03/E; ACBP1 PC14/E
  parameters: INSTANCE_ID=14
ADCIFE at 0x40038000
  pins: AD0 PA04/A; AD1 PA05/A; AD2 PA07/A; AD3 PB02/A; AD4 PB03/A; AD5 PB04/A; AD6 PB05/A; AD{n} PC{n:02}/A (n=7..14); ADVREFP ADVREFP_ADC; TRIGGER PA05/E
  parameters: CHANNELS=16, CHANNEL_MSB=15, EXT_TRIGGERS_MSB=0, GCLK_NUM=10, PDCA_ID_RX=11, PDCA_ID_TX=29, INSTANCE_ID=12
AESA at 0x400B0000
  parameters: GCLK_NUM=4, PDCA_ID_RX=17, PDCA_ID_TX=36
AST at 0x400F0800
  parameters: CLK1K=4, CLK32=1, GCLK_NUM=2, GENCLK=3, PB=2, RCOSC=0, INSTANCE_ID=98
BPM at 0x400F0000
  parameters: BKUPPMUX_MSB=9, BKUPWEN_AST=1, BKUPWEN_BOD18=4, BKUPWEN_BOD33=3, BKUPWEN_EIC=0, BKUPWEN_MSB=5, BKUPWEN_PICOUART=5, BKUPWEN_WDT=2, INSTANCE_ID=96
BSCIF at 0x400F0400
  pins: XIN32 XIN32/XIN32; XOUT32 XOUT32/XOUT32
  parameters: BGBUF_NUM=6, BOD18_IMPLEMENTED=0, BOD33_IMPLEMENTED=0, BOD50_IMPLEMENTED=0, BR_NUM=4, BOD_OFF=0, BOD_ON=1, BOD_ON_NORESET=2, GC_DIV_CLOCK=1, GC_NO_DIV_CLOCK=0, INSTANCE_ID=97
CATB at 0x40070000
  pins: DIS PA02/G or PA12/G or PA23/G or PB03/G or PB12/G or PC05/G or PC14/G or PC23/G; SENSE0 PA04/G or PB13/G; SENSE1 PA05/G or PB14/G; SENSE2 PA06/G or PB15/G; SENSE3 PA07/G or PC00/G; SENSE4 PA08/G or PC01/G; SENSE5 PA09/G or PC02/G; SENSE6 PA10/G or PC03/G; SENSE7 PA11/G or PC04/G; SENSE{n} PA{n+5}/G or PC{n-2:02}/G (n=8..15); SENSE16 PA21/G or PC15/G; SENSE17 PA22/G or PC16/G; SENSE18 PA24/G or PC17/G; SENSE19 PA25/G or PC18/G; SENSE20 PA26/G or PC19/G; SENSE21 PB00/G or PC20/G; SENSE22 PB01/G or PC21/G; SENSE23 PB02/G or PC22/G; SENSE{n} PB{n-20:02}/G or PC{n}/G (n=24..31)
  parameters: GCLK_NUM=3, PDCA_ID_RX=12, PDCA_ID_TX=30, SENSORS_MSB=31, STATUS_REG_NUMBER=1, INSTANCE_ID=19
CHIPID at 0x400E0400
  parameters: INSTANCE_ID=65
CRCCU at 0x400A4000
  parameters: INSTANCE_ID=37
DACC at 0x4003C000
  pins: EXT_TRIG0 PB04/E; VOUT PA06/A
  parameters: DACC_EXT_TRIG_MSB=0, DAC_RES_MSB=9, PDCA_ID_TX=35, INSTANCE_ID=13
EDP
  pins: TCK TCK; TDI PA24/Jtag_Alt; TDO PA23/Jtag_Alt; TMS PA03/Jtag_Alt
EIC at 0x400F1000
  pins: EXTINT0 PB01/C; EXTINT1 PA06/C or PA16/C or PC24/B; EXTINT2 PA04/C or PA17/C or PC25/B; EXTINT3 PA05/C or PA18/C or PC26/B; EXTINT4 PA07/C or PA19/C or PC27/B; EXTINT5 PA20/C or PC03/B; EXTINT6 PA21/C or PC04/B; EXTINT7 PA22/C or PC05/B; EXTINT8 PA23/C or PC06/B
  parameters: STD_NUM=8, EIC_EDGE_IRQ=0, EIC_FALLING_EDGE=0, EIC_FILTER_OFF=0, EIC_FILTER_ON=1, EIC_HIGH_LEVEL=1, EIC_LEVEL_IRQ=1, EIC_LOW_LEVEL=0, EIC_RISING_EDGE=1, EIC_SYNC=0, EIC_USE_ASYNC=1, INSTANCE_ID=100
HFLASHC at 0x400A0000 (FLASHCALW)
  pins: VMARGIN VMARGIN
  parameters: FLASH_SIZE=524288, PAGE_SIZE=512, PAGES=1024, PAGES_PR_REGION=64, PSM_0_FRMFW_FWS_1_MAX_FREQ=12000000, PSM_0_FRMLP_FWS_0_MAX_FREQ=18000000, PSM_0_FRMLP_FWS_1_MAX_FREQ=36000000, PSM_0_FRMHS_FWS_0_MAX_FREQ=25000000, PSM_0_FRMHS_FWS_1_MAX_FREQ=50000000, PSM_1_FRMFW_FWS_1_MAX_FREQ=12000000, PSM_1_FRMLP_FWS_0_MAX_FREQ=8000000, PSM_1_FRMLP_FWS_1_MAX_FREQ=12000000, INSTANCE_ID=32, IC9692=true
FUSES at USERPAGE_FUSES 0x00800000, FLASH_FUSES 0x400A0000 in fuses
FREQM at 0x400E0C00
  parameters: CPU=0, CRIPOSC=10, DFLL0=9, FLO_JITTER=27, GENCLK{n}={n+11} (n=0..10), HSB=1, NUM_CLK=28, NUM_REF_CLK=4, OSC0=6, OSC32=7, PBA=2, PBB=3, PBC=4, PLL0=26, RCFAST=24, RCOSC=8, RC1M=25, RC32K=7, RC80M=23, REFSEL_BITS=2, REF_OSC32=1, REF_RCOSC=0, INSTANCE_ID=67
GLOC at 0x40060000
  pins: IN0 PA06/D or PA20/D; IN1 PA04/D or PA21/D; IN2 PA05/D or PA22/D; IN3 PA07/D or PA23/D; IN4 PC15/D or PB06/C or PC28/C; IN5 PC16/D or PB07/C or PC29/C; IN6 PC17/D or PB08/C or PC30/C; IN7 PC18/D or PB09/C; OUT0 PA08/D or PA24/D; OUT1 PC19/D or PB10/C or PC31/C
  parameters: GCLK_NUM=5, LUTS=2, INSTANCE_ID=15
GPIO at 0x400E1000
  pins: P{n} PA{n:02} (n=0..26); P{n} PB{n-32:02} (n=32..47); P{n} PC{n-64:02} (n=64..95)
  parameters: GPIO_IRQ_MSB=11, GPIO_MAX_IRQ_MSB=11, GPIO_PADDR_BITS=11, GPIO_PINS_MSB=95, IRQS_PER_GROUP=8, NUMBER_OF_PINS=96, PADDR_MSB=10, PDATA_MSB=31, PORT_LENGTH=3, INSTANCE_ID=68
HCACHE at 0x400A0400
  parameters: INSTANCE_ID=33
HMATRIX at 0x400A1000 (HMATRIXB)
  parameters: MASTER_NUM=6, MASTER_CPU_IDCODE=0, MASTER_CPU_SYS=1, MASTER_SMAP=2, MASTER_PDCA=3, MASTER_USBC=4, MASTER_CRCCU=5, SLAVE_NUM=8, SLAVE_FLASH=0, SLAVE_HTOP0=1, SLAVE_HTOP1=2, SLAVE_HTOP2=3, SLAVE_HTOP3=4, SLAVE_HRAMC0=5, SLAVE_HRAMC1=6, SLAVE_AESA=7, INSTANCE_ID=34
IISC at 0x40004000
  pins: IMCK PB05/D or PC14/D; ISCK PB02/D or PC09/D; ISDI PB03/D or PC10/D; ISDO PB04/D or PC13/D; IWS PB06/D or PC12/D
  parameters: GCLK_NUM=6, PDCA_ID_RX=14, PDCA_ID_RX_1=15, PDCA_ID_TX=33, PDCA_ID_TX_1=34, INSTANCE_ID=0
LCDCA at 0x40080000
  pins: BIAS1 BIAS1; BIAS2 BIAS2; CAPH CAPH; CAPL CAPL; COM0 PA12/F; COM1 PA11/F; COM2 PA10/F; COM3 PA09/F; SEG0 PC15/F; SEG1 PC16/F; SEG2 PC17/F; SEG3 PC18/F; SEG4 PC19/F; SEG5 PA13/F; SEG6 PA14/F; SEG7 PA15/F; SEG8 PA16/F; SEG9 PA17/F; SEG10 PC20/F; SEG11 PC21/F; SEG12 PC22/F; SEG13 PC23/F; SEG14 PB08/F; SEG15 PB09/F; SEG16 PB10/F; SEG17 PB11/F; SEG18 PA18/F; SEG19 PA19/F; SEG20 PA20/F; SEG21 PB07/F; SEG22 PB06/F; SEG23 PA08/F; SEG{n} PC{n}/F (n=24..31); SEG32 PB12/F; SEG33 PB13/F; SEG34 PA21/F; SEG35 PA22/F; SEG36 PB14/F; SEG37 PB15/F; SEG38 PA23/F; SEG39 PA24/F; VLCD VLCD
  parameters: PDCA_ID_TX_ABM=38, PDCA_ID_TX_ACM=37, INSTANCE_ID=23
PARC at 0x4006C000
  pins: PCCK PA17/D or PC21/D; PCDATA{n} PA{n+9:02}/D or PC{n+24}/D (n=0..7); PCEN1 PA18/D or PC22/D; PCEN2 PA19/D or PC23/D
  parameters: PDCA_ID_RX=16, INSTANCE_ID=18
PDCA at 0x400A2000
  parameters: CHANNEL_LENGTH=16, MON_CH0_IMPL=0, MON_CH1_IMPL=0, INSTANCE_ID=35
PEVC at 0x400A6000
  pins: PAD_EVT0 PA08/C or PB12/C or PC07/C or PC24/C; PAD_EVT1 PA09/C or PB13/C or PC08/C or PC25/C; PAD_EVT2 PA10/C or PC11/C or PC26/C or PB09/B; PAD_EVT3 PA11/C or PC27/C or PB10/B
  parameters: EVIN_BITS=31, PADS_BITS=4, TRIGOUT_BITS=19, INSTANCE_ID=39
PICOUART at 0x400F1400
  parameters: INSTANCE_ID=101
PM at 0x400E0000
  pins: RESET_N RESET_N
  parameters: AWEN_LCDCA=7, AWEN_PICOUART=6, AWEN_TWIS0=0, AWEN_TWIS1=1, AWEN_USBC=2, MCCTRL_MCSEL_DFLL0=3, MCCTRL_MCSEL_FLO=7, MCCTRL_MCSEL_OSC0=1, MCCTRL_MCSEL_PLL0=2, MCCTRL_MCSEL_RCFAST=5, MCCTRL_MCSEL_RC1M=6, MCCTRL_MCSEL_RC80M=4, MCCTRL_MCSEL_SLOW=0, PM_CLK_APB_NUM=4, PPCR_FLASH_WAIT_BGREF_MASK=512, PPCR_FLASH_WAIT_BOD18_MASK=1024, SYSTEM_CLOCK=115000, PM_SMODE_DEEPSTOP=4, PM_SMODE_FROZEN=1, PM_SMODE_IDLE=0, PM_SMODE_SHUTDOWN=6, PM_SMODE_STANDBY=2, PM_SMODE_STATIC=5, PM_SMODE_STOP=3, INSTANCE_ID=64
  clocks: CPU OCD bit 0; HSB PDCA bit 0, HFLASHC bit 1, HRAMC1 bit 2, USBC bit 3, CRCCU bit 4, HTOP0 bit 5, HTOP1 bit 6, HTOP2 bit 7, HTOP3 bit 8, AESA bit 9; PBA IISC bit 0, SPI bit 1, TC0 bit 2, TC1 bit 3, TWIM0 bit 4, TWIS0 bit 5, TWIM1 bit 6, TWIS1 bit 7, USART0 bit 8, USART1 bit 9, USART2 bit 10, USART3 bit 11, ADCIFE bit 12, DACC bit 13, ACIFC bit 14, GLOC bit 15, ABDACB bit 16, TRNG bit 17, PARC bit 18, CATB bit 19, TWIM2 bit 21, TWIM3 bit 22, LCDCA bit 23; PBB HFLASHC bit 0, HCACHE bit 1, HMATRIX bit 2, PDCA bit 3, CRCCU bit 4, USBC bit 5, PEVC bit 6; PBC PM bit 0, CHIPID bit 1, SCIF bit 2, FREQM bit 3, GPIO bit 4; PBD BPM bit 0, BSCIF bit 1, AST bit 2, WDT bit 3, EIC bit 4, PICOUART bit 5
SCIF at 0x400E0800
  pins: GCLK0 PA19/E or PB10/E or PC26/E or PA02/A; GCLK1 PA20/E or PB11/E or PC27/E; GCLK2 PB12/E or PC28/E; GCLK3 PB13/E or PC29/E; GCLK_IN0 PA23/E or PB14/E or PC30/E; GCLK_IN1 PA24/E or PB15/E or PC31/E; XIN0 PA00/XIN0; XOUT0 PA01/XOUT0
  parameters: BOD33_IMPLEMENTED=0, BOD50_IMPLEMENTED=0, BR_NUM=0, DFLL_CALIB_MSB=3, DFLL_COARSE_MSB=4, DFLL_FINE_MSB=7, DFLL_RANGE_MSB=1, GCLK_EXTCLK_MSB=3, GCLK_IN_MSB=1, GCLK_IN_NUM=2, GCLK_MSB=10, GCLK_NUM=12, GCLK_NUM_DFLL_REF=0, GCLK_NUM_DFLL_SSG=1, GCLK_NUM_FLO=4, GCLK_NUM_MASTER=11, GCLK_NUM_PLL=9, GCLK_NUM_RC32KIFB_REF=5, GC_USES_CLK_CPU=7, GC_USES_CLK_HSB=8, GC_USES_CLK_PBA=9, GC_USES_CLK_PBB=10, GC_USES_CLK_PBC=11, GC_USES_CLK_PBD=12, GC_USES_CLK_SLOW=0, GC_USES_CLK_1K=15, GC_USES_CLK_32=1, GC_USES_DFLL0=2, GC_USES_FLO=14, GC_USES_GCLKPRESC_FP=18, GC_USES_GCLKPRESC_HRP=17, GC_USES_GCLK_IN0=19, GC_USES_GCLK_IN1=20, GC_USES_MASTER=21, GC_USES_OSC0=3, GC_USES_PLL0=16, GC_USES_RCFAST=5, GC_USES_RC1M=6, GC_USES_RC32K=13, GC_USES_RC80M=4, OSC_NUM=1, PLL_NUM=1, RCFAST_CALIBRATION_MSB=6, RCFAST_FRANGE_MSB=1, RCOSC_FREQUENCY=115200, RC80M_CALIBRATION_MSB=1, BOD_OFF=0, BOD_ON=1, BOD_ON_NORESET=2, GC_DIV_CLOCK=1, GC_NO_DIV_CLOCK=0, INSTANCE_ID=66
SMAP at 0x400A3000
  parameters: INSTANCE_ID=36
SPI at 0x40008000
  pins: MISO PA03/B or PB14/B or PC28/B or PA21/A or PC04/A; MOSI PB15/B or PC29/B or PA22/A or PC05/A; NPCS0 PA02/B or PC31/B or PA24/A or PC03/A; NPCS1 PA13/C or PB13/B or PC02/A; NPCS2 PA14/C or PB11/B or PC00/A; NPCS3 PA15/C or PB12/B or PC01/A; SCK PC30/B or PA23/A or PC06/A
  parameters: CS_MSB=3, PDCA_ID_RX=4, PDCA_ID_TX=22, INSTANCE_ID=1
TC0 at 0x40010000 (TC)
  pins: A0 PB07/D or PA08/B; A1 PB09/D or PA10/B; A2 PB11/D or PA12/B; B0 PB08/D or PA09/B; B1 PB10/D or PA11/B; B2 PB12/D or PA13/B; CLK0 PB13/D or PA14/B; CLK1 PB14/D or PA15/B; CLK2 PB15/D or PA16/B
  parameters: CLK_DIV1=gen_clk_tc0, CLK_DIV2=2, CLK_DIV3=8, CLK_DIV4=32, CLK_DIV5=128, GCLK_NUM=5, INSTANCE_ID=2
TC1 at 0x40014000 (TC)
  pins: A0 PC00/D or PC15/A; A1 PC02/D or PC17/A; A2 PC04/D or PC19/A; B0 PC01/D or PC16/A; B1 PC03/D or PC18/A; B2 PC05/D or PC20/A; CLK0 PC06/D or PC21/A; CLK1 PC07/D or PC22/A; CLK2 PC08/D or PC23/A
  parameters: CLK_DIV1=gen_clk_tc1, CLK_DIV2=2, CLK_DIV3=8, CLK_DIV4=32, CLK_DIV5=128, GCLK_NUM=8, INSTANCE_ID=3
TRNG at 0x40068000
  parameters: INSTANCE_ID=17
TWIM0 at 0x40018000 (TWIM)
  parameters: PDCA_ID_RX=5, PDCA_ID_TX=23, INSTANCE_ID=4
TWIM1 at 0x4001C000 (TWIM)
  parameters: PDCA_ID_RX=6, PDCA_ID_TX=24, INSTANCE_ID=6
TWIM2 at 0x40078000 (TWIM)
  parameters: PDCA_ID_RX=7, PDCA_ID_TX=25, INSTANCE_ID=21
TWIM3 at 0x4007C000 (TWIM)
  parameters: PDCA_ID_RX=8, PDCA_ID_TX=26, INSTANCE_ID=22
TWIMS0
  pins: TWCK PA24/B; TWD PA23/B
TWIMS1
  pins: TWCK PB01/A; TWD PB00/A
TWIMS2
  pins: TWCK PA22/E; TWD PA21/E
TWIMS3
  pins: TWCK PB15/C; TWD PB14/C
TWIS0 at 0x40018400 (TWIS)
  parameters: PDCA_ID_RX=9, PDCA_ID_TX=27, INSTANCE_ID=5
TWIS1 at 0x4001C400 (TWIS)
  parameters: PDCA_ID_RX=10, PDCA_ID_TX=28, INSTANCE_ID=7
USART0 at 0x40024000 (USART)
  pins: CLK PA04/B or PC00/B or PA10/A or PB13/A; CTS PC02/B or PA09/A or PB11/A; RTS PA06/B or PC01/B or PA08/A or PB12/A; RXD PC02/C or PA05/B or PB00/B or PA11/A or PB14/A; TXD PC03/C or PA07/B or PB01/B or PA12/A or PB15/A
  parameters: CLK_DIV=8, PDCA_ID_RX=0, PDCA_ID_TX=18, INSTANCE_ID=8
USART1 at 0x40028000 (USART)
  pins: CLK PB03/B or PA14/A or PC25/A; CTS PA21/B; RTS PB02/B or PA13/A or PC24/A; RXD PB04/B or PA15/A or PC26/A; TXD PB05/B or PA16/A or PC27/A
  parameters: CLK_DIV=8, PDCA_ID_RX=1, PDCA_ID_TX=19, INSTANCE_ID=9
USART2 at 0x4002C000 (USART)
  pins: CLK PC08/B or PA18/A; CTS PC08/E or PA22/B; RTS PC07/B or PA17/A; RXD PA25/B or PC11/B or PA19/A; TXD PA26/B or PC12/B or PA20/A
  parameters: CLK_DIV=8, PDCA_ID_RX=2, PDCA_ID_TX=20, INSTANCE_ID=10
USART3 at 0x40030000 (USART)
  pins: CLK PC14/B or PB08/A or PC31/A; CTS PB07/A; RTS PC13/B or PB06/A or PC30/A; RXD PC09/B or PB09/A or PC28/A; TXD PC10/B or PB10/A or PC29/A
  parameters: CLK_DIV=8, PDCA_ID_RX=3, PDCA_ID_TX=21, INSTANCE_ID=11
USBC at 0x400A5000
  pins: DM PA25/A; DP PA26/A
  parameters: EPT_NBR=7, GCLK_NUM=7, HOST_IMPLEMENTED=1, INSTANCE_ID=38
WDT at 0x400F0C00
  parameters: WDT_KEY_CONST=85, INSTANCE_ID=99
SystemControl at 0xE000E000
SysTick at 0xE000E010
NVIC at 0xE000E100
MPU at 0xE000ED90

## Interrupts
-14 NonMaskableInt_IRQn — Non Maskable Interrupt
-13 HardFault_IRQn — Cortex-M4 Hard Fault Interrupt
-12 MemoryManagement_IRQn — Cortex-M4 Memory Management Interrupt
-11 BusFault_IRQn — Cortex-M4 Bus Fault Interrupt
-10 UsageFault_IRQn — Cortex-M4 Usage Fault Interrupt
-5 SVCall_IRQn — Cortex-M4 SV Call Interrupt
-4 DebugMonitor_IRQn — Cortex-M4 Debug Monitor Interrupt
-2 PendSV_IRQn — Cortex-M4 Pend SV Interrupt
-1 SysTick_IRQn — Cortex-M4 System Tick Interrupt
0 HFLASHC_IRQn (HFLASHC)
{n+1} PDCA_{n}_IRQn (PDCA) (n=0..15)
17 CRCCU_IRQn (CRCCU)
18 USBC_IRQn (USBC)
19 PEVC_TR_IRQn (PEVC)
20 PEVC_OV_IRQn (PEVC)
21 AESA_IRQn (AESA)
22 PM_IRQn (PM)
23 SCIF_IRQn (SCIF)
24 FREQM_IRQn (FREQM)
{n+25} GPIO_{n}_IRQn (GPIO) (n=0..11)
37 BPM_IRQn (BPM)
38 BSCIF_IRQn (BSCIF)
39 AST_ALARM_IRQn (AST)
40 AST_PER_IRQn (AST)
41 AST_OVF_IRQn (AST)
42 AST_READY_IRQn (AST)
43 AST_CLKREADY_IRQn (AST)
44 WDT_IRQn (WDT)
{n+44} EIC_{n}_IRQn (EIC) (n=1..8)
53 IISC_IRQn (IISC)
54 SPI_IRQn (SPI)
55 TC00_IRQn (TC0)
56 TC01_IRQn (TC0)
57 TC02_IRQn (TC0)
58 TC10_IRQn (TC1)
59 TC11_IRQn (TC1)
60 TC12_IRQn (TC1)
61 TWIM0_IRQn (TWIM0)
62 TWIS0_IRQn (TWIS0)
63 TWIM1_IRQn (TWIM1)
64 TWIS1_IRQn (TWIS1)
65 USART0_IRQn (USART0)
66 USART1_IRQn (USART1)
67 USART2_IRQn (USART2)
68 USART3_IRQn (USART3)
69 ADCIFE_IRQn (ADCIFE)
70 DACC_IRQn (DACC)
71 ACIFC_IRQn (ACIFC)
72 ABDACB_IRQn (ABDACB)
73 TRNG_IRQn (TRNG)
74 PARC_IRQn (PARC)
75 CATB_IRQn (CATB)
77 TWIM2_IRQn (TWIM2)
78 TWIM3_IRQn (TWIM3)
79 LCDCA_IRQn (LCDCA)

## Properties
SIGNATURES: CHIPID_CIDR=0xAB0B0AE0, CHIPID_EXID=0x1400000F

## Pinouts (pin number, pad)
QFP100: 1 PC00, 2 PC01, 3 PC02, 4 PC03, 5 PA00, 6 PA01, 7 GNDIO05, 8 VDDIO05, 9 PC, 10 PC, 11 PC, 12 PA, 13 RESET_N, 14 VDDCORE, 15 GNDIN, 16 VDDOUT, 17 VDDIN, 18 TCK, 19 PA, 20 PB, 21 PB, 22 PB02, 23 PB03, 24 PA04, 25 PA05, 26 XIN32, 27 XOUT32, 28 PB04, 29 PB05, 30 PA, 31 PA07, 32 ADVREFN, 33 GNDANA, 34 ADVREFP, 35 VANA, 36 PC07, 37 PC08, 38 PC09, 39 PC10, 40 PC11, 41 PC12, 42 PC13, 43 PC14, 44 PA08, 45 PB06, 46 PB07, 47 PA09, 48 PA10, 49 PA11, 50 PA12, 51 CAPH, 52 CAPL, 53 VLCD, 54 BIAS1, 55 BIAS2, 56 GNDIO00, 57 VPUMP, 58 PC15, 59 PC16, 60 PC17, 61 PC18, 62 PC19, 63 PA, 64 PA14, 65 PA15, 66 PA16, 67 PA17, 68 PC20, 69 PC21, 70 PC22, 71 PC23, 72 PB08, 73 PB09, 74 PB10, 75 PB11, 76 PA18, 77 PA19, 78 PA20, 79 PC24, 80 PC25, 81 PC26, 82 PC27, 83 PC28, 84 PC29, 85 PC30, 86 PC31, 87 VDDIO02, 88 VDDIO03, 89 PB12, 90 PB13, 91 PA, 92 PA, 93 PB, 94 PB, 95 PA, 96 PA, 97 VDDIO04, 98 PA25, 99 PA26, 100 GNDIO04
VFBGA100: A1 PA05, A2 PA04, A3 GNDIN, A4 VDDIN, A5 VDDOUT, A6 VDDCORE, A7 PA, A8 VDDIO05, A9 GNDIO05, A10 PC00, B1 PB05, B2 XIN32, B3 PA, B4 TCK, B5 RESET_N, B6 PC, B7 PC03, B8 PA01, B9 PA00, B10 GNDIO04, C1 PB04, C2 XOUT32, C3 PA, C4 PB03, C5 PC, C6 PC, C7 PC02, C8 PC01, C9 PA26, C10 VDDIO04, D1 ADVREFN, D2 GNDANA, D3 PA07, D4 PC10, D5 PB, D6 PA, D7 PB, D8 PB, D9 PA25, D10 PA, E1 VANA, E2 ADVREFP, E3 PC08, E4 PC11, E5 PB02, E6 VDDIO02, E7 PB12, E8 PB13, E9 PA, E10 PA, F1 PC09, F2 PC07, F3 PC12, F4 PC13, F5 PA09, F6 PC27, F7 PC29, F8 PC30, F9 PC31, F10 VDDIO03, G1 PC14, G2 PA08, G3 PB06, G4 PC19, G5 PA15, G6 PB08, G7 PB09, G8 PB10, G9 PC26, G10 PC28, H1 PB07, H2 PA10, H3 PA11, H4 PC17, H5 PA, H6 PA17, H7 PC20, H8 PC23, H9 PC25, H10 PA20, J1 CAPL, J2 PA12, J3 PB, J4 BIAS2, J5 PC15, J6 PC16, J7 PA16, J8 PC22, J9 PC24, J10 PA19, K1 CAPH, K2 VLCD, K3 BIAS1, K4 GNDIO00, K5 VPUMP, K6 PC18, K7 PA14, K8 PC21, K9 PB11, K10 PA18

## Notices in the file
Copyright (c) 2016 Atmel Corporation,
a wholly owned subsidiary of Microchip Technology Inc.
Licensed under the Apache License, Version 2.0 (the "License");
you may not use this file except in compliance with the License.
You may obtain a copy of the Licence at
http://www.apache.org/licenses/LICENSE-2.0
Unless required by applicable law or agreed to in writing, software
distributed under the License is distributed on an "AS IS" BASIS,
WITHOUT WARRANTIES OR CONDITIONS OF ANY KIND, either express or implied.
See the License for the specific language governing permissions and
limitations under the License.
