# ATSAM4C32E_1 device description
Architecture: CORTEX-M4; Family: SAM4; Series: SAM4C
Parameters: __CM4_REV=0x0000, __MPU_PRESENT=0, __FPU_PRESENT=1, __NVIC_PRIO_BITS=4, __Vendor_SysTickConfig=0
Programming and debug interfaces: JTAG, SWD
Registers are 32-bit, read-write, no defined reset value unless marked. A register's access mark holds for its fields unless they carry their own. Offsets are from the block's base; lines under a group give offsets from that group; [hi:lo] are bit positions; {n}, {i} and the like mark numbered series; 'fields as' and 'values as' point back to an identical list; <NAME> marks a mode.

## Ordering variants
ATSAM4C32E-AU: LQFP144, up to 120 MHz, -40 to +85 C, 1.62 to 3.6 V

## Memory
base space: start 0 size 0x100000000, little endian
  0x40000000 PERIPHERALS size 0x20000000 io
  0x01000000 IFLASH0 size 0x00100000 flash, page 512
  0x01100000 IFLASH1 size 0x00100000 flash, page 512
  0x02000000 IROM size 0x01000000 rom
  0x20080000 IRAM1 size 0x00008000 ram
  0x20100000 IRAM2 size 0x00004000 ram
  0x20200000 UOTGHS_RAM size 0x00001000 other
  0x60000000 EBI_CS0 size 0x01000000 other
  0x61000000 EBI_CS1 size 0x01000000 other
  0x62000000 EBI_CS2 size 0x01000000 other
  0x63000000 EBI_CS3 size 0x01000000 other
  0x20000000 IRAM0 size 0x00040000 ram
fuses space: start 0 size 1, little endian
lockbits space: start 0 size 0x20, little endian

## Peripheral instances (address, pins/pin function, parameters)
ADC at 0x40038000
  pins: ADTRG PB23/A; COM4 PA4/X1; AD1 PA4/X1; COM5 PA5/X1; AD2 PA5/X1; SEG6 PA12/X1; AD0 PA12/X1; SEG31 PB13/X1; AD3 PB13/X1; SEG41 PB23/X1; AD4 PB23/X1; SEG49 PB31/X1; AD5 PB31/X1
AES at 0x40000000
CHIPID at 0x400E0740
CMCC0 at 0x4007C000 (CMCC)
CMCC1 at 0x48018000 (CMCC)
EFC0 at 0x400E0A00 (EFC)
  parameters: FLASH_SIZE=1048576, PAGE_SIZE=512, PAGES_PR_REGION=16
EFC1 at 0x400E0C00 (EFC)
  parameters: FLASH_SIZE=1048576, PAGE_SIZE=512, PAGES_PR_REGION=16
GPBR at 0x400E1490
ICM at 0x40044000
IPC0 at 0x4004C000 (IPC)
IPC1 at 0x48014000 (IPC)
MATRIX0 at 0x400E0200 (MATRIX)
MATRIX1 at 0x48010000 (MATRIX)
PIOA at 0x400E0E00 (PIO)
PIOB at 0x400E1000 (PIO)
PIOC at 0x4800C000 (PIO)
PIOD at 0x400E1200 (PIO)
PMC at 0x400E0400
  pins: PCK0 PA31/A or PB13/A; PCK1 PA29/A or PA30/A; PCK2 PA0/B or PB18/B
PWM at 0x48008000
  pins: PWM0 PC0/B or PC6/A; PWM1 PC1/B or PC7/A; PWM2 PC2/B or PC8/A; PWM3 PC3/B or PC9/A
RSTC at 0x400E1400
RSWDT at 0x400E1500
RTC at 0x400E1460
RTT at 0x400E1430
SLCDC at 0x4003C000
  pins: COM0 PA0/X1; COM1 PA1/X1; COM2 PA2/X1; COM3 PA3/X1; COM4 PA4/X1; AD1 PA4/X1; COM5 PA5/X1; AD2 PA5/X1; SEG{n} PA{n+6}/X1 (n=0..23); AD0 PA12/X1; SEG{n} PB{n-18}/X1 (n=24..49); AD3 PB13/X1; AD4 PB23/X1; AD5 PB31/X1
SMC0 at 0x400E0000 (SMC)
SMC1 at 0x4801C000 (SMC)
SPI0 at 0x40008000 (SPI)
  pins: SPI0_MISO PA6/A; SPI0_MOSI PA7/A; SPI0_NPCS0 PA5/A; SPI0_NPCS1 PA21/A; SPI0_NPCS2 PA22/A; SPI0_NPCS3 PA23/A; SPI0_SPCK PA8/A
SPI1 at 0x48000000 (SPI)
  pins: SPI1_MISO PC3/A; SPI1_MOSI PC4/A; SPI1_NPCS0 PC2/A; SPI1_NPCS1 PC6/B; SPI1_NPCS2 PC7/B; SPI1_NPCS3 PC8/B; SPI1_SPCK PC5/A
SUPC at 0x400E1410
TC0 at 0x40010000 (TC)
  pins: TCLK0 PB4/B; TCLK1 PB9/A; TCLK2 PB12/A; TIOA0 PA13/B; TIOA1 PB7/A; TIOA2 PB10/A; TIOB0 PA14/B; TIOB1 PB8/A; TIOB2 PB11/A
TC1 at 0x40014000 (TC)
  pins: TCLK3 PB26/A; TCLK4 PA17/B; TCLK5 PA19/B; TIOA3 PB24/A; TIOA4 PA15/B; TIOA5 PA18/B; TIOB3 PB25/A; TIOB4 PA16/B; TIOB5 PA20/B
TRNG at 0x40048000
TWI0 at 0x40018000 (TWI)
  pins: TWCK0 PA25/A; TWD0 PA24/A
TWI1 at 0x4001C000 (TWI)
  pins: TWCK1 PB1/A; TWD1 PB0/A
UART0 at 0x400E0600 (UART)
  pins: URXD0 PB4/A; UTXD0 PB5/A
UART1 at 0x48004000 (UART)
  pins: URXD1 PC1/A; UTXD1 PC0/A
UOTGHS at 0x40020000
USART0 at 0x40024000 (USART)
  pins: CTS0 PA20/A; RTS0 PA19/A; RXD0 PB16/A; SCK0 PB18/A; TXD0 PB17/A
USART1 at 0x40028000 (USART)
  pins: CTS1 PA18/A; RTS1 PA17/A; RXD1 PA11/A; SCK1 PA16/A; TXD1 PA12/A
USART2 at 0x4002C000 (USART)
  pins: CTS2 PA15/A; RTS2 PA14/A; RXD2 PA9/A; SCK2 PA13/A; TXD2 PA10/A
USART3 at 0x40030000 (USART)
  pins: CTS3 PA1/A; RTS3 PA0/A; RXD3 PA3/A; SCK3 PA2/A; TXD3 PA4/A
USART4 at 0x40034000 (USART)
  pins: CTS4 PA26/A; RTS4 PB22/A; RXD4 PB19/A; SCK4 PB21/A; TXD4 PB20/A
WDT at 0x400E1450
FUSES at GPNVMBITS 0 in fuses
LOCKBIT at 0 in lockbits
SystemControl at 0xE000E000
SysTick at 0xE000E010
NVIC at 0xE000E100
MPU at 0xE000ED90

## Interrupts
-14 NonMaskableInt_IRQn — Non Maskable Interrupt
-12 MemoryManagement_IRQn — Cortex-M4 Memory Management Interrupt
-11 BusFault_IRQn — Cortex-M4 Bus Fault Interrupt
-10 UsageFault_IRQn — Cortex-M4 Usage Fault Interrupt
-5 SVCall_IRQn — Cortex-M4 SV Call Interrupt
-4 DebugMonitor_IRQn — Cortex-M4 Debug Monitor Interrupt
-2 PendSV_IRQn — Cortex-M4 Pend SV Interrupt
-1 SysTick_IRQn — Cortex-M4 System Tick Interrupt
0 SUPC (SYSC) — Supply Controller
1 RSTC (SYSC) — Reset Controller
2 RTC (SYSC) — Real Time Clock
3 RTT (SYSC) — Real Time Timer
4 WDT (SYSC) — Watchdog Timer
5 PMC — Power Management Controller
6 EFC0 — Enhanced Embedded Flash Controller 0
7 EFC1 — Enhanced Embedded Flash Controller 1
8 UART0
11 PIOA — Parallel I/O Controller A
12 PIOB — Parallel I/O Controller B
13 PIOD — Parallel I/O Controller D
14 USART0
15 USART1
16 USART2
17 USART3
18 USART4
19 TWI0 — Two Wire Interface 0
20 TWI1 — Two Wire Interface 1
21 SPI0 — Serial Peripheral Interface 0
22 UOTGHS — USB Host / Device Full/Low Speed Port
23 TC0 — Timer/Counter 0
24 TC1 (TC0) — Timer/Counter 1
25 TC2 (TC0) — Timer/Counter 2
26 TC3 (TC1) — Timer/Counter 3
27 TC4 (TC1) — Timer/Counter 4
28 TC5 (TC1) — Timer/Counter 5
29 ADC — Analog To Digital Converter
31 IPC0 — Interprocessor communication 0
32 SLCDC — Segment LCD Controller
33 TRNG — True Random Generator
34 ICM — Integrity Check Module
36 AES — Advanced Enhanced Standard
37 PIOC — Parallel I/O Controller C
38 UART1
39 IPC1 — Interprocessor communication 1
40 SPI1 — Serial Peripheral Interface 1
41 PWM — Pulse Width Modulation

## Properties
SIGNATURES: JTAGID=0x05B3403F, CHIPID_CIDR=0xA66D0EE0, CHIPID_EXID=0x0

## Notices in the file
SAM Software Package License
Copyright (c) %copyright_year%, Atmel Corporation
All rights reserved.
Redistribution and use in source and binary forms, with or without
modification, are permitted provided that the following condition is met:
- Redistributions of source code must retain the above copyright notice,
this list of conditions and the disclaimer below.
Atmel's name may not be used to endorse or promote products derived from
this software without specific prior written permission.
DISCLAIMER:  THIS SOFTWARE IS PROVIDED BY ATMEL "AS IS" AND ANY EXPRESS OR
IMPLIED WARRANTIES, INCLUDING, BUT NOT LIMITED TO, THE IMPLIED WARRANTIES OF
MERCHANTABILITY, FITNESS FOR A PARTICULAR PURPOSE AND NON-INFRINGEMENT ARE
DISCLAIMED. IN NO EVENT SHALL ATMEL BE LIABLE FOR ANY DIRECT, INDIRECT,
INCIDENTAL, SPECIAL, EXEMPLARY, OR CONSEQUENTIAL DAMAGES (INCLUDING, BUT NOT
LIMITED TO, PROCUREMENT OF SUBSTITUTE GOODS OR SERVICES; LOSS OF USE, DATA,
OR PROFITS; OR BUSINESS INTERRUPTION) HOWEVER CAUSED AND ON ANY THEORY OF
LIABILITY, WHETHER IN CONTRACT, STRICT LIABILITY, OR TORT (INCLUDING
NEGLIGENCE OR OTHERWISE) ARISING IN ANY WAY OUT OF THE USE OF THIS SOFTWARE,
EVEN IF ADVISED OF THE POSSIBILITY OF SUCH DAMAGE.
