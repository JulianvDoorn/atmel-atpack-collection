# AT32UC3A0256 device description
Architecture: AVR32_UC3; Family: AVR UC3
Programming and debug interfaces: JTAG
Registers are 32-bit, read-write, reset 0x0 unless marked. A register's access mark holds for its fields unless they carry their own. Offsets are from the block's base; lines under a group give offsets from that group; [hi:lo] are bit positions; {n}, {i} and the like mark numbered series; 'fields as' and 'values as' point back to an identical list; <NAME> marks a mode.

## Ordering variants
standard: up to 66 MHz, 3.0 to 3.6 V

## Memory
sysreg space: start 0 size 1024, big endian
dbgreg space: start 0 size 1024
base space: start 0 size 0x100000000, big endian
  0xC0000000 EBI_CS0 size 0x01000000 other
  0xD0000000 EBI_CS1 size 0x08000000 other
  0xC8000000 EBI_CS2 size 0x01000000 other
  0xCC000000 EBI_CS3 size 0x01000000 other
  0x80000000 FLASH size 0x00040000 flash
  0x80800000 USER_PAGE size 0x00000200 user_page
  0x00000000 SRAM size 0x00010000 ram
  0xE0000000 USBB_SLAVE size 0x00800000 other
  0xfffe0000 IO size 0x20000 io, rw
fuses space: start 0xFFFE1410 size 4, big endian

## Peripheral instances (address, pins/pin function, parameters)
CORE at 0 in sysreg
INTC at 0xFFFF0800
  parameters: NUM_INT_GRPS=20, NUM_IRQS_PER_GRP0=1, NUM_IRQS_PER_GRP1=11, NUM_IRQS_PER_GRP2=14, NUM_IRQS_PER_GRP3=15, NUM_IRQS_PER_GRP{n}=1 (n=4..13), NUM_IRQS_PER_GRP14=3, NUM_IRQS_PER_GRP{n}=1 (n=15..19)
ADC at 0xffff3c00
  pins: AD{n} PA{n+21}/A (n=0..7); TRIGGER0 PB18/B
  parameters: ADC_CHANNELS_MSB=7, ADC_DATA_MSB=9, PADDR_MSB=10, PDATA_MSB=32
ABDAC at 0xffff4000
  pins: DATA0 PB02/B or PA03/C; DATAN0 PB03/B or PA04/C; DATA1 PB05/B or PA23/C; DATAN1 PB06/B or PA24/C
EBI
  pins: DATA10 PX00/A; DATA9 PX01/A; DATA8 PX02/A; DATA7 PX03/A; DATA6 PX04/A; DATA5 PX05/A; DATA4 PX06/A; DATA3 PX07/A; DATA2 PX08/A; DATA1 PX09/A; DATA0 PX10/A; NWE10 PX11/A; NWE00 PX12/A; NRD0 PX13/A; NCS1 PX14/A; ADDR19 PX15/A; ADDR18 PX16/A; ADDR17 PX17/A; ADDR16 PX18/A; ADDR15 PX19/A; ADDR14 PX20/A; ADDR13 PX21/A; ADDR12 PX22/A; ADDR11 PX23/A; ADDR10 PX24/A; ADDR9 PX25/A; ADDR8 PX26/A; ADDR7 PX27/A; ADDR6 PX28/A; ADDR5 PX29/A; ADDR4 PX30/A; ADDR3 PX31/A; ADDR2 PX32/A; ADDR1 PX33/A; ADDR0 PX34/A; DATA15 PX35/A; DATA14 PX36/A; DATA13 PX37/A; DATA12 PX38/A; DATA11 PX39/A; NCS0 PA14/C or PA25/C; ADDR20 PA15/C or PA26/C; ADDR21 PA16/C or PA27/C; ADDR22 PA17/C or PA28/C; NCS3 PB04/C; SDCK0 PB10/C; SDCKE0 PB11/C; RAS0 PB12/C; CAS0 PB13/C; SDWE0 PB14/C; SDA100 PB16/C; ADDR23 PB17/C; NCS2 PB29/C; SDCS0 PB30/C; NWAIT0 PB31/C; SCAN_CLOCK0 PB10
  parameters: HADDR_MSB=0, HBURST_MSB=0, HDATA_MSB=0, HEBI_CS_MSB=3, HMATRIX_NR=5, HPROT_MSB=0, HRESP_MSB=0, HSIZE_MSB=0, HTRANS_MSB=0, PADDR_MSB=0, PDATA_MSB=0, SDRAM_CS=1, SMC0_CS=0, SMC1_CS=1, SMC2_CS=2, SMC3_CS=3
EIC at 0xffff0d80
  pins: EXTINT8 PA20/A; EXTINT4 PA03/B; EXTINT5 PA04/B; EXTINT6 PA10/B; EXTINT0 PA21/B; EXTINT1 PA22/B; EXTINT2 PA23/B; EXTINT3 PA24/B; SCAN0 PA25/B or PX19/B; SCAN1 PA26/B or PX20/B; SCAN2 PA27/B or PX21/B; SCAN3 PA28/B or PX22/B; SCAN4 PX23/B or PB19/C; SCAN5 PX24/B or PB20/C; SCAN6 PX25/B or PB21/C; SCAN7 PX26/B or PB22/C; EXTINT7 PA08/C
  parameters: INT_MSB=8, SCAN_MSB=7, STD_NUM=8
FLASHC at 0xfffe1400
  pins: EXTCLK0 PB25; LATDEL0 PB19; LATDELCLK0 PB20; FLASH_OBS{n} PA{n:02} (n=0..17); FLASH_OBS18 PB23; FLASH_OBS19 PB24; FLASH_OBS20 PB26
  parameters: FLASH_SIZE=262144, PAGES_PR_REGION=64, PAGE_SIZE=512, USER_PAGE=((volatile unsigned char*) AVR32_FLASHC_USER_PAGE_ADDRESS), USER_PAGE_ADDRESS=0x80800000, USER_PAGE_SIZE=512, CF_NUM=64, GPF_NUM=64, FWS_0_MAX_FREQ=33000000, FWS_1_MAX_FREQ=66000000
FREQM at 0xffff0d50
  parameters: FREQM_REFSEL_BITS=1
GPIO at 0xffff1000
  pins: P{n} PA{n:02} (n=0..30); P{n} PB{n-32:02} (n=32..63); P64 PC00; P65 PC01; P66 PC02; P67 PC03; P68 PC04; P69 PC05; P100 PX00; P99 PX01; P98 PX02; P97 PX03; P96 PX04; P95 PX05; P94 PX06; P93 PX07; P92 PX08; P91 PX09; P90 PX10; P109 PX11; P108 PX12; P107 PX13; P106 PX14; P89 PX15; P88 PX16; P87 PX17; P86 PX18; P85 PX19; P84 PX20; P83 PX21; P82 PX22; P81 PX23; P80 PX24; P79 PX25; P78 PX26; P77 PX27; P76 PX28; P75 PX29; P74 PX30; P73 PX31; P72 PX32; P71 PX33; P70 PX34; P105 PX35; P104 PX36; P103 PX37; P102 PX38; P101 PX39
  parameters: GPIO_IRQ_MSB=13, GPIO_PADDR_BITS=10, GPIO_PINS_MSB=109, IRQS_PER_GROUP=8, NUMBER_OF_PINS=110, PADDR_MSB=9, PDATA_MSB=31, PORT_LENGTH=4
HMATRIX at 0xfffe1000
  parameters: MASTER_CPU_DATA=0, MASTER_CPU_INSTRUCTION=1, MASTER_CPU_SAB=2, MASTER_PDCA=3, MASTER_MACB_DMA=4, MASTER_USBB_DMA=5, SLAVE_FLASH=0, SLAVE_PBA=1, SLAVE_PBB=2, SLAVE_SRAM=3, SLAVE_USBB_DPRAM=4, SLAVE_EBI=5, MASTER_NUM=6, SLAVE_NUM=6
SDRAMC at 0xfffe2000
SMC at 0xfffe1c00
JTAG
MACB at 0xfffe1800
  pins: TX_CLK0 PB00/A; TX_EN0 PB01/A; TXD0 PB02/A; TXD1 PB03/A; CRS0 PB04/A; RXD0 PB05/A; RXD1 PB06/A; RX_ER0 PB07/A; MDC0 PB08/A; MDIO0 PB09/A; TXD2 PB10/A; TXD3 PB11/A; TX_ER0 PB12/A; RXD2 PB13/A; RXD3 PB14/A; RX_DV0 PB15/A; COL0 PB16/A; RX_CLK0 PB17/A; SPEED0 PB18/A; WOL0 PA09/C or PA18/C; SCAN_CLOCK0 PB00 or PB17
PDCA at 0xffff0000
  parameters: CHANNEL_LENGTH=15, HADDR_MSB=31, HDATA_MSB=31, PADDR_MSB=31, PDATA_MSB=31, PDCA_CHANNELS_MSB=14, PID_ADC_RX=0, PID_DAC_TX=17, PID_MCI_RX=-1, PID_SPI0_RX=7, PID_SPI0_TX=15, PID_SPI1_RX=8, PID_SPI1_TX=16, PID_SPI2_RX=-1, PID_SPI2_TX=-1, PID_SPI3_RX=-1, PID_SPI3_TX=-1, PID_SSC_RX=1, PID_SSC_TX=9, PID_SSC0_RX=-1, PID_SSC0_TX=-1, PID_SSC1_RX=-1, PID_SSC1_TX=-1, PID_SSC2_RX=-1, PID_SSC2_TX=-1, PID_TSADCC_RX=-1, PID_TWI_RX=6, PID_TWI_TX=14, PID_TWI0_RX=-1, PID_TWI0_TX=-1, PID_TWI1_RX=-1, PID_TWI1_TX=-1, PID_USART0_RX=2, PID_USART0_TX=10, PID_USART1_RX=3, PID_USART1_TX=11, PID_USART2_RX=4, PID_USART2_TX=12, PID_USART3_RX=5, PID_USART3_TX=13, PID_USART4_RX=-1, PID_USART4_TX=-1, PID_USART5_RX=-1, PID_USART5_TX=-1
PLL0
  pins: PLLCLK0 PA00; LOCK0 PA01; DN0 PB18; UP0 PB19; FDIV0 PB20
PLL1
  pins: PLLCLK0 PA02; LOCK0 PA03; DN0 PB23; UP0 PB24; FDIV0 PB25
PM at 0xffff0c00
  pins: GCLK0 PA07/B or PB19/B; GCLK1 PB20/B or PB29/B; GCLK2 PB21/B or PB30/B; GCLK3 PB22/B or PB31/B; RSTM_N0 PB31; XIN00 PC02; XIN10 PC04; XIN320 PC00; XOUT00 PC03; XOUT10 PC05; XOUT320 PC01
  parameters: GCLK_MSB=5, GCLK_NUM=6, GCLK_USBB=4, GPLP_NUM=2, RCOSC_CALIBRATION_BITS=10, RCOSC_FREQUENCY=115200, PLL_VCO_RANGE0_MIN_FREQ=160000000, PLL_VCO_RANGE0_MAX_FREQ=240000000, PLL_VCO_RANGE1_MIN_FREQ=80000000, PLL_VCO_RANGE1_MAX_FREQ=180000000, CPU_MAX_FREQ=66000000, HSB_MAX_FREQ=66000000, PBA_MAX_FREQ=66000000, PBB_MAX_FREQ=66000000
  clocks: CPU OCD bit 0, SYSTIMER bit 16; HSB FLASHC bit 0, PBA bit 1, PBB bit 2, USBB bit 3, MACB bit 4, PDCA bit 5, EBI bit 6; PBA INTC bit 0, GPIO bit 1, PDCA bit 2, PM bit 3, RTC bit 3, EIC bit 3, ADC bit 4, SPI0 bit 5, SPI1 bit 6, TWI bit 7, USART0 bit 8, USART1 bit 9, USART2 bit 10, USART3 bit 11, PWM bit 12, SSC bit 13, TC bit 14, ABDAC bit 15; PBB HMATRIX bit 0, USBB bit 1, FLASHC bit 2, MACB bit 3, SMC bit 4, SDRAMC bit 5
PULLUP0
  pins: LPC_PULLUP0 PX02 or PX03 or PX04 or PX05 or PX06 or PX07 or PX08 or PX09 or PX10 or PX11 or PX12 or PX13 or PX14 or PX33 or PX34 or PX35 or PX36 or PX37 or PX38 or PX39
PULLUP1
  pins: LPC_PULLUP0 PX00 or PX01 or PX15 or PX16 or PX17 or PX18 or PX19 or PX20 or PX21 or PX22 or PX23 or PX24 or PX25 or PX26 or PX27 or PX28 or PX29 or PX30 or PX31 or PX32
PWM at 0xffff3000
  pins: PWM0 PB19/A; PWM1 PB20/A; PWM2 PB21/A; PWM3 PB22/A; PWM4 PA05/B or PB27/B; PWM5 PA06/B or PB28/B; PWM6 PB18/C
  parameters: CHANNEL_LENGTH=0x7, PADDR_MSB=3, PDATA_MSB=3, PWM_LINES_MSB=6
RTC at 0xffff0d00
SPI0 at 0xffff2400 (SPI)
  pins: NPCS0 PA10/A or PX30/B; MISO0 PA11/A or PX27/B; MOSI0 PA12/A or PX28/B; SCK0 PA13/A or PX29/B; NPCS1 PA08/B or PX31/B; NPCS2 PA09/B or PX32/B; NPCS3 PX33/B or PA07/C; SCAN_CLOCK0 PA13
  parameters: SPI_CS_MSB=3
SPI1 at 0xffff2800 (SPI)
  pins: NPCS0 PA14/B or PX37/B; SCK0 PA15/B or PX36/B; MOSI0 PA16/B or PX35/B; MISO0 PA17/B or PX34/B; NPCS1 PA18/B or PX38/B; NPCS2 PA19/B or PX39/B; NPCS3 PA20/B; SCAN_CLOCK0 PA15
  parameters: SPI_CS_MSB=3
SSC at 0xffff3400
  pins: TX_FRAME_SYNC0 PA14/A; TX_CLOCK0 PA15/A; TX_DATA0 PA16/A; RX_DATA0 PA17/A; RX_CLOCK0 PA18/A; RX_FRAME_SYNC0 PA19/A
TC at 0xffff3800
  pins: A00 PB23/A or PX14/C; B00 PB24/A or PX15/C; A10 PB25/A or PX16/C; B10 PB26/A or PX17/C; A20 PB27/A or PX18/C; B20 PB28/A or PX19/C; CLK00 PA00/B or PB12/B or PX20/C; CLK10 PA01/B or PB13/B or PX21/C; CLK20 PA02/B or PB14/B or PX22/C
TWI at 0xffff2c00
  pins: SDA0 PA29/A or PA29; SCL0 PA30/A or PA30
  parameters: APB_TWI_PADDR_MSB=32, PDATA_SIZE=32
USART0 at 0xffff1400 (USART)
  pins: RXD0 PA00/A or PX00/B; TXD0 PA01/A or PX01/B; CLK0 PA02/A; RTS0 PA03/A or PX03/B; CTS0 PA04/A or PX02/B
  parameters: PADDR_MSB=12, PDATA_MSB=31
USART1 at 0xffff1800 (USART)
  pins: RXD0 PA05/A or PX04/B; TXD0 PA06/A or PX05/B; CLK0 PA07/A; RTS0 PA08/A or PX07/B; CTS0 PA09/A or PX06/B; DCD0 PB23/B; DSR0 PB24/B; DTR0 PB25/B; RI0 PB26/B
  parameters: PADDR_MSB=12, PDATA_MSB=31
USART2 at 0xffff1c00 (USART)
  pins: RXD0 PB29/A or PX10/B; TXD0 PB30/A or PX11/B; CLK0 PB31/A; RTS0 PA29/B or PB00/B or PX13/B; CTS0 PA30/B or PB01/B or PX12/B
  parameters: PADDR_MSB=12, PDATA_MSB=31
USART3 at 0xffff2000 (USART)
  pins: CLK0 PB04/B; RXD0 PB10/B or PX08/B; TXD0 PB11/B or PX09/B; RTS0 PX15/B or PB00/C; CTS0 PX16/B or PB01/C
  parameters: PADDR_MSB=12, PDATA_MSB=31
USBB at 0xfffe0000, USBB_SLAVE 0x0000 in slave
  pins: USB_ID0 PA11/B or PB16/B or PA21/C; USB_VBOF0 PA12/B or PB17/B or PA22/C; SCAN_CLOCK0 PB30
  parameters: EPT_NUM=7
WDT at 0xffff0d30
  parameters: WDTEXTRST_MSB=1
FUSES at 0xFFFE1400 in fuses (FLASH_FUSES)

## Interrupts
0 CORE_COMPARE_IRQ (CORE)
NMI EIM_IRQ_8 (EIC)
{n+32} EIM_IRQ_{n} (EIC) (n=0..7)
40 RTC_IRQ (RTC)
41 PM_IRQ (PM)
42 FREQM_IRQ (FREQM)
{n+64} GPIO_IRQ_{n} (GPIO) (n=0..13)
{n+96} PDMA_IRQ_{n} (PDCA) (n=0..14)
128 HFLASHC_IRQ (FLASHC)
160 USART0_IRQ (USART0)
192 USART1_IRQ (USART1)
224 USART2_IRQ (USART2)
256 USART3_IRQ (USART3)
288 SPI0_IRQ (SPI0)
320 SPI1_IRQ (SPI1)
352 TWI_IRQ (TWI)
384 PWM_IRQ (PWM)
416 SSC_IRQ (SSC)
448 TC_IRQ0 (TC)
449 TC_IRQ1 (TC)
450 TC_IRQ2 (TC)
480 ADC_IRQ (ADC)
512 MACB_IRQ (MACB)
544 USB_IRQ (USBB)
576 HSDRAMC_IRQ (SDRAMC)
608 DAC_IRQ (ABDAC)

## Properties
AVR32_RESET: NumberOfResetDomains=5, ResetGroup=1
SIGNATURES: JTAGID=0x1edf03f
